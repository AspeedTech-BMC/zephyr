#include <zephyr.h>
#include <sys/printk.h>
#include <string.h>
#include <crypto/rsa_structs.h>
#include <crypto/rsa.h>
#include "rsa_aspeed.h"

int decrypt_aspeed (const struct rsa_key *key, const uint8_t *encrypted, size_t in_length, uint8_t *decrypted, size_t out_length)
{
	const struct device *dev = device_get_binding(RSA_DRV_NAME);
    struct rsa_ctx ini;
    struct rsa_pkt pkt;
    struct rsa_key *rk;
    int ret;
    int j;

    rk = key;
    pkt.in_buf = encrypted;
    pkt.in_len = in_length;
    pkt.out_buf = decrypted;
    pkt.out_buf_max = out_length;
    ret = rsa_begin_session(dev, &ini, rk);
    if (ret)
        printk("rsa_begin_session fail: %d", ret);

    rsa_decrypt(&ini, &pkt);
    rsa_free_session(dev, &ini);

	return ret;
}

/**
 * Verify that a signature matches the expected SHA-256 hash.  The signature is expected to be
 * in PKCS v1.5 format.
 *
  * @param key The public key to decrypt the signature.
 * @param signature The signature to validate.
 * @param sig_length The length of the signature.
 * @param match The value that should match the decrypted signature.
 * @param match_length The length of the match value.
 *
 * @return 0 if the signature matches the digest or an error code.
 */
int sig_verify_aspeed (const struct rsa_key *key, const uint8_t *signature, size_t sig_length, const uint8_t *match, size_t match_length)
{
    const struct device *dev = device_get_binding(RSA_DRV_NAME);
    struct rsa_ctx ini;
    struct rsa_pkt pkt;
    struct rsa_key *rk;
    uint8_t plain_text[match_length];
    int i, j;
    int ret;

    printk("Sig_verify_aspeed\n");
 
    rk->m = key->m;
    rk->m_bits = key->m_bits;
    rk->d = key->d;
    rk->d_bits = 512;
    pkt.in_buf = signature;
    pkt.in_len = sig_length;
    pkt.out_buf = plain_text;//match;
    pkt.out_buf_max = match_length;

    ret = rsa_begin_session(dev, &ini, rk);
    if (ret)
        printk("rsa_begin_session fail: %d", ret);
    rsa_decrypt(&ini, &pkt);//decrypt signature
    rsa_free_session(dev, &ini);

    ret = memcmp(plain_text, match, match_length);//rsa_tv[i].p = OTP hash data 

    if (ret != 0) 
    {
        printk("decrypt fail: %d\n", ret);
        printk("input text:\n");
        printk("c_size=%x\n", sig_length);
        printk("p_size=%x\n", match_length);
        for (j = 0; j < sig_length; j++) 
        {
            printk("%x ", signature[j]);
            if ((j + 1) % 16 == 0)
                printk("\n");
        }
        printk("result text:\n");
        for (j = 0; j < match_length; j++)
        {
            printk("%x ", plain_text[j]);
            if ((j + 1) % 16 == 0)
                printk("\n");
        }
        printk( "\n");
    }

    return ret;
}

#if ZEPHYR_RSA_API_MIDLEYER_TEST_SUPPORT

struct rsa_testvec {
    struct rsa_key k;
    char *p;
    char *c;
    unsigned int p_size;
    unsigned int c_size;
};

static struct rsa_testvec rsa_tv[] = {
    {
        .k = {
            .m =
                "\x00\xb4\xea\x51\x4c\x84\x04\x6c\xc9\xb2\xb7\x58\x52\xc0\x84\x79"
                "\x5f\xc5\x6d\x58\x80\x07\xe1\xf4\x9b\xc7\x67\xa6\x42\xac\x45\x2e"
                "\xc0\xe9\x5e\x40\x48\xac\x4f\x3c\x21\xad\x0b\xef\xc7\x58\x01\xaf"
                "\xf7\x2d\x4a\x27\xcf\xfe\x28\x97\xbf\x81\xc6\xb4\xec\x5f\xe1\x44"
                "\x8f",
            .d =
                "\x07\x9d\x0c\xca\xd1\x8b\x76\x20\x8e\xda\xd4\x66\xb7\x1f\x5c\x14"
                "\x41\xb4\xb6\x52\xbd\x02\x2f\x4f\x16\xf7\x2f\xb2\x02\x99\xee\xbb"
                "\xb1\x79\x17\xdc\x14\x2c\x13\xa4\xd8\xa7\x5c\x25\xc9\xeb\x18\x16"
                "\xf2\x33\xa5\xf1\x33\x2d\x6c\x7d\x2d\x8f\x5c\x19\xb4\x6b\xf9\x51",
            .e = "\x01\x00\x01",
            .m_bits = 520,
            .d_bits = 512,
            .e_bits = 24
        },
        .p = //Hash
        "\x53\x2e\xaa\xbd\x95\x74\x88\x0d\xbf\x76\xb9\xb8\xcc\x00\x83\x2c"
        "\x20\xa6\xec\x11\x3d\x68\x22\x99\x55\x0d\x7a\x6e\x0f\x34\x5e\x25",
        .c = //Sig
        "\x01\xe6\x40\xd4\x2f\x4b\xd2\x24\x1c\xb1\x3f\xe0\xa4\x40\x95\x60"
        "\x9c\x64\x6c\x0b\x9e\x3a\xda\xc1\x0c\x9d\x0c\xd2\x0a\xbe\xe4\x5d"
        "\xf3\x6b\xb4\x96\x32\x6b\x47\x23\x68\xf1\x4e\x8a\xa9\xb9\x8f\x89"
        "\x6b\x1a\x58\x98\x2b\x04\x53\x74\x0b\x5d\x3e\x82\xb2\x7a\x69\x3c",
        .p_size = 32,
        .c_size = 64,
    },
};

static struct rsa_key rsa_pub_key[] = {
    {
        .m = 
            "\x00\xb4\xea\x51\x4c\x84\x04\x6c\xc9\xb2\xb7\x58\x52\xc0\x84\x79"
            "\x5f\xc5\x6d\x58\x80\x07\xe1\xf4\x9b\xc7\x67\xa6\x42\xac\x45\x2e"
            "\xc0\xe9\x5e\x40\x48\xac\x4f\x3c\x21\xad\x0b\xef\xc7\x58\x01\xaf"
            "\xf7\x2d\x4a\x27\xcf\xfe\x28\x97\xbf\x81\xc6\xb4\xec\x5f\xe1\x44"
            "\x8f",
        .m_bits = 520,
        .d = 
            "\x07\x9d\x0c\xca\xd1\x8b\x76\x20\x8e\xda\xd4\x66\xb7\x1f\x5c\x14"
            "\x41\xb4\xb6\x52\xbd\x02\x2f\x4f\x16\xf7\x2f\xb2\x02\x99\xee\xbb"
            "\xb1\x79\x17\xdc\x14\x2c\x13\xa4\xd8\xa7\x5c\x25\xc9\xeb\x18\x16"
            "\xf2\x33\xa5\xf1\x33\x2d\x6c\x7d\x2d\x8f\x5c\x19\xb4\x6b\xf9\x51",
    },
};

/* The SHA256 hash for the string "Test". */
// const uint8_t SIG_HASH_TEST[] = {
//     0x53,0x2e,0xaa,0xbd,0x95,0x74,0x88,0x0d,0xbf,0x76,0xb9,0xb8,0xcc,0x00,0x83,0x2c,
//     0x20,0xa6,0xec,0x11,0x3d,0x68,0x22,0x99,0x55,0x0d,0x7a,0x6e,0x0f,0x34,0x5e,0x25
// };

static int rsa_sig_verify_test(void)
{
	int ret;
	// const struct rsa_key *key;
	// const uint8_t *signature; 
	// size_t sig_length; 
	//const uint8_t *match; 
	size_t match_length;
	int j;

	ret = sig_verify_aspeed (rsa_pub_key, rsa_tv[0].c, rsa_tv[0].c_size, rsa_tv[0].p, rsa_tv[0].p_size);

    //ret = memcmp(match, , rsa_tv[0].p_size);//rsa_tv[i].p = OTP hash data
    if (ret != 0) 
    {
        printk("decrypt fail: %d\n", ret);
        // printk("input text:\n");
        // printk("c_size=%x\n", rsa_tv[0].c_size);
        // printk("p_size=%x\n", rsa_tv[0].p_size);
        // for (j = 0; j < rsa_tv[0].c_size; j++) 
        // {
        //     printk("%x ", rsa_tv[0].c[j]);
        //     if ((j + 1) % 16 == 0)
        //         printk("\n");
        // }
        // printk("result text:\n");
        // for (j = 0; j < rsa_tv[0].p_size; j++)
        // {
        //     printk("%x ", match[j]);
        //     if ((j + 1) % 16 == 0)
        //         printk("\n");
        // }
        // printk( "\n");
    } 
    else 
    {
        printk("decrypt pass\n");
    }

	return 0;
}
//mark_rsa_test+>

struct RsaTestData {
	struct rsa_key k;
	char *p;
	char *c;
	unsigned int p_size;
	unsigned int c_size;
};
static struct RsaTestData RsaTD[] = 
{
	{
	.k = {
			.m =
			"\xC3\x8B\x55\x7B\x73\x4D\xFF\xE9\x9B\xC6\xDC\x67\x3C\xB4\x8E"
			"\xA0\x86\xED\xF2\xB9\x50\x5C\x54\x5C\xBA\xE4\xA1\xB2\xA7\xAE\x2F"
			"\x1B\x7D\xF1\xFB\xAC\x79\xC5\xDF\x1A\x00\xC9\xB2\xC1\x61\x25\x33"
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			"\xCC\xA8\x0B\x92\x8E\xB4\xF7\x06\xFF\x1E\x95\xCB\x07\x76\x97\x3B"
			"\x9D",
			.d =
			"\x74\xA9\xE0\x6A\x32\xB4\xCA\x85\xD9\x86\x9F\x60\x88\x7B\x40\xCC"
			"\xCD\x33\x91\xA8\xB6\x25\x1F\xBF\xE3\x51\x1C\x97\xB6\x2A\xD9\xB8"
			"\x11\x40\x19\xE3\x21\x13\xC8\xB3\x7E\xDC\xD7\x65\x40\x4C\x2D\xD6"
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			"\xA7\x7B\xAE\x3A\xF6\x7E\xD9\xDB\xD3\xF5\xC5\x41\xAF\xE6\x9C\x91",
			.e = "\x01\x00\x01",
			.m_bits = 4096,
			.d_bits = 4096,
			.e_bits = 24
		},
		.p = "\x54\x85\x9b\x34\x2c\x49\xea\x2a",
		.c =
		"\x5c\xce\x9c\xd7\x9a\x9e\xa1\xfe\x7a\x82\x3c\x68\x27\x98\xe3\x5d"
		"\xd5\xd7\x07\x29\xf5\xfb\xc3\x1a\x7f\x63\x1e\x62\x31\x3b\x19\x87"
		"\x79\x4f\xec\x7b\xf3\xcb\xea\x9b\x95\x52\x3a\x40\xe5\x87\x7b\x72"
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		"\x26\x86\x45\x6f\x0b\xd5\x9f\x03\xb1\x65\x5b\xdb\xa4\xe4\xf9\x45",
		.p_size = 8,
		.c_size = 512,
	},
};

static int RsaDecryptTest(void)
{
	const struct device *dev = device_get_binding(RSA_DRV_NAME);
	struct rsa_ctx ini;
	struct rsa_pkt pkt;
	struct rsa_key *rk;
	char plain_text[512];
	char cipher_text[512];
	int j;
	int ret;

	printk("RsaDecryptTest start:\n");
	rk = &RsaTD[0].k;
	pkt.in_buf = RsaTD[0].p;
	pkt.in_len = RsaTD[0].p_size;
	pkt.out_buf = cipher_text;
	pkt.out_buf_max = 512;
	ret = rsa_begin_session(dev, &ini, rk);
	if (ret)
		printk("rsa_begin_session fail: %d", ret);

	rsa_encrypt(&ini, &pkt);
	rsa_free_session(dev, &ini);
	ret = memcmp(cipher_text, RsaTD[0].c, RsaTD[0].c_size);
	if (ret != 0) 
	{
		printk("enc fail: %d\n", ret);
		printk("input text:\n");
		for (j = 0; j < RsaTD[0].p_size; j++) 
		{
			printk("%02x", RsaTD[0].p[j]);
			if ((j + 1) % 32 == 0)
				printk("\n");
		}
		printk("\n");
		printk("result text:\n");
		for (j = 0; j < RsaTD[0].c_size; j++) 
		{
			printk("%02x", cipher_text[j]);
			if ((j + 1) % 32 == 0)
				printk("\n");
		}
		printk("\n");
	} 
	else 
	{
		printk("RsaDecryptTest enc pass\n");
	}

	decrypt_aspeed(&RsaTD[0].k,&cipher_text,RsaTD[0].c_size,&plain_text,512);
	ret = memcmp(plain_text, RsaTD[0].p, RsaTD[0].p_size);
	if (ret != 0) 
		{
			printk("dec fail: %d\n", ret);
			printk("input text:\n");
			for (j = 0; j < RsaTD[0].c_size; j++) 
			{
				printk("%02x", RsaTD[0].p[j]);
				if ((j + 1) % 32 == 0)
					printk("\n");
			}
			printk("result text:\n");
			for (j = 0; j < RsaTD[0].p_size; j++) 
			{
				printk("%02x", plain_text[j]);
				if ((j + 1) % 32 == 0)
					printk("\n");
			}
			printk("\n");
		} 
		else 
		{
			printk("MarkRsaDec pass\n");
		}

	return ret;

}
//<+mark_rsa_test

/**
 * @brief	test rsa functions
 */
void rsa_engine_function_test(void)
{
    uint8_t* status_string;

    status_string = ( RsaDecryptTest() ) ? ("FAIL") : ("PASS");

    printk("RsaDecryptTest : %s\n", status_string);

    status_string = ( rsa_sig_verify_test() ) ? ("FAIL") : ("PASS");

    printk("rsa_sig_verify_test : %s\n", status_string);
}

#endif	/* #if ZEPHYR_RSA_API_MIDLEYER_TEST_SUPPORT */