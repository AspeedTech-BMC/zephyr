## drivers/ipmi/Kconfig
```kconfig
# eSPI configuration options

# Copyright (c) 2019 Intel Corporation
# SPDX-License-Identifier: Apache-2.0

menuconfig IPMI
	bool "IPMI Driver"
	help
	  Enable IPMI Driver.

if IPMI

source "drivers/ipmi/Kconfig.aspeed"

endif # IPMI
```

## drivers/ipmi/Kconfig.aspeed
```kconfig
# ASPEED IPMI driver configuration options

# Copyright (c) 2021 ASPEED
# SPDX-License-Identifier: Apache-2.0

config IPMI_KCS_ASPEED
	bool "ASPEED IPMI KCS driver"
	depends on SOC_FAMILY_ASPEED
	help
	  This option enables the KCS BMC driver for ASPEED
	  SoCs.
	  Say y if you wish to use KCS channels on ASPEED MCU.
```

## drivers/otp/Kconfig.aspeed
```kconfig
# ASPEED I3C driver configuration options

# Copyright (c) 2021 ASPEED Technology Inc.
# SPDX-License-Identifier: Apache-2.0

config OTP_ASPEED
	bool "ASPEED OTP Utility"
	depends on SOC_FAMILY_ASPEED
	select MBEDTLS_MAC_SHA256_ENABLED
	select MBEDTLS_MAC_SHA512_ENABLED
	help
	  This option enables the OTP Utility for ASPEED SoCs.
```

## drivers/pwm/Kconfig.aspeed
```kconfig
# ASPEED PWM driver configuration options

# Copyright (c) 2021 ASPEED Technology Inc.
# SPDX-License-Identifier: Apache-2.0

config PWM_ASPEED
	bool "ASPEED PWM driver"
	depends on SOC_FAMILY_ASPEED
	help
	  This option enables the PWM driver for ASPEED family of
	  processors.
	  Say y if you wish to use PWM channels on ASPEED MCU.
```

## drivers/spi/Kconfig.aspeed
```kconfig
# ASPEED FMC_SPI

# Copyright (c) 2021 ASPEED Technology Inc. <chin-ting_kuo@aspeedtech.com>
# SPDX-License-Identifier: Apache-2.0

config SPI_ASPEED
	select SPI_NOR_MULTI_DEV
	bool "ASPEED SPI(FMC) driver"
	help
	  Enable ASPEED SPI(FMC) controller driver.
```

## drivers/timer/Kconfig.aspeed
```kconfig
# ASPEED timer driver configuration options

# Copyright (c) 2024 ASPEED Technology Inc.
# SPDX-License-Identifier: Apache-2.0

config TIMER_ASPEED
	bool "Aspeed general purpose timer"
	depends on DT_HAS_ASPEED_TIMER_ENABLED
	default y
	help
	  Say "y" to enable the driver of the Aspeed general purpose timer.

config TIMER_ASPEED_AST27XX
	bool "Aspeed ast27xx general purpose timer"
	depends on DT_HAS_ASPEED_AST27XX_TIMER_ENABLED
	default y
	help
	  Say "y" to enable the driver of the Aspeed ast27xx general purpose timer.

if TIMER_ASPEED || TIMER_ASPEED_AST27XX
config TIMER_ASPEED_SHELL
	bool "Shell commands for Aspeed timer"
	default y
	depends on SHELL
	select SHELL_GETOPT
	help
	  Say "y" to enanle the shell commands for the Aspeed general purpose timer
endif
```

## dts/bindings/adc/aspeed,adc.yaml
```yaml
description: ASPEED family ADC

compatible: "aspeed,adc"

include: [adc-controller.yaml, pinctrl-device.yaml, reset-device.yaml]

properties:
    reg:
      required: true

    interrupts:
      required: true

    clocks:
      required: true

    resets:
      required: true

    ref-voltage-mv:
          type: int
          description: |
            Reference voltage in millivolts for the conversions
    aspeed,scu:
      type: phandle
      required: true
      description: phandle to SCU device tree node

    aspeed,adc-channels-used:
      type: int
      description: Bitmask of the channels muxed and enabled for this device

    aspeed,trim-data-valid:
      type: boolean
      description: |
        If true, the trim data from OTP used to calibrate the internal reference voltage is valid.

    aspeed,trim-data-locate:
      type: array
      description: |
        Locate the SCU offset and bit mask that the trimming data is loaded into from OTP.
        [SCU_offset bit_mask]

    "#io-channel-cells":
      const: 1

io-channel-cells:
    - input
```

## dts/bindings/adc/aspeed,ast1030-adc.yaml
```yaml
description: ASPEED family ADC

compatible: "aspeed,ast1030-adc"

include: adc-controller.yaml

properties:
    reg:
      required: true

    interrupts:
      required: true

    ref-voltage-mv:
          type: int
          description: |
            Reference voltage in millivolts for the conversions

    "#io-channel-cells":
      const: 1

io-channel-cells:
    - input
```

## dts/bindings/clock/aspeed,ast1030-clk.yaml
```yaml
# Copyright (c) 2021, ASPEED
# SPDX-License-Identifier: Apache-2.0

description: Aspeed Clock Controller

compatible: "aspeed,ast1030-clk"

include: [clock-controller.yaml, base.yaml]

properties:

    "#clock-cells":
      const: 1

clock-cells:
  - clk_id
```

## dts/bindings/clock/aspeed,ast26xx-clock.yaml
```yaml
# Copyright (c) 2022 Aspeed Technology Inc.
# SPDX-License-Identifier: Apache-2.0

description: Aspeed AST26XX Clock Controller

compatible: "aspeed,ast26xx-clock"

include: [clock-controller.yaml, base.yaml]

properties:
  "#clock-cells":
    const: 1

clock-cells:
  - clk_id
```

## dts/bindings/clock/aspeed,ast27xx-cpu-clock.yaml
```yaml
# Copyright (c) 2023 Aspeed Technology Inc.
# SPDX-License-Identifier: Apache-2.0

description: Aspeed AST27XX Clock Controller

compatible: "aspeed,ast27xx-cpu-clock"

include: [clock-controller.yaml, base.yaml]

properties:
  "#clock-cells":
    const: 1

clock-cells:
  - clk_id
```

## dts/bindings/clock/aspeed,ast27xx-io-clock.yaml
```yaml
# Copyright (c) 2023 Aspeed Technology Inc.
# SPDX-License-Identifier: Apache-2.0

description: Aspeed AST27XX Clock Controller

compatible: "aspeed,ast27xx-io-clock"

include: [clock-controller.yaml, base.yaml]

properties:
  "#clock-cells":
    const: 1

clock-cells:
  - clk_id
```

## dts/bindings/espi/aspeed,espi.yaml
```yaml
# Copyright (c) 2021, ASPEED
# SPDX-License-Identifier: Apache-2.0

description: ASPEED eSPI for AST1030/AST2600

compatible: "aspeed,espi"

include: espi-controller.yaml

properties:
    reg:
      description: mmio register space
      required: true

    aspeed,scu:
      type: phandle
      required: true
      description: phandle to SCU device tree node

    perif,dma-mode:
      type: boolean
      required: false
      description: enable DMA for peripheral channel

    perif,memcyc-enable:
      type: boolean
      required: false
      description: enable memory cycle for peripheral channel

    perif,memcyc-src-addr:
      type: int
      required: false
      description: host side decoding address of memory cycle

    perif,memcyc-size:
      type: int
      required: false
      description: region size for memory cycle

    oob,dma-mode:
      type: boolean
      required: false
      description: enable DMA for OOB channel

    flash,dma-mode:
      type: boolean
      required: false
      description: enable DMA for flash channel

    flash,safs-mode:
      type: int
      required: false
      description: select the SAFS mode (0->mix, 1->hw, 2->sw), don't care for MAFS
```

## dts/bindings/gpio/aspeed,gpio.yaml
```yaml
# Copyright (c) 2021 ASPEED
# SPDX-License-Identifier: Apache-2.0

description: ASPEED GPIO node

compatible: "aspeed,gpio"

include: base.yaml

properties:
  aspeed,deb-interval-ms:
    type: int
    default: 5
    description:
      Debounce inverval when pin configure with GPIO_INT_DEBOUNCE. (unit is ms)

child-binding:
  description: GPIO child node
  include: gpio-controller.yaml
  properties:
    label:
      type: string
      required: true

    ngpios:
      required: true

    gpio-reserved:
      type: int
      required: false
      description: |
          specify which GPIOs are unusable. 
          If gpio 3, 4, 10 are reserved the value will be 0x418
    
    pin-offset:
      type: int
      required: true
      description: Pin offset of this GPIO entry

    "#gpio-cells":
      const: 2

    aspeed,cmd-src:
      type: int
      required: false
      enum:
        - 0 # ARM
        - 1 # LPC
        - 2 # SSP
      description: Select the master to control the gpio device.

    aspeed,group-dedicated:
      type: int
      required: false
      description: |
        Dedicated gpio group for select master, each group include 8 gpios
        BIT0~BIT3 => GROUP0~GROUP3.
  gpio-cells:
  - pin
  - flags
```

## dts/bindings/i2c/aspeed,i2c-filter.yaml
```yaml
#
# Copyright (c) ASPEED
#
# SPDX-License-Identifier: Apache-2.0
#

description: ASPEED I2C Filter controller

compatible: "aspeed,i2c-filter"

include: [base.yaml, aspeed-pinctrl.yaml]

properties:
    reg:
      required: true

    interrupts:
      required: true

    label:
      required: true

    index:
      type: int
      required: true
      description: i2c filter device index
```

## dts/bindings/i2c/aspeed,i2c-global.yaml
```yaml
#
# Copyright (c) ASPEED
#
# SPDX-License-Identifier: Apache-2.0
#

description: ASPEED I2C Global controller

compatible: "aspeed,i2c-global"

include: [base.yaml, reset-device.yaml]

properties:
  clk-divider:
    type: int
    required: true
    description: |
      bus clock divider value. the molecular is PCLK.

  resets:
    required: true
```

## dts/bindings/i2c/aspeed,i2c.yaml
```yaml
#
# Copyright (c) ASPEED
#
# SPDX-License-Identifier: Apache-2.0
#

description: ASPEED I2C controller

compatible: "aspeed,i2c"

include:
  - name: i2c-controller.yaml
  - name: pinctrl-device.yaml

properties:
  reg:
    required: true

  interrupts:
    required: true

  xfer-mode:
    type: string
    required: true
    enum:
        - "BYTE"
        - "BUFF"
        - "DMA"
    description: |
      i2c transfer type. Default value is DMA.

  multi-master:
    type: int
    required: true
    description: |
      i2c multi-master support. Default value is enable.

  smbus-timeout:
    type: int
    required: true
    description: |
      smbus slave timeout support. Default value is enable.
      The timeout value is set 35ms.

  manual-high-count:
    type: int
    required: true
    description: |
      manual i2c clock high part. Default value is 0.
      The value should be 0x3 ~ 0xF.0 means that this
      parameter use driver default value.

  manual-low-count:
    type: int
    required: true
    description: |
      manual i2c clock low part. Default value is 0.
      The value should be 0x3 ~ 0xF. 0 means that this
      parameter use driver default value.

  manual-sda-delay:
    type: int
    required: true
    description: |
      manual i2c sda dealy. Default value is 0.
      The value should be 0x0 ~ 0x3. 0 means that this
      parameter use driver default value.
```

## dts/bindings/i2c/aspeed,swmbx-ctrl.yaml
```yaml
#
# Copyright (c) ASPEED
#
# SPDX-License-Identifier: Apache-2.0
#

description: ASPEED I2C SW MailBox Controller

compatible: "aspeed,swmbx-ctrl"

include: base.yaml

properties:
    size:
      type: int
      required: true
```

## dts/bindings/i2c/aspeed,swmbx-dev.yaml
```yaml
#
# Copyright (c) ASPEED
#
# SPDX-License-Identifier: Apache-2.0
#

description: ASPEED SW MailBox Device

compatible: "aspeed,swmbx-dev"

include:
  - name: i2c-device.yaml

properties:
    size:
      type: int
      required: true
    port:
      type: int
      required: true
```

## dts/bindings/i2c/aspeed,swmbx.yaml
```yaml
#
# Copyright (c) ASPEED
#
# SPDX-License-Identifier: Apache-2.0
#

description: ASPEED I2C SW MailBox device

compatible: "aspeed,swmbx"

include: i2c-device.yaml

properties:
    base:
      type: int
      required: true
      description: sw mailbox device address
    size:
      type: int
      required: true
      description: Total sw mailbox size
```

## dts/bindings/i3c/aspeed,i3c-global.yaml
```yaml
#
# Copyright (c) ASPEED
#
# SPDX-License-Identifier: Apache-2.0
#

description: ASPEED I3C Global controller

compatible: "aspeed,i3c-global"

include: base.yaml

properties:
  "#global-reg-cells":
    type: int
    const: 1

global-reg-cells:
  - id
```

## dts/bindings/i3c/aspeed,i3c-slave-mqueue.yaml
```yaml
# Copyright (c) 2021, ASPEED
# SPDX-License-Identifier: Apache-2.0

description: ASPEED I3C MQueue device

compatible: "aspeed,i3c-slave-mqueue"

include: base.yaml

on-bus: i3c

properties:
    msg-size:
      type: int
      required: true
      description: the size of the single message in byte
    num-of-msgs:
      type: int
      required: true
      description: number of the messages
```

## dts/bindings/i3c/aspeed,i3c.yaml
```yaml
# Copyright (c) 2021, ASPEED
# SPDX-License-Identifier: Apache-2.0

description: ASPEED I3C

compatible: "aspeed,i3c"

include: [i3c-controller.yaml, aspeed-pinctrl.yaml]

properties:
  secondary:
    required: false
    type: boolean
    description: Initialized as a secondary master / slave device

  assigned-address:
    required: false
    type: int
    description: Dynamic address when playing the role as the main master. Static address when playing the role as the slave.

  instance-id:
    required: true
    type: int
    description: Instance ID of the device

  ibi-append-pec:
    required: false
    type: boolean
    description: Append PEC byte to the IBI data.  Enable this option in slave mode if the master device is AST2600 or AST1030A0.

  priv-xfer-pec:
    required: false
    type: boolean
    description: |
      Enable this option in slave mode if the i3c want to communicate with data that have PEC.
      The PEC will auto append to the tail of the data when doing private transfer and verify
      the PEC when receiving the data from master.

  pid-extra-info:
    required: false
    type: int
    description: Extra information of the PID Bits[11:0]. Use to identify the different BIC.

  i3c-pp-scl-hi-period-ns:
    required: false
    type: int
    description: I3C push-pull mode SCL high period in nanosecond

  i3c-pp-scl-lo-period-ns:
    required: false
    type: int
    description: I3C push-pull mode SCL low period in nanosecond

  i3c-od-scl-hi-period-ns:
    required: false
    type: int
    description: I3C open-drain mode SCL high period in nanosecond

  i3c-od-scl-lo-period-ns:
    required: false
    type: int
    description: I3C open-drain mode SCL low period in nanosecond

  sda-tx-hold-ns:
    required: false
    type: int
    description: The hold time of the SDA with respect to the SCL edge. The unit is in nanosecond.
```

## dts/bindings/i3c/i3c-controller.yaml
```yaml
# Copyright (c) 2021 ASPEED Technology Inc.
# SPDX-License-Identifier: Apache-2.0

# Common fields for I3C devices

include: base.yaml

properties:
    label:
      required: true
```

## dts/bindings/ipm/aspeed,ast2600-ipc.yaml
```yaml
# Copyright (c) 2022 ASPEED Technology Inc.
# SPDX-License-Identifier: Apache-2.0

description: ASPEED IPC (Interprocessor Communication) in AST2600 SOC

compatible: "aspeed,ast2600-ipc"

include: base.yaml

properties:
    reg:
      required: true

    interrupts:
      required: true

    tx-region:
      description: phandle to the shared memory region used for data transmission
      required: true
      type: phandle

    rx-region:
      description: phandle to the shared memory region used for data reception
      required: true
      type: phandle
```
