/*
 * SPDX-License-Identifier: Apache-2.0
 *
 * Copyright (c) ASPEED Technology Inc.
 */
#include <zephyr/dt-bindings/pinctrl/ast27xx-soc1-pinctrl.h>

&pinctrl1 {
	/omit-if-no-ref/ pin_txd0: pin_txd0 {
		ball = <AC16>;
		sig_descs = <SIG_DESC(0x410, 24, 1)>;
	};
	/omit-if-no-ref/ pin_rxd0: pin_rxd0 {
		ball = <AF16>;
		sig_descs = <SIG_DESC(0x410, 28, 1)>;
	};
};
