/*
 * SPDX-License-Identifier: Apache-2.0
 *
 * Copyright (c) 2023 ASPEED Technology Inc.
 */
#include <zephyr/dt-bindings/pinctrl/ast10x0-pinctrl.h>

&pinmux {
	/omit-if-no-ref/ pin_adc0: pin_adc0 {
		ball = <B2>;
		sig_descs = <SIG_DESC_CLR(0x430, 24)>;
	};
	/omit-if-no-ref/ pin_adc1: pin_adc1 {
		ball = <B1>;
		sig_descs = <SIG_DESC_CLR(0x430, 25)>;
	};
	/omit-if-no-ref/ pin_adc2: pin_adc2 {
		ball = <C1>;
		sig_descs = <SIG_DESC_CLR(0x430, 26)>;
	};
	/omit-if-no-ref/ pin_adc3: pin_adc3 {
		ball = <D3>;
		sig_descs = <SIG_DESC_CLR(0x430, 27)>;
	};
	/omit-if-no-ref/ pin_adc4: pin_adc4 {
		ball = <C2>;
		sig_descs = <SIG_DESC_CLR(0x430, 28)>;
	};
	/omit-if-no-ref/ pin_adc5: pin_adc5 {
		ball = <D1>;
		sig_descs = <SIG_DESC_CLR(0x430, 29)>;
	};
	/omit-if-no-ref/ pin_adc6: pin_adc6 {
		ball = <D2>;
		sig_descs = <SIG_DESC_CLR(0x430, 30)>;
	};
	/omit-if-no-ref/ pin_adc7: pin_adc7 {
		ball = <E3>;
		sig_descs = <SIG_DESC_CLR(0x430, 31)>;
	};
	/omit-if-no-ref/ pin_adc8: pin_adc8 {
		ball = <K2>;
		sig_descs = <SIG_DESC_CLR(0x434, 0)>;
	};
	/omit-if-no-ref/ pin_adc9: pin_adc9 {
		ball = <K4>;
		sig_descs = <SIG_DESC_CLR(0x434, 1)>;
	};
	/omit-if-no-ref/ pin_adc10: pin_adc10 {
		ball = <K3>;
		sig_descs = <SIG_DESC_CLR(0x434, 2)>;
	};
	/omit-if-no-ref/ pin_adc11: pin_adc11 {
		ball = <J1>;
		sig_descs = <SIG_DESC_CLR(0x434, 3)>;
	};
	/omit-if-no-ref/ pin_adc12: pin_adc12 {
		ball = <J2>;
		sig_descs = <SIG_DESC_CLR(0x434, 4)>;
	};
	/omit-if-no-ref/ pin_adc13: pin_adc13 {
		ball = <J4>;
		sig_descs = <SIG_DESC_CLR(0x434, 5)>;
	};
	/omit-if-no-ref/ pin_adc14: pin_adc14 {
		ball = <H1>;
		sig_descs = <SIG_DESC_CLR(0x434, 6)>;
	};
	/omit-if-no-ref/ pin_adc15: pin_adc15 {
		ball = <H2>;
		sig_descs = <SIG_DESC_CLR(0x434, 7)>;
	};
	/omit-if-no-ref/ pin_pwm0: pin_pwm0 {
		ball = <T9>;
		sig_descs = <SIG_DESC_SET(0x414, 8)>;
	};
	/omit-if-no-ref/ pin_pwm1: pin_pwm1 {
		ball = <P9>;
		sig_descs = <SIG_DESC_SET(0x414, 9)>;
	};
	/omit-if-no-ref/ pin_pwm2: pin_pwm2 {
		ball = <R9>;
		sig_descs = <SIG_DESC_SET(0x414, 10)>;
	};
	/omit-if-no-ref/ pin_pwm3: pin_pwm3 {
		ball = <T10>;
		sig_descs = <SIG_DESC_SET(0x414, 11)>;
	};
	/omit-if-no-ref/ pin_pwm4: pin_pwm4 {
		ball = <R10>;
		sig_descs = <SIG_DESC_SET(0x414, 12)>;
	};
	/omit-if-no-ref/ pin_pwm5: pin_pwm5 {
		ball = <P10>;
		sig_descs = <SIG_DESC_SET(0x414, 13)>;
	};
	/omit-if-no-ref/ pin_pwm6: pin_pwm6 {
		ball = <T11>;
		sig_descs = <SIG_DESC_SET(0x414, 14)>;
	};
	/omit-if-no-ref/ pin_pwm7: pin_pwm7 {
		ball = <N11>;
		sig_descs = <SIG_DESC_SET(0x414, 15)>;
	};
	/omit-if-no-ref/ pin_pwm8: pin_pwm8 {
		ball = <N4>;
		sig_descs = <SIG_DESC_SET(0x410, 0)>;
	};
	/omit-if-no-ref/ pin_pwm9: pin_pwm9 {
		ball = <P4>;
		sig_descs = <SIG_DESC_SET(0x410, 1)>;
	};
	/omit-if-no-ref/ pin_pwm10: pin_pwm10 {
		ball = <P1>;
		sig_descs = <SIG_DESC_SET(0x410, 2)>;
	};
	/omit-if-no-ref/ pin_pwm11: pin_pwm11 {
		ball = <P5>;
		sig_descs = <SIG_DESC_SET(0x410, 3)>;
	};
	/omit-if-no-ref/ pin_pwm12: pin_pwm12 {
		ball = <P2>;
		sig_descs = <SIG_DESC_SET(0x410, 4)>;
	};
	/omit-if-no-ref/ pin_pwm13: pin_pwm13 {
		ball = <P3>;
		sig_descs = <SIG_DESC_SET(0x410, 5)>;
	};
	/omit-if-no-ref/ pin_pwm14: pin_pwm14 {
		ball = <R1>;
		sig_descs = <SIG_DESC_SET(0x410, 6)>;
	};
	/omit-if-no-ref/ pin_pwm15: pin_pwm15 {
		ball = <R2>;
		sig_descs = <SIG_DESC_SET(0x410, 7)>;
	};

	/omit-if-no-ref/ pin_tach0: pin_tach0 {
		ball = <R11>;
		sig_descs = <SIG_DESC_SET(0x414, 16)>;
	};
	/omit-if-no-ref/ pin_tach1: pin_tach1 {
		ball = <T12>;
		sig_descs = <SIG_DESC_SET(0x414, 17)>;
	};
	/omit-if-no-ref/ pin_tach2: pin_tach2 {
		ball = <R12>;
		sig_descs = <SIG_DESC_SET(0x414, 18)>;
	};
	/omit-if-no-ref/ pin_tach3: pin_tach3 {
		ball = <T13>;
		sig_descs = <SIG_DESC_SET(0x414, 19)>;
	};
	/omit-if-no-ref/ pin_tach4: pin_tach4 {
		ball = <P11>;
		sig_descs = <SIG_DESC_SET(0x414, 20)>;
	};
	/omit-if-no-ref/ pin_tach5: pin_tach5 {
		ball = <R13>;
		sig_descs = <SIG_DESC_SET(0x414, 21)>;
	};
	/omit-if-no-ref/ pin_tach6: pin_tach6 {
		ball = <T14>;
		sig_descs = <SIG_DESC_SET(0x414, 22)>;
	};
	/omit-if-no-ref/ pin_tach7: pin_tach7 {
		ball = <T15>;
		sig_descs = <SIG_DESC_SET(0x414, 23)>;
	};
	/omit-if-no-ref/ pin_tach8: pin_tach8 {
		ball = <R14>;
		sig_descs = <SIG_DESC_SET(0x414, 24)>;
	};
	/omit-if-no-ref/ pin_tach9: pin_tach9 {
		ball = <M12>;
		sig_descs = <SIG_DESC_SET(0x414, 25)>;
	};
	/omit-if-no-ref/ pin_tach10: pin_tach10 {
		ball = <N12>;
		sig_descs = <SIG_DESC_SET(0x414, 26)>;
	};
	/omit-if-no-ref/ pin_tach11: pin_tach11 {
		ball = <P14>;
		sig_descs = <SIG_DESC_SET(0x414, 27)>;
	};
	/omit-if-no-ref/ pin_tach12: pin_tach12 {
		ball = <T1>;
		sig_descs = <SIG_DESC_SET(0x410, 8)>;
	};
	/omit-if-no-ref/ pin_tach13: pin_tach13 {
		ball = <R3>;
		sig_descs = <SIG_DESC_SET(0x410, 9)>;
	};
	/omit-if-no-ref/ pin_tach14: pin_tach14 {
		ball = <T2>;
		sig_descs = <SIG_DESC_SET(0x410, 10)>;
	};
	/omit-if-no-ref/ pin_tach15: pin_tach15 {
		ball = <T3>;
		sig_descs = <SIG_DESC_SET(0x410, 11)>;
	};

	/omit-if-no-ref/ pin_mtrstn1: pin_mtrstn1 {
		ball = <A12>;
		sig_descs = <SIG_DESC_CLR(0x41C, 25) SIG_DESC_SET(0x4BC, 25)>;
	};
	/omit-if-no-ref/ pin_mtck1: pin_mtck1 {
		ball = <D10>;
		sig_descs = <SIG_DESC_CLR(0x41C, 26) SIG_DESC_SET(0x4BC, 26)>;
	};
	/omit-if-no-ref/ pin_mtdi1: pin_mtdi1 {
		ball = <C10>;
		sig_descs = <SIG_DESC_CLR(0x41C, 27) SIG_DESC_SET(0x4BC, 27)>;
	};
	/omit-if-no-ref/ pin_mtdo1: pin_mtdo1 {
		ball = <A11>;
		sig_descs = <SIG_DESC_CLR(0x41C, 28) SIG_DESC_SET(0x4BC, 28)>;
	};
	/omit-if-no-ref/ pin_mtms1: pin_mtms1 {
		ball = <B11>;
		sig_descs = <SIG_DESC_CLR(0x41C, 29) SIG_DESC_SET(0x4BC, 29)>;
	};
	/omit-if-no-ref/ pin_mtrstn2: pin_mtrstn2 {
		ball = <B13>;
		sig_descs = <SIG_DESC_SET(0x41C, 20)>;
	};
	/omit-if-no-ref/ pin_mtdi2: pin_mtdi2 {
		ball = <A13>;
		sig_descs = <SIG_DESC_SET(0x41C, 21)>;
	};
	/omit-if-no-ref/ pin_mtck2: pin_mtck2 {
		ball = <D11>;
		sig_descs = <SIG_DESC_SET(0x41C, 22)>;
	};
	/omit-if-no-ref/ pin_mtms2: pin_mtms2 {
		ball = <C11>;
		sig_descs = <SIG_DESC_SET(0x41C, 23)>;
	};
	/omit-if-no-ref/ pin_mtdo2: pin_mtdo2 {
		ball = <B12>;
		sig_descs = <SIG_DESC_SET(0x41C, 24)>;
	};

	/omit-if-no-ref/ pin_i3c1scl: pin_i3c1scl {
		ball = <J16>;
		sig_descs = <SIG_DESC_SET(0x418, 16) SIG_DESC_CLR(0x4B8, 8)>;
	};
	/omit-if-no-ref/ pin_i3c1sda: pin_i3c1sda {
		ball = <J15>;
		sig_descs = <SIG_DESC_SET(0x418, 17) SIG_DESC_CLR(0x4B8, 9)>;
	};
	/omit-if-no-ref/ pin_hvi3c1scl: pin_hvi3c1scl {
		ball = <M15>;
		sig_descs = <SIG_DESC_SET(0x4B8, 8) SIG_DESC_CLR(0x418, 16) SIG_DESC_CLR(0x418, 8)>;
	};
	/omit-if-no-ref/ pin_hvi3c1sda: pin_hvi3c1sda {
		ball = <M16>;
		sig_descs = <SIG_DESC_SET(0x4B8, 9) SIG_DESC_CLR(0x418, 17) SIG_DESC_CLR(0x418, 9)>;
	};
	/omit-if-no-ref/ pin_i3c2scl: pin_i3c2scl {
		ball = <J14>;
		sig_descs = <SIG_DESC_SET(0x418, 18) SIG_DESC_CLR(0x4B8, 10)>;
	};
	/omit-if-no-ref/ pin_i3c2sda: pin_i3c2sda {
		ball = <H16>;
		sig_descs = <SIG_DESC_SET(0x418, 19) SIG_DESC_CLR(0x4B8, 11)>;
	};
	/omit-if-no-ref/ pin_hvi3c2scl: pin_hvi3c2scl {
		ball = <L14>;
		sig_descs = <SIG_DESC_SET(0x4B8, 10) SIG_DESC_CLR(0x418, 18) SIG_DESC_CLR(0x418, 10)>;
	};
	/omit-if-no-ref/ pin_hvi3c2sda: pin_hvi3c2sda {
		ball = <L15>;
		sig_descs = <SIG_DESC_SET(0x4B8, 11) SIG_DESC_CLR(0x418, 19) SIG_DESC_CLR(0x418, 11)>;
	};
	/omit-if-no-ref/ pin_i3c3scl: pin_i3c3scl {
		ball = <H15>;
		sig_descs = <SIG_DESC_SET(0x418, 20) SIG_DESC_CLR(0x4B8, 12)>;
	};
	/omit-if-no-ref/ pin_i3c3sda: pin_i3c3sda {
		ball = <G15>;
		sig_descs = <SIG_DESC_SET(0x418, 21) SIG_DESC_CLR(0x4B8, 13)>;
	};
	/omit-if-no-ref/ pin_hvi3c3scl: pin_hvi3c3scl {
		ball = <L16>;
		sig_descs = <SIG_DESC_SET(0x4B8, 12)  SIG_DESC_CLR(0x418, 20) SIG_DESC_CLR(0x418, 12)>;
	};
	/omit-if-no-ref/ pin_hvi3c3sda: pin_hvi3c3sda {
		ball = <K16>;
		sig_descs = <SIG_DESC_SET(0x4B8, 13)  SIG_DESC_CLR(0x418, 21) SIG_DESC_CLR(0x418, 13)>;
	};
	/omit-if-no-ref/ pin_i3c4scl: pin_i3c4scl {
		ball = <J13>;
		sig_descs = <SIG_DESC_SET(0x418, 22) SIG_DESC_CLR(0x4B8, 14)>;
	};
	/omit-if-no-ref/ pin_i3c4sda: pin_i3c4sda {
		ball = <G16>;
		sig_descs = <SIG_DESC_SET(0x418, 23) SIG_DESC_CLR(0x4B8, 15)>;
	};
	/omit-if-no-ref/ pin_hvi3c4scl: pin_hvi3c4scl {
		ball = <K14>;
		sig_descs = <SIG_DESC_SET(0x4B8, 14) SIG_DESC_CLR(0x418, 22) SIG_DESC_CLR(0x418, 14)>;
	};
	/omit-if-no-ref/ pin_hvi3c4sda: pin_hvi3c4sda {
		ball = <K15>;
		sig_descs = <SIG_DESC_SET(0x4B8, 15) SIG_DESC_CLR(0x418, 23) SIG_DESC_CLR(0x418, 15)>;
	};

	/omit-if-no-ref/ pin_smbf1sclin: pin_smbf1sclin {
		ball = <B12>;
		sig_descs = <SIG_DESC_CLR(0x41C, 24) SIG_DESC_CLR(0x4BC, 24) SIG_DESC_SET(0x69C, 24)>;
	};
	/omit-if-no-ref/ pin_smbf1sdain: pin_smbf1sdain {
		ball = <A10>;
		sig_descs = <SIG_DESC_CLR(0x41C, 30) SIG_DESC_CLR(0x4BC, 30) SIG_DESC_SET(0x69C, 30)>;
	};
	/omit-if-no-ref/ pin_smbf1sclout: pin_smbf1sclout {
		ball = <B10>;
		sig_descs = <SIG_DESC_CLR(0x41C, 31) SIG_DESC_CLR(0x4BC, 31) SIG_DESC_SET(0x69C, 31)>;
	};
	/omit-if-no-ref/ pin_smbf1sdaout: pin_smbf1sdaout {
		ball = <A9>;
		sig_descs = <SIG_DESC_CLR(0x430, 0) SIG_DESC_SET(0x6B0, 0)>;
	};
	/omit-if-no-ref/ pin_smbf2sclin: pin_smbf2sclin {
		ball = <B13>;
		sig_descs = <SIG_DESC_CLR(0x41C, 20) SIG_DESC_CLR(0x4BC, 20) SIG_DESC_SET(0x69C, 20)>;
	};
	/omit-if-no-ref/ pin_smbf2sdain: pin_smbf2sdain {
		ball = <A13>;
		sig_descs = <SIG_DESC_CLR(0x41C, 21) SIG_DESC_CLR(0x4BC, 21) SIG_DESC_SET(0x69C, 21)>;
	};
	/omit-if-no-ref/ pin_smbf2sclout: pin_smbf2sclout {
		ball = <D11>;
		sig_descs = <SIG_DESC_CLR(0x41C, 22) SIG_DESC_CLR(0x4BC, 22) SIG_DESC_SET(0x69C, 22)>;
	};
	/omit-if-no-ref/ pin_smbf2sdaout: pin_smbf2sdaout {
		ball = <C11>;
		sig_descs = <SIG_DESC_CLR(0x41C, 23) SIG_DESC_CLR(0x4BC, 23) SIG_DESC_SET(0x69C, 23)>;
	};
	/omit-if-no-ref/ pin_smbf3sclin: pin_smbf3sclin {
		ball = <C16>;
		sig_descs = <SIG_DESC_CLR(0x418, 28) SIG_DESC_CLR(0x4B8, 28) SIG_DESC_SET(0x698, 28)>;
	};
	/omit-if-no-ref/ pin_smbf3sdain: pin_smbf3sdain {
		ball = <C15>;
		sig_descs = <SIG_DESC_CLR(0x418, 29) SIG_DESC_CLR(0x4B8, 29) SIG_DESC_SET(0x698, 29)>;
	};
	/omit-if-no-ref/ pin_smbf3sclout: pin_smbf3sclout {
		ball = <B16>;
		sig_descs = <SIG_DESC_CLR(0x418, 30) SIG_DESC_CLR(0x4B8, 30) SIG_DESC_SET(0x698, 30)>;
	};
	/omit-if-no-ref/ pin_smbf3sdaout: pin_smbf3sdaout {
		ball = <F11>;
		sig_descs = <SIG_DESC_CLR(0x418, 31) SIG_DESC_CLR(0x4B8, 31) SIG_DESC_SET(0x698, 31)>;
	};
	/omit-if-no-ref/ pin_smbf4sclin: pin_smbf4sclin {
		ball = <B9>;
		sig_descs = <SIG_DESC_CLR(0x430, 1) SIG_DESC_SET(0x6B0, 1)>;
	};
	/omit-if-no-ref/ pin_smbf4sdain: pin_smbf4sdain {
		ball = <C9>;
		sig_descs = <SIG_DESC_CLR(0x430, 2) SIG_DESC_SET(0x6B0, 2)>;
	};
	/omit-if-no-ref/ pin_smbf4sclout: pin_smbf4sclout {
		ball = <D9>;
		sig_descs = <SIG_DESC_CLR(0x430, 3) SIG_DESC_SET(0x6B0, 3)>;
	};
	/omit-if-no-ref/ pin_smbf4sdaout: pin_smbf4sdaout {
		ball = <A8>;
		sig_descs = <SIG_DESC_CLR(0x430, 4) SIG_DESC_SET(0x6B0, 4)>;
	};

	/omit-if-no-ref/ pin_scl1: pin_scl1 {
		ball = <R15>;
		sig_descs = <SIG_DESC_SET(0x414, 28)>;
	};
	/omit-if-no-ref/ pin_sda1: pin_sda1 {
		ball = <P12>;
		sig_descs = <SIG_DESC_SET(0x414, 29)>;
	};
	/omit-if-no-ref/ pin_salt1: pin_salt1 {
		ball = <N4>;
		sig_descs = <SIG_DESC_SET(0x4B0, 0)>;
	};
	/omit-if-no-ref/ pin_scl2: pin_scl2 {
		ball = <P13>;
		sig_descs = <SIG_DESC_SET(0x414, 30)>;
	};
	/omit-if-no-ref/ pin_sda2: pin_sda2 {
		ball = <N14>;
		sig_descs = <SIG_DESC_SET(0x414, 31)>;
	};
	/omit-if-no-ref/ pin_salt2: pin_salt2 {
		ball = <P4>;
		sig_descs = <SIG_DESC_SET(0x4B0, 1)>;
	};
	/omit-if-no-ref/ pin_scl3: pin_scl3 {
		ball = <T16>;
		sig_descs = <SIG_DESC_SET(0x418, 0)>;
	};
	/omit-if-no-ref/ pin_sda3: pin_sda3 {
		ball = <R16>;
		sig_descs = <SIG_DESC_SET(0x418, 1)>;
	};
	/omit-if-no-ref/ pin_salt3: pin_salt3 {
		ball = <P1>;
		sig_descs = <SIG_DESC_SET(0x4B0, 2)>;
	};
	/omit-if-no-ref/ pin_scl4: pin_scl4 {
		ball = <P15>;
		sig_descs = <SIG_DESC_SET(0x418, 2)>;
	};
	/omit-if-no-ref/ pin_sda4: pin_sda4 {
		ball = <P16>;
		sig_descs = <SIG_DESC_SET(0x418, 3)>;
	};
	/omit-if-no-ref/ pin_salt4: pin_salt4 {
		ball = <P5>;
		sig_descs = <SIG_DESC_SET(0x4B0, 3)>;
	};
	/omit-if-no-ref/ pin_scl5: pin_scl5 {
		ball = <M13>;
		sig_descs = <SIG_DESC_SET(0x418, 4)>;
	};
	/omit-if-no-ref/ pin_sda5: pin_sda5 {
		ball = <N15>;
		sig_descs = <SIG_DESC_SET(0x418, 5)>;
	};
	/omit-if-no-ref/ pin_salt5: pin_salt5 {
		ball = <P2>;
		sig_descs = <SIG_DESC_SET(0x4B0, 4)>;
	};
	/omit-if-no-ref/ pin_scl6: pin_scl6 {
		ball = <N16>;
		sig_descs = <SIG_DESC_SET(0x418, 6)>;
	};
	/omit-if-no-ref/ pin_sda6: pin_sda6 {
		ball = <M14>;
		sig_descs = <SIG_DESC_SET(0x418, 7)>;
	};
	/omit-if-no-ref/ pin_salt6: pin_salt6 {
		ball = <P3>;
		sig_descs = <SIG_DESC_SET(0x4B0, 5)>;
	};
	/omit-if-no-ref/ pin_scl7: pin_scl7 {
		ball = <M15>;
		sig_descs = <SIG_DESC_SET(0x418, 8)>;
	};
	/omit-if-no-ref/ pin_sda7: pin_sda7 {
		ball = <M16>;
		sig_descs = <SIG_DESC_SET(0x418, 9)>;
	};
	/omit-if-no-ref/ pin_salt7: pin_salt7 {
		ball = <R1>;
		sig_descs = <SIG_DESC_SET(0x4B0, 6)>;
	};
	/omit-if-no-ref/ pin_scl8: pin_scl8 {
		ball = <L14>;
		sig_descs = <SIG_DESC_SET(0x418, 10)>;
	};
	/omit-if-no-ref/ pin_sda8: pin_sda8 {
		ball = <L15>;
		sig_descs = <SIG_DESC_SET(0x418, 11)>;
	};
	/omit-if-no-ref/ pin_salt8: pin_salt8 {
		ball = <R2>;
		sig_descs = <SIG_DESC_SET(0x4B0, 7)>;
	};
	/omit-if-no-ref/ pin_scl9: pin_scl9 {
		ball = <L16>;
		sig_descs = <SIG_DESC_SET(0x418, 12)>;
	};
	/omit-if-no-ref/ pin_sda9: pin_sda9 {
		ball = <K16>;
		sig_descs = <SIG_DESC_SET(0x418, 13)>;
	};
	/omit-if-no-ref/ pin_salt9: pin_salt9 {
		ball = <T1>;
		sig_descs = <SIG_DESC_SET(0x4B0, 8) SIG_DESC_CLR(0x410, 8)>;
	};
	/omit-if-no-ref/ pin_scl10: pin_scl10 {
		ball = <K14>;
		sig_descs = <SIG_DESC_SET(0x418, 14)>;
	};
	/omit-if-no-ref/ pin_sda10: pin_sda10 {
		ball = <K15>;
		sig_descs = <SIG_DESC_SET(0x418, 15)>;
	};
	/omit-if-no-ref/ pin_salt10: pin_salt10 {
		ball = <R3>;
		sig_descs = <SIG_DESC_SET(0x4B0, 9) SIG_DESC_CLR(0x410, 9)>;
	};
	/omit-if-no-ref/ pin_scl11: pin_scl11 {
		ball = <J16>;
		sig_descs = <SIG_DESC_CLR(0x418, 16) SIG_DESC_SET(0x4B8, 16)>;
	};
	/omit-if-no-ref/ pin_sda11: pin_sda11 {
		ball = <J15>;
		sig_descs = <SIG_DESC_CLR(0x418, 17) SIG_DESC_SET(0x4B8, 17)>;
	};
	/omit-if-no-ref/ pin_scl12: pin_scl12 {
		ball = <J14>;
		sig_descs = <SIG_DESC_CLR(0x418, 18) SIG_DESC_SET(0x4B8, 18)>;
	};
	/omit-if-no-ref/ pin_sda12: pin_sda12 {
		ball = <H16>;
		sig_descs = <SIG_DESC_CLR(0x418, 19) SIG_DESC_SET(0x4B8, 19)>;
	};
	/omit-if-no-ref/ pin_scl13: pin_scl13 {
		ball = <H15>;
		sig_descs = <SIG_DESC_CLR(0x418, 20) SIG_DESC_SET(0x4B8, 20)>;
	};
	/omit-if-no-ref/ pin_sda13: pin_sda13 {
		ball = <G15>;
		sig_descs = <SIG_DESC_CLR(0x418, 21) SIG_DESC_SET(0x4B8, 21)>;
	};
	/omit-if-no-ref/ pin_scl14: pin_scl14 {
		ball = <J13>;
		sig_descs = <SIG_DESC_CLR(0x418, 22) SIG_DESC_SET(0x4B8, 22)>;
	};
	/omit-if-no-ref/ pin_sda14: pin_sda14 {
		ball = <G16>;
		sig_descs = <SIG_DESC_CLR(0x418, 23) SIG_DESC_SET(0x4B8, 23)>;
	};

	/* GPIO Passthrough */
	/omit-if-no-ref/ pin_thruin0: pin_thruin0 {
		ball = <R5>;
		sig_descs = <SIG_DESC_SET(0x4B0, 16)>;
	};
	/omit-if-no-ref/ pin_thruout0: pin_thruout0 {
		ball = <T4>;
		sig_descs = <SIG_DESC_SET(0x4B0, 17)>;
	};
	/omit-if-no-ref/ pin_thruin1: pin_thruin1 {
		ball = <P7>;
		sig_descs = <SIG_DESC_SET(0x4B0, 18)>;
	};
	/omit-if-no-ref/ pin_thruout1: pin_thruout1 {
		ball = <N6>;
		sig_descs = <SIG_DESC_SET(0x4B0, 19)>;
	};
	/omit-if-no-ref/ pin_thruin2: pin_thruin2 {
		ball = <P8>;
		sig_descs = <SIG_DESC_SET(0x4B0, 20)>;
	};
	/omit-if-no-ref/ pin_thruout2: pin_thruout2 {
		ball = <T5>;
		sig_descs = <SIG_DESC_SET(0x4B0, 21)>;
	};
	/omit-if-no-ref/ pin_thruin3: pin_thruin3 {
		ball = <R6>;
		sig_descs = <SIG_DESC_SET(0x4B0, 22)>;
	};
	/omit-if-no-ref/ pin_thruout3: pin_thruout3 {
		ball = <T6>;
		sig_descs = <SIG_DESC_SET(0x4B0, 23)>;
	};

	/* GPIOs */
	/omit-if-no-ref/ pin_gpiol0: pin_gpiol0 {
		ball = <F12>;
		sig_descs = <SIG_DESC_CLR(0x418, 24) SIG_DESC_CLR(0x51C, 8)>;
	};
	/omit-if-no-ref/ pin_gpiol1: pin_gpiol1 {
		ball = <E12>;
		sig_descs = <SIG_DESC_CLR(0x418, 25) SIG_DESC_CLR(0x51C, 8)>;
	};
	/omit-if-no-ref/ pin_gpiom0: pin_gpiom0 {
		ball = <B15>;
		sig_descs = <SIG_DESC_CLR(0x41C, 0) SIG_DESC_CLR(0x4BC, 0)>;
	};
	/omit-if-no-ref/ pin_gpiom1: pin_gpiom1 {
		ball = <E11>;
		sig_descs = <SIG_DESC_CLR(0x41C, 1) SIG_DESC_CLR(0x4BC, 1)>;
	};
	/omit-if-no-ref/ pin_gpiom2: pin_gpiom2 {
		ball = <D14>;
		sig_descs = <SIG_DESC_CLR(0x41C, 2) SIG_DESC_CLR(0x4BC, 2)>;
	};
	/omit-if-no-ref/ pin_gpiom3: pin_gpiom3 {
		ball = <C14>;
		sig_descs = <SIG_DESC_CLR(0x41C, 3) SIG_DESC_CLR(0x4BC, 3)>;
	};
	/omit-if-no-ref/ pin_gpiom4: pin_gpiom4 {
		ball = <A16>;
		sig_descs = <SIG_DESC_CLR(0x41C, 4) SIG_DESC_CLR(0x4BC, 4)>;
	};
	/omit-if-no-ref/ pin_gpiom5: pin_gpiom5 {
		ball = <A15>;
		sig_descs = <SIG_DESC_CLR(0x41C, 5) SIG_DESC_CLR(0x4BC, 5)>;
	};

	/omit-if-no-ref/ pin_gpion4: pin_gpion4 {
		ball = <G14>;
		sig_descs = <SIG_DESC_CLR(0x41C, 12)>;
	};
	/omit-if-no-ref/ pin_gpion5: pin_gpion5 {
		ball = <F16>;
		sig_descs = <SIG_DESC_CLR(0x41C, 13)>;
	};
	/omit-if-no-ref/ pin_gpion6: pin_gpion6 {
		ball = <F15>;
		sig_descs = <SIG_DESC_CLR(0x41C, 14)>;
	};
	/omit-if-no-ref/ pin_gpion7: pin_gpion7 {
		ball = <F14>;
		sig_descs = <SIG_DESC_CLR(0x41C, 15)>;
	};
	/omit-if-no-ref/ pin_gpioo0: pin_gpioo0 {
		ball = <E16>;
		sig_descs = <SIG_DESC_CLR(0x41C, 16)>;
	};
	/omit-if-no-ref/ pin_gpioo1: pin_gpioo1 {
		ball = <E15>;
		sig_descs = <SIG_DESC_CLR(0x41C, 17)>;
	};
	/omit-if-no-ref/ pin_gpioo2: pin_gpioo2 {
		ball = <E14>;
		sig_descs = <SIG_DESC_CLR(0x41C, 18)>;
	};
	/omit-if-no-ref/ pin_gpioo3: pin_gpioo3 {
		ball = <E13>;
		sig_descs = <SIG_DESC_CLR(0x41C, 19)>;
	};
	/omit-if-no-ref/ pin_gpit0: pin_gpit0 {
		ball = <B2>;
		sig_descs = <SIG_DESC_SET(0x430, 24)>;
	};
	/omit-if-no-ref/ pin_gpit1: pin_gpit1 {
		ball = <B1>;
		sig_descs = <SIG_DESC_SET(0x430, 25)>;
	};
	/omit-if-no-ref/ pin_gpit2: pin_gpit2 {
		ball = <C1>;
		sig_descs = <SIG_DESC_SET(0x430, 26)>;
	};
	/omit-if-no-ref/ pin_gpit3: pin_gpit3 {
		ball = <D3>;
		sig_descs = <SIG_DESC_SET(0x430, 27)>;
	};
	/omit-if-no-ref/ pin_gpit4: pin_gpit4 {
		ball = <C2>;
		sig_descs = <SIG_DESC_SET(0x430, 28)>;
	};
	/omit-if-no-ref/ pin_gpit5: pin_gpit5 {
		ball = <D1>;
		sig_descs = <SIG_DESC_SET(0x430, 29)>;
	};
	/omit-if-no-ref/ pin_gpit6: pin_gpit6 {
		ball = <D2>;
		sig_descs = <SIG_DESC_SET(0x430, 30)>;
	};
	/omit-if-no-ref/ pin_gpit7: pin_gpit7 {
		ball = <E3>;
		sig_descs = <SIG_DESC_SET(0x430, 31)>;
	};
	/omit-if-no-ref/ pin_gpiu0: pin_gpiu0 {
		ball = <K2>;
		sig_descs = <SIG_DESC_SET(0x434, 0)>;
	};
	/omit-if-no-ref/ pin_gpiu1: pin_gpiu1 {
		ball = <K4>;
		sig_descs = <SIG_DESC_SET(0x434, 1)>;
	};
	/omit-if-no-ref/ pin_gpiu2: pin_gpiu2 {
		ball = <K3>;
		sig_descs = <SIG_DESC_SET(0x434, 2)>;
	};
	/omit-if-no-ref/ pin_gpiu3: pin_gpiu3 {
		ball = <J1>;
		sig_descs = <SIG_DESC_SET(0x434, 3)>;
	};
	/omit-if-no-ref/ pin_gpiu4: pin_gpiu4 {
		ball = <J2>;
		sig_descs = <SIG_DESC_SET(0x434, 4)>;
	};
	/omit-if-no-ref/ pin_gpiu5: pin_gpiu5 {
		ball = <J4>;
		sig_descs = <SIG_DESC_SET(0x434, 5)>;
	};
	/omit-if-no-ref/ pin_gpiu6: pin_gpiu6 {
		ball = <H1>;
		sig_descs = <SIG_DESC_SET(0x434, 6)>;
	};
	/omit-if-no-ref/ pin_gpiu7: pin_gpiu7 {
		ball = <H2>;
		sig_descs = <SIG_DESC_SET(0x434, 7)>;
	};

	/omit-if-no-ref/ pin_sgpmclk: pin_sgpmclk {
		ball = <B14>;
		sig_descs = <SIG_DESC_SET(0x41C, 8)>;
	};
	/omit-if-no-ref/ pin_sgpmld: pin_sgpmld {
		ball = <C13>;
		sig_descs = <SIG_DESC_SET(0x41C, 9)>;
	};
	/omit-if-no-ref/ pin_sgpmo: pin_sgpmo {
		 ball = <D12>;
		sig_descs = <SIG_DESC_SET(0x41C, 10)>;
	};
	/omit-if-no-ref/ pin_sgpmi: pin_sgpmi {
		 ball = <C12>;
		sig_descs = <SIG_DESC_SET(0x41C, 11)>;
	};

	/omit-if-no-ref/ pin_fwspidq2: pin_fwspidq2 {
		ball = <D8>;
		sig_descs = <SIG_DESC_SET(0x430, 10)>;
	};
	/omit-if-no-ref/ pin_fwspidq3: pin_fwspidq3 {
		ball = <D5>;
		sig_descs = <SIG_DESC_SET(0x430, 11)>;
	};
	/omit-if-no-ref/ pin_spi1dq2: pin_spi1dq2 {
		ball = <A4>;
		sig_descs = <SIG_DESC_SET(0x430, 17)>;
	};
	/omit-if-no-ref/ pin_spi1dq3: pin_spi1dq3 {
		ball = <B4>;
		sig_descs = <SIG_DESC_SET(0x430, 18)>;
	};
	/omit-if-no-ref/ pin_spi2cs0: pin_spi2cs0 {
		ball = <A10>;
		sig_descs = <SIG_DESC_SET(0x41C, 30)>;
	};
	/omit-if-no-ref/ pin_spi2cs1: pin_spi2cs1 {
		ball = <B10>;
		sig_descs = <SIG_DESC_SET(0x41C, 31)>;
	};
	/omit-if-no-ref/ pin_spi2ck: pin_spi2ck {
		ball = <A9>;
		sig_descs = <SIG_DESC_SET(0x430, 0)>;
	};
	/omit-if-no-ref/ pin_spi2dq0: pin_spi2dq0 {
		ball = <B9>;
		sig_descs = <SIG_DESC_SET(0x430, 1)>;
	};
	/omit-if-no-ref/ pin_spi2dq1: pin_spi2dq1 {
		ball = <C9>;
		sig_descs = <SIG_DESC_SET(0x430, 2)>;
	};
	/omit-if-no-ref/ pin_spi2dq2: pin_spi2dq2 {
		ball = <D9>;
		sig_descs = <SIG_DESC_SET(0x430, 3)>;
	};
	/omit-if-no-ref/ pin_spi2dq3: pin_spi2dq3 {
		ball = <A8>;
		sig_descs = <SIG_DESC_SET(0x430, 4)>;
	};

	/omit-if-no-ref/ pin_spim1csin: pin_spim1csin {
		ball = <N4>;
		sig_descs = <SIG_DESC_CLR(0x410, 0) SIG_DESC_CLR(0x4B0, 0) SIG_DESC_SET(0x690, 0)>;
	};
	/omit-if-no-ref/ pin_spim1clkin: pin_spim1clkin {
		ball = <P4>;
		sig_descs = <SIG_DESC_CLR(0x410, 1) SIG_DESC_CLR(0x4B0, 1) SIG_DESC_SET(0x690, 1)>;
	};
	/omit-if-no-ref/ pin_spim1mosiin: pin_spim1mosiin {
		ball = <P1>;
		sig_descs = <SIG_DESC_CLR(0x410, 2) SIG_DESC_CLR(0x4B0, 2) SIG_DESC_SET(0x690, 2)>;
	};
	/omit-if-no-ref/ pin_spim1misoin: pin_spim1misoin {
		ball = <P5>;
		sig_descs = <SIG_DESC_CLR(0x410, 3) SIG_DESC_CLR(0x4B0, 3) SIG_DESC_SET(0x690, 3)>;
	};
	/omit-if-no-ref/ pin_spim1io2in: pin_spim1io2in {
		ball = <P2>;
		sig_descs = <SIG_DESC_CLR(0x410, 4) SIG_DESC_CLR(0x4B0, 4) SIG_DESC_SET(0x690, 4)>;
	};
	/omit-if-no-ref/ pin_spim1io3in: pin_spim1io3in {
		ball = <P3>;
		sig_descs = <SIG_DESC_CLR(0x410, 5) SIG_DESC_CLR(0x4B0, 5) SIG_DESC_SET(0x690, 5)>;
	};
	/omit-if-no-ref/ pin_spim1csout: pin_spim1csout {
		ball = <R1>;
		sig_descs = <SIG_DESC_CLR(0x410, 6) SIG_DESC_CLR(0x4B0, 6) SIG_DESC_SET(0x690, 6)>;
	};
	/omit-if-no-ref/ pin_spim1clkout: pin_spim1clkout {
		ball = <R2>;
		sig_descs = <SIG_DESC_CLR(0x410, 7) SIG_DESC_CLR(0x4B0, 7) SIG_DESC_SET(0x690, 7)>;
	};
	/omit-if-no-ref/ pin_spim1mosiout: pin_spim1mosiout {
		ball = <T1>;
		sig_descs = <SIG_DESC_CLR(0x410, 8) SIG_DESC_CLR(0x4B0, 8) SIG_DESC_SET(0x690, 8)>;
	};
	/omit-if-no-ref/ pin_spim1misoout: pin_spim1misoout {
		ball = <R3>;
		sig_descs = <SIG_DESC_CLR(0x410, 9) SIG_DESC_CLR(0x4B0, 9) SIG_DESC_SET(0x690, 9)>;
	};
	/omit-if-no-ref/ pin_spim1io2out: pin_spim1io2out {
		ball = <T2>;
		sig_descs = <SIG_DESC_CLR(0x410, 10) SIG_DESC_CLR(0x4B0, 10) SIG_DESC_SET(0x690, 10)>;
	};
	/omit-if-no-ref/ pin_spim1io3out: pin_spim1io3out {
		ball = <T3>;
		sig_descs = <SIG_DESC_CLR(0x410, 11) SIG_DESC_CLR(0x4B0, 11) SIG_DESC_SET(0x690, 11)>;
	};
	/omit-if-no-ref/ pin_spim1muxsel: pin_spim1muxsel {
		ball = <N5>;
		sig_descs = <SIG_DESC_CLR(0x410, 12) SIG_DESC_CLR(0x4B0, 12) SIG_DESC_SET(0x690, 12)>;
	};
	/omit-if-no-ref/ pin_spim1spirstout: pin_spim1spirstout {
		ball = <P6>;
		sig_descs = <SIG_DESC_CLR(0x410, 13) SIG_DESC_CLR(0x4B0, 13) SIG_DESC_SET(0x690, 13)>;
	};
	/omit-if-no-ref/ pin_spim1spirstin: pin_spim1spirstin {
		ball = <R14>;
		sig_descs = <SIG_DESC_CLR(0x414, 24) SIG_DESC_CLR(0x4B4, 24) SIG_DESC_SET(0x694, 24)>;
	};
	/omit-if-no-ref/ pin_spim2csin: pin_spim2csin {
		ball = <M5>;
		sig_descs = <SIG_DESC_CLR(0x410, 14) SIG_DESC_CLR(0x4B0, 14) SIG_DESC_SET(0x690, 14)>;
	};
	/omit-if-no-ref/ pin_spim2clkin: pin_spim2clkin {
		ball = <R4>;
		sig_descs = <SIG_DESC_CLR(0x410, 15) SIG_DESC_CLR(0x4B0, 15) SIG_DESC_SET(0x690, 15)>;
	};
	/omit-if-no-ref/ pin_spim2mosiin: pin_spim2mosiin {
		ball = <R5>;
		sig_descs = <SIG_DESC_CLR(0x410, 16) SIG_DESC_CLR(0x4B0, 16) SIG_DESC_SET(0x690, 16)>;
	};
	/omit-if-no-ref/ pin_spim2misoin: pin_spim2misoin {
		ball = <T4>;
		sig_descs = <SIG_DESC_CLR(0x410, 17) SIG_DESC_CLR(0x4B0, 17) SIG_DESC_SET(0x690, 17)>;
	};
	/omit-if-no-ref/ pin_spim2io2in: pin_spim2io2in {
		ball = <P7>;
		sig_descs = <SIG_DESC_CLR(0x410, 18) SIG_DESC_CLR(0x4B0, 18) SIG_DESC_SET(0x690, 18)>;
	};
	/omit-if-no-ref/ pin_spim2io3in: pin_spim2io3in {
		ball = <N6>;
		sig_descs = <SIG_DESC_CLR(0x410, 19) SIG_DESC_CLR(0x4B0, 19) SIG_DESC_SET(0x690, 19)>;
	};
	/omit-if-no-ref/ pin_spim2csout: pin_spim2csout {
		ball = <P8>;
		sig_descs = <SIG_DESC_CLR(0x410, 20) SIG_DESC_CLR(0x4B0, 20) SIG_DESC_SET(0x690, 20)>;
	};
	/omit-if-no-ref/ pin_spim2clkout: pin_spim2clkout {
		ball = <T5>;
		sig_descs = <SIG_DESC_CLR(0x410, 21) SIG_DESC_CLR(0x4B0, 21) SIG_DESC_SET(0x690, 21)>;
	};
	/omit-if-no-ref/ pin_spim2mosiout: pin_spim2mosiout {
		ball = <R6>;
		sig_descs = <SIG_DESC_CLR(0x410, 22) SIG_DESC_CLR(0x4B0, 22) SIG_DESC_SET(0x690, 22)>;
	};
	/omit-if-no-ref/ pin_spim2misoout: pin_spim2misoout {
		ball = <T6>;
		sig_descs = <SIG_DESC_CLR(0x410, 23) SIG_DESC_CLR(0x4B0, 23) SIG_DESC_SET(0x690, 23)>;
	};
	/omit-if-no-ref/ pin_spim2io2out: pin_spim2io2out {
		ball = <R7>;
		sig_descs = <SIG_DESC_CLR(0x410, 24) SIG_DESC_CLR(0x4B0, 24) SIG_DESC_SET(0x690, 24)>;
	};
	/omit-if-no-ref/ pin_spim2io3out: pin_spim2io3out {
		ball = <T7>;
		sig_descs = <SIG_DESC_CLR(0x410, 25) SIG_DESC_CLR(0x4B0, 25) SIG_DESC_SET(0x690, 25)>;
	};
	/omit-if-no-ref/ pin_spim2muxsel: pin_spim2muxsel {
		ball = <R8>;
		sig_descs = <SIG_DESC_CLR(0x410, 26) SIG_DESC_CLR(0x4B0, 26) SIG_DESC_SET(0x690, 26)>;
	};
	/omit-if-no-ref/ pin_spim2spirstout: pin_spim2spirstout {
		ball = <T8>;
		sig_descs = <SIG_DESC_CLR(0x410, 27) SIG_DESC_CLR(0x4B0, 27) SIG_DESC_SET(0x690, 27)>;
	};
	/omit-if-no-ref/ pin_spim2spirstin: pin_spim2spirstin {
		ball = <C13>;
		sig_descs = <SIG_DESC_CLR(0x41C, 9) SIG_DESC_CLR(0x4BC, 9) SIG_DESC_SET(0x69C, 9)>;
	};
	/omit-if-no-ref/ pin_spim3csin: pin_spim3csin {
		ball = <K1>;
		sig_descs = <SIG_DESC_CLR(0x410, 28) SIG_DESC_CLR(0x4B0, 28) SIG_DESC_SET(0x690, 28)>;
	};
	/omit-if-no-ref/ pin_spim3clkin: pin_spim3clkin {
		ball = <L3>;
		sig_descs = <SIG_DESC_CLR(0x410, 29) SIG_DESC_CLR(0x4B0, 29) SIG_DESC_SET(0x690, 29)>;
	};
	/omit-if-no-ref/ pin_spim3mosiin: pin_spim3mosiin {
		ball = <L4>;
		sig_descs = <SIG_DESC_CLR(0x410, 30) SIG_DESC_CLR(0x4B0, 30) SIG_DESC_SET(0x690, 30)>;
	};
	/omit-if-no-ref/ pin_spim3misoin: pin_spim3misoin {
		ball = <M4>;
		sig_descs = <SIG_DESC_CLR(0x410, 31) SIG_DESC_CLR(0x4B0, 31) SIG_DESC_SET(0x690, 31)>;
	};
	/omit-if-no-ref/ pin_spim3io2in: pin_spim3io2in {
		ball = <L2>;
		sig_descs = <SIG_DESC_CLR(0x414, 0) SIG_DESC_CLR(0x4B4, 0) SIG_DESC_SET(0x694, 0)>;
	};
	/omit-if-no-ref/ pin_spim3io3in: pin_spim3io3in {
		ball = <L1>;
		sig_descs = <SIG_DESC_CLR(0x414, 1) SIG_DESC_CLR(0x4B4, 1) SIG_DESC_SET(0x694, 1)>;
	};
	/omit-if-no-ref/ pin_spim3csout: pin_spim3csout {
		ball = <M3>;
		sig_descs = <SIG_DESC_CLR(0x414, 2) SIG_DESC_CLR(0x4B4, 2) SIG_DESC_SET(0x694, 2)>;
	};
	/omit-if-no-ref/ pin_spim3clkout: pin_spim3clkout {
		ball = <M2>;
		sig_descs = <SIG_DESC_CLR(0x414, 3) SIG_DESC_CLR(0x4B4, 3) SIG_DESC_SET(0x694, 3)>;
	};
	/omit-if-no-ref/ pin_spim3mosiout: pin_spim3mosiout {
		ball = <M1>;
		sig_descs = <SIG_DESC_CLR(0x414, 4) SIG_DESC_CLR(0x4B4, 4) SIG_DESC_SET(0x694, 4)>;
	};
	/omit-if-no-ref/ pin_spim3misoout: pin_spim3misoout {
		ball = <N3>;
		sig_descs = <SIG_DESC_CLR(0x414, 5) SIG_DESC_CLR(0x4B4, 5) SIG_DESC_SET(0x694, 5)>;
	};
	/omit-if-no-ref/ pin_spim3io2out: pin_spim3io2out {
		ball = <N2>;
		sig_descs = <SIG_DESC_CLR(0x414, 6) SIG_DESC_CLR(0x4B4, 6) SIG_DESC_SET(0x694, 6)>;
	};
	/omit-if-no-ref/ pin_spim3io3out: pin_spim3io3out {
		ball = <N1>;
		sig_descs = <SIG_DESC_CLR(0x414, 7) SIG_DESC_CLR(0x4B4, 7) SIG_DESC_SET(0x694, 7)>;
	};
	/omit-if-no-ref/ pin_spim3muxsel: pin_spim3muxsel {
		ball = <T9>;
		sig_descs = <SIG_DESC_CLR(0x414, 8) SIG_DESC_CLR(0x4B4, 8) SIG_DESC_SET(0x694, 8)>;
	};
	/omit-if-no-ref/ pin_spim3spirstout: pin_spim3spirstout {
		ball = <P9>;
		sig_descs = <SIG_DESC_CLR(0x414, 9) SIG_DESC_CLR(0x4B4, 9) SIG_DESC_SET(0x694, 9)>;
	};
	/omit-if-no-ref/ pin_spim3spirstin: pin_spim3spirstin {
		ball = <M12>;
		sig_descs = <SIG_DESC_CLR(0x414, 25) SIG_DESC_CLR(0x4B4, 25) SIG_DESC_SET(0x694, 25)>;
	};
	/omit-if-no-ref/ pin_spim4csin: pin_spim4csin {
		ball = <R9>;
		sig_descs = <SIG_DESC_CLR(0x414, 10) SIG_DESC_CLR(0x4B4, 10) SIG_DESC_SET(0x694, 10)>;
	};
	/omit-if-no-ref/ pin_spim4clkin: pin_spim4clkin {
		ball = <T10>;
		sig_descs = <SIG_DESC_CLR(0x414, 11) SIG_DESC_CLR(0x4B4, 11) SIG_DESC_SET(0x694, 11)>;
	};
	/omit-if-no-ref/ pin_spim4mosiin: pin_spim4mosiin {
		ball = <R10>;
		sig_descs = <SIG_DESC_CLR(0x414, 12) SIG_DESC_CLR(0x4B4, 12) SIG_DESC_SET(0x694, 12)>;
	};
	/omit-if-no-ref/ pin_spim4misoin: pin_spim4misoin {
		ball = <P10>;
		sig_descs = <SIG_DESC_CLR(0x414, 13) SIG_DESC_CLR(0x4B4, 13) SIG_DESC_SET(0x694, 13)>;
	};
	/omit-if-no-ref/ pin_spim4io2in: pin_spim4io2in {
		ball = <T11>;
		sig_descs = <SIG_DESC_CLR(0x414, 14) SIG_DESC_CLR(0x4B4, 14) SIG_DESC_SET(0x694, 14)>;
	};
	/omit-if-no-ref/ pin_spim4io3in: pin_spim4io3in {
		ball = <N11>;
		sig_descs = <SIG_DESC_CLR(0x414, 15) SIG_DESC_CLR(0x4B4, 15) SIG_DESC_SET(0x694, 15)>;
	};
	/omit-if-no-ref/ pin_spim4csout: pin_spim4csout {
		ball = <R11>;
		sig_descs = <SIG_DESC_CLR(0x414, 16) SIG_DESC_CLR(0x4B4, 16) SIG_DESC_SET(0x694, 16)>;
	};
	/omit-if-no-ref/ pin_spim4clkout: pin_spim4clkout {
		ball = <T12>;
		sig_descs = <SIG_DESC_CLR(0x414, 17) SIG_DESC_CLR(0x4B4, 17) SIG_DESC_SET(0x694, 17)>;
	};
	/omit-if-no-ref/ pin_spim4mosiout: pin_spim4mosiout {
		ball = <R12>;
		sig_descs = <SIG_DESC_CLR(0x414, 18) SIG_DESC_CLR(0x4B4, 18) SIG_DESC_SET(0x694, 18)>;
	};
	/omit-if-no-ref/ pin_spim4misoout: pin_spim4misoout {
		ball = <T13>;
		sig_descs = <SIG_DESC_CLR(0x414, 19) SIG_DESC_CLR(0x4B4, 19) SIG_DESC_SET(0x694, 19)>;
	};
	/omit-if-no-ref/ pin_spim4io2out: pin_spim4io2out {
		ball = <P11>;
		sig_descs = <SIG_DESC_CLR(0x414, 20) SIG_DESC_CLR(0x4B4, 20) SIG_DESC_SET(0x694, 20)>;
	};
	/omit-if-no-ref/ pin_spim4io3out: pin_spim4io3out {
		ball = <R13>;
		sig_descs = <SIG_DESC_CLR(0x414, 21) SIG_DESC_CLR(0x4B4, 21) SIG_DESC_SET(0x694, 21)>;
	};
	/omit-if-no-ref/ pin_spim4muxsel: pin_spim4muxsel {
		ball = <T14>;
		sig_descs = <SIG_DESC_CLR(0x414, 22) SIG_DESC_CLR(0x4B4, 22) SIG_DESC_SET(0x694, 22)>;
	};
	/omit-if-no-ref/ pin_spim4spirstout: pin_spim4spirstout {
		ball = <T15>;
		sig_descs = <SIG_DESC_CLR(0x414, 23) SIG_DESC_CLR(0x4B4, 23) SIG_DESC_SET(0x694, 23)>;
	};
	/omit-if-no-ref/ pin_spim4spirstin: pin_spim4spirstin {
		ball = <C12>;
		sig_descs = <SIG_DESC_CLR(0x41C, 11) SIG_DESC_CLR(0x4BC, 11) SIG_DESC_SET(0x69C, 11)>;
	};

	/omit-if-no-ref/ pin_txd1: pin_txd1 {
		ball = <F12>;
		sig_descs = <SIG_DESC_SET(0x418, 24)>;
	};
	/omit-if-no-ref/ pin_rxd1: pin_rxd1 {
		ball = <E12>;
		sig_descs = <SIG_DESC_SET(0x418, 25)>;
	};
	/omit-if-no-ref/ pin_txd2: pin_txd2 {
		ball = <D15>;
		sig_descs = <SIG_DESC_SET(0x418, 26)>;
	};
	/omit-if-no-ref/ pin_rxd2: pin_rxd2 {
		ball = <D16>;
		sig_descs = <SIG_DESC_SET(0x418, 27)>;
	};
	/omit-if-no-ref/ pin_txd3: pin_txd3 {
		ball = <C16>;
		sig_descs = <SIG_DESC_SET(0x418, 28)>;
	};
	/omit-if-no-ref/ pin_rxd3: pin_rxd3 {
		ball = <C15>;
		sig_descs = <SIG_DESC_SET(0x418, 29)>;
	};
	/omit-if-no-ref/ pin_txd4: pin_txd4 {
		ball = <B16>;
		sig_descs = <SIG_DESC_SET(0x418, 30)>;
	};
	/omit-if-no-ref/ pin_rxd4: pin_rxd4 {
		ball = <F11>;
		sig_descs = <SIG_DESC_SET(0x418, 31)>;
	};
	/omit-if-no-ref/ pin_txd6: pin_txd6 {
		ball = <B15>;
		sig_descs = <SIG_DESC_SET(0x41C, 0)>;
	};
	/omit-if-no-ref/ pin_rxd6: pin_rxd6 {
		ball = <E11>;
		sig_descs = <SIG_DESC_SET(0x41C, 1)>;
	};
	/omit-if-no-ref/ pin_txd7: pin_txd7 {
		ball = <D14>;
		sig_descs = <SIG_DESC_SET(0x41C, 2)>;
	};
	/omit-if-no-ref/ pin_rxd7: pin_rxd7 {
		ball = <C14>;
		sig_descs = <SIG_DESC_SET(0x41C, 3)>;
	};
	/omit-if-no-ref/ pin_txd8: pin_txd8 {
		ball = <A16>;
		sig_descs = <SIG_DESC_SET(0x41C, 4)>;
	};
	/omit-if-no-ref/ pin_rxd8: pin_rxd8 {
		ball = <A15>;
		sig_descs = <SIG_DESC_SET(0x41C, 5)>;
	};
	/omit-if-no-ref/ pin_txd9: pin_txd9 {
		ball = <N5>;
		sig_descs = <SIG_DESC_SET(0x410, 12)>;
	};
	/omit-if-no-ref/ pin_rxd9: pin_rxd9 {
		ball = <P6>;
		sig_descs = <SIG_DESC_SET(0x410, 13)>;
	};
	/omit-if-no-ref/ pin_txd10: pin_txd10 {
		ball = <M5>;
		sig_descs = <SIG_DESC_SET(0x410, 14)>;
	};
	/omit-if-no-ref/ pin_rxd10: pin_rxd10 {
		ball = <R4>;
		sig_descs = <SIG_DESC_SET(0x410, 15)>;
	};
	/omit-if-no-ref/ pin_txd11: pin_txd11 {
		ball = <R5>;
		sig_descs = <SIG_DESC_SET(0x410, 16)>;
	};
	/omit-if-no-ref/ pin_rxd11: pin_rxd11 {
		ball = <T4>;
		sig_descs = <SIG_DESC_SET(0x410, 17)>;
	};
	/omit-if-no-ref/ pin_txd12: pin_txd12 {
		ball = <P7>;
		sig_descs = <SIG_DESC_SET(0x410, 18)>;
	};
	/omit-if-no-ref/ pin_rxd12: pin_rxd12 {
		ball = <N6>;
		sig_descs = <SIG_DESC_SET(0x410, 19)>;
	};
	/omit-if-no-ref/ pin_txd13: pin_txd13 {
		ball = <P8>;
		sig_descs = <SIG_DESC_SET(0x410, 20)>;
	};
	/omit-if-no-ref/ pin_rxd13: pin_rxd13 {
		ball = <T5>;
		sig_descs = <SIG_DESC_SET(0x410, 21)>;
	};
};

&pinctrl {
	/omit-if-no-ref/ pinctrl_adc0_default: adc0_default {
		group0 {
			pinmux = <&pin_adc0>;
		};
	};
	/omit-if-no-ref/ pinctrl_adc1_default: adc1_default {
		group0 {
			pinmux = <&pin_adc1>;
		};
	};
	/omit-if-no-ref/ pinctrl_adc2_default: adc2_default {
		group0 {
			pinmux = <&pin_adc2>;
		};
	};
	/omit-if-no-ref/ pinctrl_adc3_default: adc3_default {
		group0 {
			pinmux = <&pin_adc3>;
		};
	};
	/omit-if-no-ref/ pinctrl_adc4_default: adc4_default {
		group0 {
			pinmux = <&pin_adc4>;
		};
	};
	/omit-if-no-ref/ pinctrl_adc5_default: adc5_default {
		group0 {
			pinmux = <&pin_adc5>;
		};
	};
	/omit-if-no-ref/ pinctrl_adc6_default: adc6_default {
		group0 {
			pinmux = <&pin_adc6>;
		};
	};
	/omit-if-no-ref/ pinctrl_adc7_default: adc7_default {
		group0 {
			pinmux = <&pin_adc7>;
		};
	};
	/omit-if-no-ref/ pinctrl_adc8_default: adc8_default {
		group0 {
			pinmux = <&pin_adc8>;
		};
	};
	/omit-if-no-ref/ pinctrl_adc9_default: adc9_default {
		group0 {
			pinmux = <&pin_adc9>;
		};
	};
	/omit-if-no-ref/ pinctrl_adc10_default: adc10_default {
		group0 {
			pinmux = <&pin_adc10>;
		};
	};
	/omit-if-no-ref/ pinctrl_adc11_default: adc11_default {
		group0 {
			pinmux = <&pin_adc11>;
		};
	};
	/omit-if-no-ref/ pinctrl_adc12_default: adc12_default {
		group0 {
			pinmux = <&pin_adc12>;
		};
	};
	/omit-if-no-ref/ pinctrl_adc13_default: adc13_default {
		group0 {
			pinmux = <&pin_adc13>;
		};
	};
	/omit-if-no-ref/ pinctrl_adc14_default: adc14_default {
		group0 {
			pinmux = <&pin_adc14>;
		};
	};
	/omit-if-no-ref/ pinctrl_adc15_default: adc15_default {
		group0 {
			pinmux = <&pin_adc15>;
		};
	};
	/omit-if-no-ref/ pinctrl_pwm0_default: pwm0_default {
		group0 {
			pinmux = <&pin_pwm0>;
		};
	};
	/omit-if-no-ref/ pinctrl_pwm1_default: pwm1_default {
		group0 {
			pinmux = <&pin_pwm1>;
		};
	};
	/omit-if-no-ref/ pinctrl_pwm2_default: pwm2_default {
		group0 {
			pinmux = <&pin_pwm2>;
		};
	};
	/omit-if-no-ref/ pinctrl_pwm3_default: pwm3_default {
		group0 {
			pinmux = <&pin_pwm3>;
		};
	};
	/omit-if-no-ref/ pinctrl_pwm4_default: pwm4_default {
		group0 {
			pinmux = <&pin_pwm4>;
		};
	};
	/omit-if-no-ref/ pinctrl_pwm5_default: pwm5_default {
		group0 {
			pinmux = <&pin_pwm5>;
		};
	};
	/omit-if-no-ref/ pinctrl_pwm6_default: pwm6_default {
		group0 {
			pinmux = <&pin_pwm6>;
		};
	};
	/omit-if-no-ref/ pinctrl_pwm7_default: pwm7_default {
		group0 {
			pinmux = <&pin_pwm7>;
		};
	};
	/omit-if-no-ref/ pinctrl_pwm8_default: pwm8_default {
		group0 {
			pinmux = <&pin_pwm8>;
		};
	};
	/omit-if-no-ref/ pinctrl_pwm9_default: pwm9_default {
		group0 {
			pinmux = <&pin_pwm9>;
		};
	};
	/omit-if-no-ref/ pinctrl_pwm10_default: pwm10_default {
		group0 {
			pinmux = <&pin_pwm10>;
		};
	};
	/omit-if-no-ref/ pinctrl_pwm11_default: pwm11_default {
		group0 {
			pinmux = <&pin_pwm11>;
		};
	};
	/omit-if-no-ref/ pinctrl_pwm12_default: pwm12_default {
		group0 {
			pinmux = <&pin_pwm12>;
		};
	};
	/omit-if-no-ref/ pinctrl_pwm13_default: pwm13_default {
		group0 {
			pinmux = <&pin_pwm13>;
		};
	};
	/omit-if-no-ref/ pinctrl_pwm14_default: pwm14_default {
		group0 {
			pinmux = <&pin_pwm14>;
		};
	};
	/omit-if-no-ref/ pinctrl_pwm15_default: pwm15_default {
		group0 {
			pinmux = <&pin_pwm15>;
		};
	};
	/omit-if-no-ref/ pinctrl_tach0_default: tach0_default {
		group0 {
			pinmux = <&pin_tach0>;
		};
	};
	/omit-if-no-ref/ pinctrl_tach1_default: tach1_default {
		group0 {
			pinmux = <&pin_tach1>;
		};
	};
	/omit-if-no-ref/ pinctrl_tach2_default: tach2_default {
		group0 {
			pinmux = <&pin_tach2>;
		};
	};
	/omit-if-no-ref/ pinctrl_tach3_default: tach3_default {
		group0 {
			pinmux = <&pin_tach3>;
		};
	};
	/omit-if-no-ref/ pinctrl_tach4_default: tach4_default {
		group0 {
			pinmux = <&pin_tach4>;
		};
	};
	/omit-if-no-ref/ pinctrl_tach5_default: tach5_default {
		group0 {
			pinmux = <&pin_tach5>;
		};
	};
	/omit-if-no-ref/ pinctrl_tach6_default: tach6_default {
		group0 {
			pinmux = <&pin_tach6>;
		};
	};
	/omit-if-no-ref/ pinctrl_tach7_default: tach7_default {
		group0 {
			pinmux = <&pin_tach7>;
		};
	};
	/omit-if-no-ref/ pinctrl_tach8_default: tach8_default {
		group0 {
			pinmux = <&pin_tach8>;
		};
	};
	/omit-if-no-ref/ pinctrl_tach9_default: tach9_default {
		group0 {
			pinmux = <&pin_tach9>;
		};
	};
	/omit-if-no-ref/ pinctrl_tach10_default: tach10_default {
		group0 {
			pinmux = <&pin_tach10>;
		};
	};
	/omit-if-no-ref/ pinctrl_tach11_default: tach11_default {
		group0 {
			pinmux = <&pin_tach11>;
		};
	};
	/omit-if-no-ref/ pinctrl_tach12_default: tach12_default {
		group0 {
			pinmux = <&pin_tach12>;
		};
	};
	/omit-if-no-ref/ pinctrl_tach13_default: tach13_default {
		group0 {
			pinmux = <&pin_tach13>;
		};
	};
	/omit-if-no-ref/ pinctrl_tach14_default: tach14_default {
		group0 {
			pinmux = <&pin_tach14>;
		};
	};
	/omit-if-no-ref/ pinctrl_tach15_default: tach15_default {
		group0 {
			pinmux = <&pin_tach15>;
		};
	};
	/omit-if-no-ref/ pinctrl_sgpiom_default: sgpiom_default {
		group0 {
			pinmux = <&pin_sgpmclk>, <&pin_sgpmld>, <&pin_sgpmo>, <&pin_sgpmi>;
		};
	};

	/omit-if-no-ref/ pinctrl_jtagm0_default: jtagm0_default {
		group0 {
			pinmux = <&pin_mtrstn1>, <&pin_mtdi1>, <&pin_mtck1>, <&pin_mtms1>, <&pin_mtdo1>;
		};
	};

	/omit-if-no-ref/ pinctrl_jtagm1_default: jtagm1_default {
		group0 {
			pinmux = <&pin_mtrstn2>, <&pin_mtdi2>, <&pin_mtck2>, <&pin_mtms2>, <&pin_mtdo2>;
		};
	};

	/omit-if-no-ref/ pinctrl_i2c0_default: i2c0_default {
		group0 {
			pinmux = <&pin_scl1>, <&pin_sda1>;
		};
	};
	/omit-if-no-ref/ pinctrl_i2c1_default: i2c1_default {
		group0 {
			pinmux = <&pin_scl2>, <&pin_sda2>;
		};
	};
	/omit-if-no-ref/ pinctrl_i2c2_default: i2c2_default {
		group0 {
			pinmux = <&pin_scl3>, <&pin_sda3>;
		};
	};
	/omit-if-no-ref/ pinctrl_i2c3_default: i2c3_default {
		group0 {
			pinmux = <&pin_scl4>, <&pin_sda4>;
		};
	};
	/omit-if-no-ref/ pinctrl_i2c4_default: i2c4_default {
		group0 {
			pinmux = <&pin_scl5>, <&pin_sda5>;
		};
	};
	/omit-if-no-ref/ pinctrl_i2c5_default: i2c5_default {
		group0 {
			pinmux = <&pin_scl6>, <&pin_sda6>;
		};
	};
	/omit-if-no-ref/ pinctrl_i2c6_default: i2c6_default {
		group0 {
			pinmux = <&pin_scl7>, <&pin_sda7>;
		};
	};
	/omit-if-no-ref/ pinctrl_i2c7_default: i2c7_default {
		group0 {
			pinmux = <&pin_scl8>, <&pin_sda8>;
		};
	};
	/omit-if-no-ref/ pinctrl_i2c8_default: i2c8_default {
		group0 {
			pinmux = <&pin_scl9>, <&pin_sda9>;
		};
	};
	/omit-if-no-ref/ pinctrl_i2c9_default: i2c9_default {
		group0 {
			pinmux = <&pin_scl10>, <&pin_sda10>;
		};
	};
	/omit-if-no-ref/ pinctrl_i2c10_default: i2c10_default {
		group0 {
			pinmux = <&pin_scl11>, <&pin_sda11>;
		};
	};
	/omit-if-no-ref/ pinctrl_i2c11_default: i2c11_default {
		group0 {
			pinmux = <&pin_scl12>, <&pin_sda12>;
		};
	};
	/omit-if-no-ref/ pinctrl_i2c12_default: i2c12_default {
		group0 {
			pinmux = <&pin_scl13>, <&pin_sda13>;
		};
	};
	/omit-if-no-ref/ pinctrl_i2c13_default: i2c13_default {
		group0 {
			pinmux = <&pin_scl14>, <&pin_sda14>;
		};
	};
	/omit-if-no-ref/ pinctrl_i3c0_default: i3c0_default {
		group0 {
			pinmux = <&pin_i3c1scl>, <&pin_i3c1sda>;
		};
	};
	/omit-if-no-ref/ pinctrl_hvi3c0_default: hvi3c0_default {
		group0 {
			pinmux = <&pin_hvi3c1scl>, <&pin_hvi3c1sda>;
		};
	};
	/omit-if-no-ref/ pinctrl_i3c1_default: i3c1_default {
		group0 {
			pinmux = <&pin_i3c2scl>, <&pin_i3c2sda>;
		};
	};
	/omit-if-no-ref/ pinctrl_hvi3c1_default: hvi3c1_default {
		group0 {
			pinmux = <&pin_hvi3c2scl>, <&pin_hvi3c2sda>;
		};
	};
	/omit-if-no-ref/ pinctrl_i3c2_default: i3c2_default {
		group0 {
			pinmux = <&pin_i3c3scl>, <&pin_i3c3sda>;
		};
	};
	/omit-if-no-ref/ pinctrl_hvi3c2_default: hvi3c2_default {
		group0 {
			pinmux = <&pin_hvi3c3scl>, <&pin_hvi3c3sda>;
		};
	};
	/omit-if-no-ref/ pinctrl_i3c3_default: i3c3_default {
		group0 {
			pinmux = <&pin_i3c4scl>, <&pin_i3c4sda>;
		};
	};
	/omit-if-no-ref/ pinctrl_hvi3c3_default: hvi3c3_default {
		group0 {
			pinmux = <&pin_hvi3c4scl>, <&pin_hvi3c4sda>;
		};
	};
	/omit-if-no-ref/ pinctrl_uart1_default: uart1_default {
		group0 {
			pinmux = <&pin_txd1>, <&pin_rxd1>;
		};
	};
	/omit-if-no-ref/ pinctrl_uart2_default: uart2_default {
		group0 {
			pinmux = <&pin_txd2>, <&pin_rxd2>;
		};
	};
	/omit-if-no-ref/ pinctrl_uart3_default: uart3_default {
		group0 {
			pinmux = <&pin_txd3>, <&pin_rxd3>;
		};
	};
	/omit-if-no-ref/ pinctrl_uart4_default: uart4_default {
		group0 {
			pinmux = <&pin_txd4>, <&pin_rxd4>;
		};
	};

	/omit-if-no-ref/ pinctrl_uart6_default: uart6_default {
		group0 {
			pinmux = <&pin_txd6>, <&pin_rxd6>;
		};
	};
	/omit-if-no-ref/ pinctrl_uart7_default: uart7_default {
		group0 {
			pinmux = <&pin_txd7>, <&pin_rxd7>;
		};
	};
	/omit-if-no-ref/ pinctrl_uart8_default: uart8_default {
		group0 {
			pinmux = <&pin_txd8>, <&pin_rxd8>;
		};
	};
	/omit-if-no-ref/ pinctrl_uart9_default: uart9_default {
		group0 {
			pinmux = <&pin_txd9>, <&pin_rxd9>;
		};
	};
	/omit-if-no-ref/ pinctrl_uart10_default: uart10_default {
		group0 {
			pinmux = <&pin_txd10>, <&pin_rxd10>;
		};
	};
	/omit-if-no-ref/ pinctrl_uart11_default: uart11_default {
		group0 {
			pinmux = <&pin_txd11>, <&pin_rxd11>;
		};
	};
	/omit-if-no-ref/ pinctrl_uart12_default: uart12_default {
		group0 {
			pinmux = <&pin_txd12>, <&pin_rxd12>;
		};
	};
	/omit-if-no-ref/ pinctrl_uart13_default: uart13_default {
		group0 {
			pinmux = <&pin_txd13>, <&pin_rxd13>;
		};
	};
	/omit-if-no-ref/ pinctrl_fmc_quad: fmc_quad {
		group0 {
			pinmux = <&pin_fwspidq2>, <&pin_fwspidq3>;
		};
	};
	/omit-if-no-ref/ pinctrl_spi1_quad: spi1_quad {
		group0 {
			pinmux = <&pin_spi1dq2>, <&pin_spi1dq3>;
		};
	};
	/omit-if-no-ref/ pinctrl_spi2_default: spi2_default {
		group0 {
			pinmux = <&pin_spi2cs0>, <&pin_spi2ck>, <&pin_spi2dq0>, <&pin_spi2dq1>,
					 <&pin_spi2cs1>;
		};
	};

	/omit-if-no-ref/ pinctrl_spi2_quad: spi2_quad {
		group0 {
			pinmux = <&pin_spi2cs0>, <&pin_spi2ck>, <&pin_spi2dq0>, <&pin_spi2dq1>,
					 <&pin_spi2cs1>, <&pin_spi2dq2>, <&pin_spi2dq3>;
		};
	};

	/* The following pins only available on AST1060 */
	/omit-if-no-ref/ pinctrl_smbflt_default: smbflt_default {
		group0 {
			pinmux = <&pin_smbf1sclin>, <&pin_smbf1sdain>, <&pin_smbf1sclout>, <&pin_smbf1sdaout>,
				 <&pin_smbf2sclin>, <&pin_smbf2sdain>, <&pin_smbf2sclout>, <&pin_smbf2sdaout>,
				 <&pin_smbf3sclin>, <&pin_smbf3sdain>, <&pin_smbf3sclout>, <&pin_smbf3sdaout>,
				 <&pin_smbf4sclin>, <&pin_smbf4sdain>, <&pin_smbf4sclout>, <&pin_smbf4sdaout>;
		};
	};

	/omit-if-no-ref/ pinctrl_spim1_default: spim1_default {
		group0 {
			pinmux = <&pin_spim1csin>, <&pin_spim1clkin>,
					 <&pin_spim1mosiin>, <&pin_spim1misoin>,
					 <&pin_spim1csout>, <&pin_spim1clkout>,
					 <&pin_spim1mosiout>, <&pin_spim1misoout>,
					 <&pin_spim1spirstin>, <&pin_spim1spirstout>,
					 <&pin_spim1muxsel>;
		};
	};

	/omit-if-no-ref/ pinctrl_spim1_quad_default: spim1_quad_default {
		group0 {
			pinmux = <&pin_spim1csin>, <&pin_spim1clkin>,
					 <&pin_spim1mosiin>, <&pin_spim1misoin>,
					 <&pin_spim1csout>, <&pin_spim1clkout>,
					 <&pin_spim1mosiout>, <&pin_spim1misoout>,
					 <&pin_spim1spirstin>, <&pin_spim1spirstout>,
					 <&pin_spim1muxsel>, <&pin_spim1io2in>,
					 <&pin_spim1io3in>, <&pin_spim1io2out>,
					 <&pin_spim1io3out>;
		};
	};

	/omit-if-no-ref/ pinctrl_spim2_default: spim2_default {
		group0 {
			pinmux = <&pin_spim2csin>, <&pin_spim2clkin>,
					 <&pin_spim2mosiin>, <&pin_spim2misoin>,
					 <&pin_spim2csout>, <&pin_spim2clkout>,
					 <&pin_spim2mosiout>, <&pin_spim2misoout>,
					 <&pin_spim2spirstin>, <&pin_spim2spirstout>,
					 <&pin_spim2muxsel>;
		};
	};

	/omit-if-no-ref/ pinctrl_spim2_quad_default: spim2_quad_default {
		group0 {
			pinmux = <&pin_spim2csin>, <&pin_spim2clkin>,
					 <&pin_spim2mosiin>, <&pin_spim2misoin>,
					 <&pin_spim2csout>, <&pin_spim2clkout>,
					 <&pin_spim2mosiout>, <&pin_spim2misoout>,
					 <&pin_spim2spirstin>, <&pin_spim2spirstout>,
					 <&pin_spim2muxsel>, <&pin_spim2io2in>,
					 <&pin_spim2io3in>, <&pin_spim2io2out>,
					 <&pin_spim2io3out>;
		};
	};

	/omit-if-no-ref/ pinctrl_spim3_default: spim3_default {
		group0 {
			pinmux = <&pin_spim3csin>, <&pin_spim3clkin>,
					 <&pin_spim3mosiin>, <&pin_spim3misoin>,
					 <&pin_spim3csout>, <&pin_spim3clkout>,
					 <&pin_spim3mosiout>, <&pin_spim3misoout>,
					 <&pin_spim3spirstin>, <&pin_spim3spirstout>,
					 <&pin_spim3muxsel>;
		};
	};

	/omit-if-no-ref/ pinctrl_spim3_quad_default: spim3_quad_default {
		group0 {
			pinmux = <&pin_spim3csin>, <&pin_spim3clkin>,
					 <&pin_spim3mosiin>, <&pin_spim3misoin>,
					 <&pin_spim3csout>, <&pin_spim3clkout>,
					 <&pin_spim3mosiout>, <&pin_spim3misoout>,
					 <&pin_spim3spirstin>, <&pin_spim3spirstout>,
					 <&pin_spim3muxsel>, <&pin_spim3io2in>,
					 <&pin_spim3io3in>, <&pin_spim3io2out>,
					 <&pin_spim3io3out>;
		};
	};

	/omit-if-no-ref/ pinctrl_spim4_default: spim4_default {
		group0 {
			pinmux = <&pin_spim4csin>, <&pin_spim4clkin>,
					 <&pin_spim4mosiin>, <&pin_spim4misoin>,
					 <&pin_spim4csout>, <&pin_spim4clkout>,
					 <&pin_spim4mosiout>, <&pin_spim4misoout>,
					 <&pin_spim4spirstin>, <&pin_spim4spirstout>,
					 <&pin_spim4muxsel>;
		};
	};

	/omit-if-no-ref/ pinctrl_spim4_quad_default: spim4_quad_default {
		group0 {
			pinmux = <&pin_spim4csin>, <&pin_spim4clkin>,
					 <&pin_spim4mosiin>, <&pin_spim4misoin>,
					 <&pin_spim4csout>, <&pin_spim4clkout>,
					 <&pin_spim4mosiout>, <&pin_spim4misoout>,
					 <&pin_spim4spirstin>, <&pin_spim4spirstout>,
					 <&pin_spim4muxsel>, <&pin_spim4io2in>,
					 <&pin_spim4io3in>, <&pin_spim4io2out>,
					 <&pin_spim4io3out>;
		};
	};
};
