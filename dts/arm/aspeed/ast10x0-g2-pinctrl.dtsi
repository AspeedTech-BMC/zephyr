/*
 * SPDX-License-Identifier: Apache-2.0
 *
 * Copyright (c) 2026 ASPEED Technology Inc.
 */
#include <zephyr/dt-bindings/pinctrl/ast10x0-g2-pinctrl.h>

&pinctrl {
	/*
	 * SCU480[7:4] drive-strength, SCU480[2] DIS_PU, SCU480[0] DIS_PD
	 * (datasheet: SCU480 IO Control #1, GPIO000 half).
	 */
	/omit-if-no-ref/ pin_i3cscl0: pin_i3cscl0 {
		ball = <F14>;
		sig_descs = <SIG_DESC(0x400, 0, 1)>;
		drive-strength-desc = <PINCFG_DESC(0x480, 4, 4)>;
		bias-disable-desc = <PINCFG_DESC(0x480, 0, 1)>;
		pull-up-disable-desc = <PINCFG_DESC(0x480, 2, 1)>;
	};
	/*
	 * SCU480[23:20] drive-strength, SCU480[18] DIS_PU, SCU480[16] DIS_PD
	 * (datasheet: SCU480 IO Control #1, GPIO001 half).
	 */
	/omit-if-no-ref/ pin_i3csda0: pin_i3csda0 {
		ball = <E15>;
		sig_descs = <SIG_DESC(0x400, 4, 1)>;
		drive-strength-desc = <PINCFG_DESC(0x480, 20, 4)>;
		bias-disable-desc = <PINCFG_DESC(0x480, 16, 1)>;
		pull-up-disable-desc = <PINCFG_DESC(0x480, 18, 1)>;
	};
	/omit-if-no-ref/ pin_i3cscl1: pin_i3cscl1 {
		ball = <H13>;
		sig_descs = <SIG_DESC(0x400, 8, 1)>;
		drive-strength-desc = <PINCFG_DESC(0x484, 4, 4)>;
		bias-disable-desc = <PINCFG_DESC(0x484, 0, 1)>;
		pull-up-disable-desc = <PINCFG_DESC(0x484, 2, 1)>;
	};
	/omit-if-no-ref/ pin_i3csda1: pin_i3csda1 {
		ball = <D17>;
		sig_descs = <SIG_DESC(0x400, 12, 1)>;
		drive-strength-desc = <PINCFG_DESC(0x484, 20, 4)>;
		bias-disable-desc = <PINCFG_DESC(0x484, 16, 1)>;
		pull-up-disable-desc = <PINCFG_DESC(0x484, 18, 1)>;
	};
	/omit-if-no-ref/ pin_i3cscl2: pin_i3cscl2 {
		ball = <D16>;
		sig_descs = <SIG_DESC(0x400, 16, 1)>;
		drive-strength-desc = <PINCFG_DESC(0x488, 4, 4)>;
		bias-disable-desc = <PINCFG_DESC(0x488, 0, 1)>;
		pull-up-disable-desc = <PINCFG_DESC(0x488, 2, 1)>;
	};
	/omit-if-no-ref/ pin_i3csda2: pin_i3csda2 {
		ball = <D15>;
		sig_descs = <SIG_DESC(0x400, 20, 1)>;
		drive-strength-desc = <PINCFG_DESC(0x488, 20, 4)>;
		bias-disable-desc = <PINCFG_DESC(0x488, 16, 1)>;
		pull-up-disable-desc = <PINCFG_DESC(0x488, 18, 1)>;
	};
	/omit-if-no-ref/ pin_i3cscl3: pin_i3cscl3 {
		ball = <C15>;
		sig_descs = <SIG_DESC(0x400, 24, 1)>;
		drive-strength-desc = <PINCFG_DESC(0x48c, 4, 4)>;
		bias-disable-desc = <PINCFG_DESC(0x48c, 0, 1)>;
		pull-up-disable-desc = <PINCFG_DESC(0x48c, 2, 1)>;
	};
	/omit-if-no-ref/ pin_i3csda3: pin_i3csda3 {
		ball = <F13>;
		sig_descs = <SIG_DESC(0x400, 28, 1)>;
		drive-strength-desc = <PINCFG_DESC(0x48c, 20, 4)>;
		bias-disable-desc = <PINCFG_DESC(0x48c, 16, 1)>;
		pull-up-disable-desc = <PINCFG_DESC(0x48c, 18, 1)>;
	};
	/omit-if-no-ref/ pin_i3cscl4: pin_i3cscl4 {
		ball = <K13>;
		sig_descs = <SIG_DESC(0x404, 0, 1)>;
		drive-strength-desc = <PINCFG_DESC(0x490, 4, 4)>;
		bias-disable-desc = <PINCFG_DESC(0x490, 0, 1)>;
		pull-up-disable-desc = <PINCFG_DESC(0x490, 2, 1)>;
	};
	/omit-if-no-ref/ pin_i3csda4: pin_i3csda4 {
		ball = <C14>;
		sig_descs = <SIG_DESC(0x404, 4, 1)>;
		drive-strength-desc = <PINCFG_DESC(0x490, 20, 4)>;
		bias-disable-desc = <PINCFG_DESC(0x490, 16, 1)>;
		pull-up-disable-desc = <PINCFG_DESC(0x490, 18, 1)>;
	};
	/omit-if-no-ref/ pin_i3cscl5: pin_i3cscl5 {
		ball = <A14>;
		sig_descs = <SIG_DESC(0x404, 8, 1)>;
		drive-strength-desc = <PINCFG_DESC(0x494, 4, 4)>;
		bias-disable-desc = <PINCFG_DESC(0x494, 0, 1)>;
		pull-up-disable-desc = <PINCFG_DESC(0x494, 2, 1)>;
	};
	/omit-if-no-ref/ pin_i3csda5: pin_i3csda5 {
		ball = <D14>;
		sig_descs = <SIG_DESC(0x404, 12, 1)>;
		drive-strength-desc = <PINCFG_DESC(0x494, 20, 4)>;
		bias-disable-desc = <PINCFG_DESC(0x494, 16, 1)>;
		pull-up-disable-desc = <PINCFG_DESC(0x494, 18, 1)>;
	};
	/omit-if-no-ref/ pin_i3cscl6: pin_i3cscl6 {
		ball = <B14>;
		sig_descs = <SIG_DESC(0x404, 16, 1)>;
		drive-strength-desc = <PINCFG_DESC(0x498, 4, 4)>;
		bias-disable-desc = <PINCFG_DESC(0x498, 0, 1)>;
		pull-up-disable-desc = <PINCFG_DESC(0x498, 2, 1)>;
	};
	/omit-if-no-ref/ pin_txd5: pin_txd5 {
		ball = <B14>;
		sig_descs = <SIG_DESC(0x404, 16, 2)>;
		drive-strength-desc = <PINCFG_DESC(0x498, 4, 4)>;
		bias-disable-desc = <PINCFG_DESC(0x498, 0, 1)>;
		pull-up-disable-desc = <PINCFG_DESC(0x498, 2, 1)>;
	};
	/omit-if-no-ref/ pin_i3csda6: pin_i3csda6 {
		ball = <B13>;
		sig_descs = <SIG_DESC(0x404, 20, 1)>;
		drive-strength-desc = <PINCFG_DESC(0x498, 20, 4)>;
		bias-disable-desc = <PINCFG_DESC(0x498, 16, 1)>;
		pull-up-disable-desc = <PINCFG_DESC(0x498, 18, 1)>;
	};
	/omit-if-no-ref/ pin_rxd5: pin_rxd5 {
		ball = <B13>;
		sig_descs = <SIG_DESC(0x404, 20, 2)>;
		drive-strength-desc = <PINCFG_DESC(0x498, 20, 4)>;
		bias-disable-desc = <PINCFG_DESC(0x498, 16, 1)>;
		pull-up-disable-desc = <PINCFG_DESC(0x498, 18, 1)>;
	};
	/omit-if-no-ref/ pin_i3cscl7: pin_i3cscl7 {
		ball = <D13>;
		sig_descs = <SIG_DESC(0x404, 24, 1)>;
		drive-strength-desc = <PINCFG_DESC(0x49c, 4, 4)>;
		bias-disable-desc = <PINCFG_DESC(0x49c, 0, 1)>;
		pull-up-disable-desc = <PINCFG_DESC(0x49c, 2, 1)>;
	};
	/omit-if-no-ref/ pin_txd6: pin_txd6 {
		ball = <D13>;
		sig_descs = <SIG_DESC(0x404, 24, 2)>;
		drive-strength-desc = <PINCFG_DESC(0x49c, 4, 4)>;
		bias-disable-desc = <PINCFG_DESC(0x49c, 0, 1)>;
		pull-up-disable-desc = <PINCFG_DESC(0x49c, 2, 1)>;
	};
	/omit-if-no-ref/ pin_i3csda7: pin_i3csda7 {
		ball = <E13>;
		sig_descs = <SIG_DESC(0x404, 28, 1)>;
		drive-strength-desc = <PINCFG_DESC(0x49c, 20, 4)>;
		bias-disable-desc = <PINCFG_DESC(0x49c, 16, 1)>;
		pull-up-disable-desc = <PINCFG_DESC(0x49c, 18, 1)>;
	};
	/omit-if-no-ref/ pin_rxd6: pin_rxd6 {
		ball = <E13>;
		sig_descs = <SIG_DESC(0x404, 28, 2)>;
		drive-strength-desc = <PINCFG_DESC(0x49c, 20, 4)>;
		bias-disable-desc = <PINCFG_DESC(0x49c, 16, 1)>;
		pull-up-disable-desc = <PINCFG_DESC(0x49c, 18, 1)>;
	};
	/omit-if-no-ref/ pin_scl0: pin_scl0 {
		ball = <R10>;
		sig_descs = <SIG_DESC(0x408, 0, 1)>;
		drive-strength-desc = <PINCFG_DESC(0x4a0, 4, 4)>;
		bias-disable-desc = <PINCFG_DESC(0x4a0, 0, 1)>;
		pull-up-disable-desc = <PINCFG_DESC(0x4a0, 2, 1)>;
	};
	/*
	 * Primary TXD0 path. The alternate path below (pin_dtxd0,
	 * ball R10) only takes effect while this ball's mux is not
	 * selecting TXD0 (datasheet: SCU414[18:16] not-equal 1).
	 */
	/omit-if-no-ref/ pin_txd0: pin_txd0 {
		ball = <F3>;
		sig_descs = <SIG_DESC(0x414, 16, 1)>;
		drive-strength-desc = <PINCFG_DESC(0x4d8, 4, 4)>;
		bias-disable-desc = <PINCFG_DESC(0x4d8, 0, 1)>;
		pull-up-disable-desc = <PINCFG_DESC(0x4d8, 2, 1)>;
	};
	/omit-if-no-ref/ pin_dtxd0: pin_dtxd0 {
		ball = <R10>;
		sig_descs = <SIG_DESC(0x408, 0, 3)>;
		drive-strength-desc = <PINCFG_DESC(0x4a0, 4, 4)>;
		bias-disable-desc = <PINCFG_DESC(0x4a0, 0, 1)>;
		pull-up-disable-desc = <PINCFG_DESC(0x4a0, 2, 1)>;
	};
	/*
	 * Primary PWM4 path. The alternate path below (pin_dpwm4,
	 * ball R10) only takes effect while this ball's mux is not
	 * selecting PWM4 (datasheet: SCU424[02:00] not-equal 1).
	 */
	/omit-if-no-ref/ pin_pwm4: pin_pwm4 {
		ball = <A3>;
		sig_descs = <SIG_DESC(0x424, 0, 1)>;
		drive-strength-desc = <PINCFG_DESC(0x510, 4, 4)>;
		bias-disable-desc = <PINCFG_DESC(0x510, 0, 1)>;
		pull-up-disable-desc = <PINCFG_DESC(0x510, 2, 1)>;
	};
	/omit-if-no-ref/ pin_dpwm4: pin_dpwm4 {
		ball = <R10>;
		sig_descs = <SIG_DESC(0x408, 0, 4)>;
		drive-strength-desc = <PINCFG_DESC(0x4a0, 4, 4)>;
		bias-disable-desc = <PINCFG_DESC(0x4a0, 0, 1)>;
		pull-up-disable-desc = <PINCFG_DESC(0x4a0, 2, 1)>;
	};
	/omit-if-no-ref/ pin_sda0: pin_sda0 {
		ball = <P11>;
		sig_descs = <SIG_DESC(0x408, 4, 1)>;
		drive-strength-desc = <PINCFG_DESC(0x4a0, 20, 4)>;
		bias-disable-desc = <PINCFG_DESC(0x4a0, 16, 1)>;
		pull-up-disable-desc = <PINCFG_DESC(0x4a0, 18, 1)>;
	};
	/*
	 * Primary RXD0 path. The alternate path below (pin_drxd0,
	 * ball P11) only takes effect while this ball's mux is not
	 * selecting RXD0 (datasheet: SCU414[22:20] not-equal 1).
	 */
	/omit-if-no-ref/ pin_rxd0: pin_rxd0 {
		ball = <G5>;
		sig_descs = <SIG_DESC(0x414, 20, 1)>;
		drive-strength-desc = <PINCFG_DESC(0x4d8, 20, 4)>;
		bias-disable-desc = <PINCFG_DESC(0x4d8, 16, 1)>;
		pull-up-disable-desc = <PINCFG_DESC(0x4d8, 18, 1)>;
	};
	/omit-if-no-ref/ pin_drxd0: pin_drxd0 {
		ball = <P11>;
		sig_descs = <SIG_DESC(0x408, 4, 3)>;
		drive-strength-desc = <PINCFG_DESC(0x4a0, 20, 4)>;
		bias-disable-desc = <PINCFG_DESC(0x4a0, 16, 1)>;
		pull-up-disable-desc = <PINCFG_DESC(0x4a0, 18, 1)>;
	};
	/*
	 * Primary PWM5 path. The alternate path below (pin_dpwm5,
	 * ball P11) only takes effect while this ball's mux is not
	 * selecting PWM5 (datasheet: SCU424[06:04] not-equal 1).
	 */
	/omit-if-no-ref/ pin_pwm5: pin_pwm5 {
		ball = <A2>;
		sig_descs = <SIG_DESC(0x424, 4, 1)>;
		drive-strength-desc = <PINCFG_DESC(0x510, 20, 4)>;
		bias-disable-desc = <PINCFG_DESC(0x510, 16, 1)>;
		pull-up-disable-desc = <PINCFG_DESC(0x510, 18, 1)>;
	};
	/omit-if-no-ref/ pin_dpwm5: pin_dpwm5 {
		ball = <P11>;
		sig_descs = <SIG_DESC(0x408, 4, 4)>;
		drive-strength-desc = <PINCFG_DESC(0x4a0, 20, 4)>;
		bias-disable-desc = <PINCFG_DESC(0x4a0, 16, 1)>;
		pull-up-disable-desc = <PINCFG_DESC(0x4a0, 18, 1)>;
	};
	/omit-if-no-ref/ pin_scl1: pin_scl1 {
		ball = <R11>;
		sig_descs = <SIG_DESC(0x408, 8, 1)>;
		drive-strength-desc = <PINCFG_DESC(0x4a4, 4, 4)>;
		bias-disable-desc = <PINCFG_DESC(0x4a4, 0, 1)>;
		pull-up-disable-desc = <PINCFG_DESC(0x4a4, 2, 1)>;
	};
	/*
	 * Primary TXD1 path. The alternate path below (pin_dtxd1,
	 * ball R11) only takes effect while this ball's mux is not
	 * selecting TXD1 (datasheet: SCU414[26:24] not-equal 1).
	 */
	/omit-if-no-ref/ pin_txd1: pin_txd1 {
		ball = <G4>;
		sig_descs = <SIG_DESC(0x414, 24, 1)>;
		drive-strength-desc = <PINCFG_DESC(0x4dc, 4, 4)>;
		bias-disable-desc = <PINCFG_DESC(0x4dc, 0, 1)>;
		pull-up-disable-desc = <PINCFG_DESC(0x4dc, 2, 1)>;
	};
	/omit-if-no-ref/ pin_dtxd1: pin_dtxd1 {
		ball = <R11>;
		sig_descs = <SIG_DESC(0x408, 8, 3)>;
		drive-strength-desc = <PINCFG_DESC(0x4a4, 4, 4)>;
		bias-disable-desc = <PINCFG_DESC(0x4a4, 0, 1)>;
		pull-up-disable-desc = <PINCFG_DESC(0x4a4, 2, 1)>;
	};
	/*
	 * Primary PWM6 path. The alternate path below (pin_dpwm6,
	 * ball R11) only takes effect while this ball's mux is not
	 * selecting PWM6 (datasheet: SCU424[10:08] not-equal 1).
	 */
	/omit-if-no-ref/ pin_pwm6: pin_pwm6 {
		ball = <B6>;
		sig_descs = <SIG_DESC(0x424, 8, 1)>;
		drive-strength-desc = <PINCFG_DESC(0x514, 4, 4)>;
		bias-disable-desc = <PINCFG_DESC(0x514, 0, 1)>;
		pull-up-disable-desc = <PINCFG_DESC(0x514, 2, 1)>;
	};
	/omit-if-no-ref/ pin_dpwm6: pin_dpwm6 {
		ball = <R11>;
		sig_descs = <SIG_DESC(0x408, 8, 4)>;
		drive-strength-desc = <PINCFG_DESC(0x4a4, 4, 4)>;
		bias-disable-desc = <PINCFG_DESC(0x4a4, 0, 1)>;
		pull-up-disable-desc = <PINCFG_DESC(0x4a4, 2, 1)>;
	};
	/omit-if-no-ref/ pin_sda1: pin_sda1 {
		ball = <U12>;
		sig_descs = <SIG_DESC(0x408, 12, 1)>;
		drive-strength-desc = <PINCFG_DESC(0x4a4, 20, 4)>;
		bias-disable-desc = <PINCFG_DESC(0x4a4, 16, 1)>;
		pull-up-disable-desc = <PINCFG_DESC(0x4a4, 18, 1)>;
	};
	/*
	 * Primary RXD1 path. The alternate path below (pin_drxd1,
	 * ball U12) only takes effect while this ball's mux is not
	 * selecting RXD1 (datasheet: SCU414[30:28] not-equal 1).
	 */
	/omit-if-no-ref/ pin_rxd1: pin_rxd1 {
		ball = <H4>;
		sig_descs = <SIG_DESC(0x414, 28, 1)>;
		drive-strength-desc = <PINCFG_DESC(0x4dc, 20, 4)>;
		bias-disable-desc = <PINCFG_DESC(0x4dc, 16, 1)>;
		pull-up-disable-desc = <PINCFG_DESC(0x4dc, 18, 1)>;
	};
	/omit-if-no-ref/ pin_drxd1: pin_drxd1 {
		ball = <U12>;
		sig_descs = <SIG_DESC(0x408, 12, 3)>;
		drive-strength-desc = <PINCFG_DESC(0x4a4, 20, 4)>;
		bias-disable-desc = <PINCFG_DESC(0x4a4, 16, 1)>;
		pull-up-disable-desc = <PINCFG_DESC(0x4a4, 18, 1)>;
	};
	/*
	 * Primary PWM7 path. The alternate path below (pin_dpwm7,
	 * ball U12) only takes effect while this ball's mux is not
	 * selecting PWM7 (datasheet: SCU424[14:12] not-equal 1).
	 */
	/omit-if-no-ref/ pin_pwm7: pin_pwm7 {
		ball = <L3>;
		sig_descs = <SIG_DESC(0x424, 12, 1)>;
		drive-strength-desc = <PINCFG_DESC(0x514, 20, 4)>;
		bias-disable-desc = <PINCFG_DESC(0x514, 16, 1)>;
		pull-up-disable-desc = <PINCFG_DESC(0x514, 18, 1)>;
	};
	/omit-if-no-ref/ pin_dpwm7: pin_dpwm7 {
		ball = <U12>;
		sig_descs = <SIG_DESC(0x408, 12, 4)>;
		drive-strength-desc = <PINCFG_DESC(0x4a4, 20, 4)>;
		bias-disable-desc = <PINCFG_DESC(0x4a4, 16, 1)>;
		pull-up-disable-desc = <PINCFG_DESC(0x4a4, 18, 1)>;
	};
	/omit-if-no-ref/ pin_scl2: pin_scl2 {
		ball = <T12>;
		sig_descs = <SIG_DESC(0x408, 16, 1)>;
		drive-strength-desc = <PINCFG_DESC(0x4a8, 4, 4)>;
		bias-disable-desc = <PINCFG_DESC(0x4a8, 0, 1)>;
		pull-up-disable-desc = <PINCFG_DESC(0x4a8, 2, 1)>;
	};
	/*
	 * Primary TXD2 path. The alternate path below (pin_dtxd2,
	 * ball T12) only takes effect while this ball's mux is not
	 * selecting TXD2 (datasheet: SCU418[02:00] not-equal 1).
	 */
	/omit-if-no-ref/ pin_txd2: pin_txd2 {
		ball = <H5>;
		sig_descs = <SIG_DESC(0x418, 0, 1)>;
		drive-strength-desc = <PINCFG_DESC(0x4e0, 4, 4)>;
		bias-disable-desc = <PINCFG_DESC(0x4e0, 0, 1)>;
		pull-up-disable-desc = <PINCFG_DESC(0x4e0, 2, 1)>;
	};
	/omit-if-no-ref/ pin_dtxd2: pin_dtxd2 {
		ball = <T12>;
		sig_descs = <SIG_DESC(0x408, 16, 3)>;
		drive-strength-desc = <PINCFG_DESC(0x4a8, 4, 4)>;
		bias-disable-desc = <PINCFG_DESC(0x4a8, 0, 1)>;
		pull-up-disable-desc = <PINCFG_DESC(0x4a8, 2, 1)>;
	};
	/*
	 * Primary TACH4 path. The alternate path below (pin_dtach4,
	 * ball T12) only takes effect while this ball's mux is not
	 * selecting TACH4 (datasheet: SCU42C[02:00] not-equal 1).
	 */
	/omit-if-no-ref/ pin_tach4: pin_tach4 {
		ball = <T1>;
		sig_descs = <SIG_DESC(0x42c, 0, 1)>;
		drive-strength-desc = <PINCFG_DESC(0x530, 4, 4)>;
		bias-disable-desc = <PINCFG_DESC(0x530, 0, 1)>;
		pull-up-disable-desc = <PINCFG_DESC(0x530, 2, 1)>;
	};
	/omit-if-no-ref/ pin_dtach4: pin_dtach4 {
		ball = <T12>;
		sig_descs = <SIG_DESC(0x408, 16, 4)>;
		drive-strength-desc = <PINCFG_DESC(0x4a8, 4, 4)>;
		bias-disable-desc = <PINCFG_DESC(0x4a8, 0, 1)>;
		pull-up-disable-desc = <PINCFG_DESC(0x4a8, 2, 1)>;
	};
	/omit-if-no-ref/ pin_sda2: pin_sda2 {
		ball = <R12>;
		sig_descs = <SIG_DESC(0x408, 20, 1)>;
		drive-strength-desc = <PINCFG_DESC(0x4a8, 20, 4)>;
		bias-disable-desc = <PINCFG_DESC(0x4a8, 16, 1)>;
		pull-up-disable-desc = <PINCFG_DESC(0x4a8, 18, 1)>;
	};
	/*
	 * Primary RXD2 path. The alternate path below (pin_drxd2,
	 * ball R12) only takes effect while this ball's mux is not
	 * selecting RXD2 (datasheet: SCU418[06:04] not-equal 1).
	 */
	/omit-if-no-ref/ pin_rxd2: pin_rxd2 {
		ball = <J3>;
		sig_descs = <SIG_DESC(0x418, 4, 1)>;
		drive-strength-desc = <PINCFG_DESC(0x4e0, 20, 4)>;
		bias-disable-desc = <PINCFG_DESC(0x4e0, 16, 1)>;
		pull-up-disable-desc = <PINCFG_DESC(0x4e0, 18, 1)>;
	};
	/omit-if-no-ref/ pin_drxd2: pin_drxd2 {
		ball = <R12>;
		sig_descs = <SIG_DESC(0x408, 20, 3)>;
		drive-strength-desc = <PINCFG_DESC(0x4a8, 20, 4)>;
		bias-disable-desc = <PINCFG_DESC(0x4a8, 16, 1)>;
		pull-up-disable-desc = <PINCFG_DESC(0x4a8, 18, 1)>;
	};
	/*
	 * Primary TACH5 path. The alternate path below (pin_dtach5,
	 * ball R12) only takes effect while this ball's mux is not
	 * selecting TACH5 (datasheet: SCU42C[06:04] not-equal 1).
	 */
	/omit-if-no-ref/ pin_tach5: pin_tach5 {
		ball = <U5>;
		sig_descs = <SIG_DESC(0x42c, 4, 1)>;
		drive-strength-desc = <PINCFG_DESC(0x530, 20, 4)>;
		bias-disable-desc = <PINCFG_DESC(0x530, 16, 1)>;
		pull-up-disable-desc = <PINCFG_DESC(0x530, 18, 1)>;
	};
	/omit-if-no-ref/ pin_dtach5: pin_dtach5 {
		ball = <R12>;
		sig_descs = <SIG_DESC(0x408, 20, 4)>;
		drive-strength-desc = <PINCFG_DESC(0x4a8, 20, 4)>;
		bias-disable-desc = <PINCFG_DESC(0x4a8, 16, 1)>;
		pull-up-disable-desc = <PINCFG_DESC(0x4a8, 18, 1)>;
	};
	/omit-if-no-ref/ pin_scl3: pin_scl3 {
		ball = <N12>;
		sig_descs = <SIG_DESC(0x408, 24, 1)>;
		drive-strength-desc = <PINCFG_DESC(0x4ac, 4, 4)>;
		bias-disable-desc = <PINCFG_DESC(0x4ac, 0, 1)>;
		pull-up-disable-desc = <PINCFG_DESC(0x4ac, 2, 1)>;
	};
	/*
	 * Primary TXD3 path. The alternate path below (pin_dtxd3,
	 * ball N12) only takes effect while this ball's mux is not
	 * selecting TXD3 (datasheet: SCU418[10:08] not-equal 1).
	 */
	/omit-if-no-ref/ pin_txd3: pin_txd3 {
		ball = <K3>;
		sig_descs = <SIG_DESC(0x418, 8, 1)>;
		drive-strength-desc = <PINCFG_DESC(0x4e4, 4, 4)>;
		bias-disable-desc = <PINCFG_DESC(0x4e4, 0, 1)>;
		pull-up-disable-desc = <PINCFG_DESC(0x4e4, 2, 1)>;
	};
	/omit-if-no-ref/ pin_dtxd3: pin_dtxd3 {
		ball = <N12>;
		sig_descs = <SIG_DESC(0x408, 24, 3)>;
		drive-strength-desc = <PINCFG_DESC(0x4ac, 4, 4)>;
		bias-disable-desc = <PINCFG_DESC(0x4ac, 0, 1)>;
		pull-up-disable-desc = <PINCFG_DESC(0x4ac, 2, 1)>;
	};
	/*
	 * Primary TACH6 path. The alternate path below (pin_dtach6,
	 * ball N12) only takes effect while this ball's mux is not
	 * selecting TACH6 (datasheet: SCU42C[10:08] not-equal 1).
	 */
	/omit-if-no-ref/ pin_tach6: pin_tach6 {
		ball = <T5>;
		sig_descs = <SIG_DESC(0x42c, 8, 1)>;
		drive-strength-desc = <PINCFG_DESC(0x534, 4, 4)>;
		bias-disable-desc = <PINCFG_DESC(0x534, 0, 1)>;
		pull-up-disable-desc = <PINCFG_DESC(0x534, 2, 1)>;
	};
	/omit-if-no-ref/ pin_dtach6: pin_dtach6 {
		ball = <N12>;
		sig_descs = <SIG_DESC(0x408, 24, 4)>;
		drive-strength-desc = <PINCFG_DESC(0x4ac, 4, 4)>;
		bias-disable-desc = <PINCFG_DESC(0x4ac, 0, 1)>;
		pull-up-disable-desc = <PINCFG_DESC(0x4ac, 2, 1)>;
	};
	/omit-if-no-ref/ pin_sda3: pin_sda3 {
		ball = <P12>;
		sig_descs = <SIG_DESC(0x408, 28, 1)>;
		drive-strength-desc = <PINCFG_DESC(0x4ac, 20, 4)>;
		bias-disable-desc = <PINCFG_DESC(0x4ac, 16, 1)>;
		pull-up-disable-desc = <PINCFG_DESC(0x4ac, 18, 1)>;
	};
	/*
	 * Primary RXD3 path. The alternate path below (pin_drxd3,
	 * ball P12) only takes effect while this ball's mux is not
	 * selecting RXD3 (datasheet: SCU418[14:12] not-equal 1).
	 */
	/omit-if-no-ref/ pin_rxd3: pin_rxd3 {
		ball = <F4>;
		sig_descs = <SIG_DESC(0x418, 12, 1)>;
		drive-strength-desc = <PINCFG_DESC(0x4e4, 20, 4)>;
		bias-disable-desc = <PINCFG_DESC(0x4e4, 16, 1)>;
		pull-up-disable-desc = <PINCFG_DESC(0x4e4, 18, 1)>;
	};
	/omit-if-no-ref/ pin_drxd3: pin_drxd3 {
		ball = <P12>;
		sig_descs = <SIG_DESC(0x408, 28, 3)>;
		drive-strength-desc = <PINCFG_DESC(0x4ac, 20, 4)>;
		bias-disable-desc = <PINCFG_DESC(0x4ac, 16, 1)>;
		pull-up-disable-desc = <PINCFG_DESC(0x4ac, 18, 1)>;
	};
	/*
	 * Primary TACH7 path. The alternate path below (pin_dtach7,
	 * ball P12) only takes effect while this ball's mux is not
	 * selecting TACH7 (datasheet: SCU42C[14:12] not-equal 1).
	 */
	/omit-if-no-ref/ pin_tach7: pin_tach7 {
		ball = <R5>;
		sig_descs = <SIG_DESC(0x42c, 12, 1)>;
		drive-strength-desc = <PINCFG_DESC(0x534, 20, 4)>;
		bias-disable-desc = <PINCFG_DESC(0x534, 16, 1)>;
		pull-up-disable-desc = <PINCFG_DESC(0x534, 18, 1)>;
	};
	/omit-if-no-ref/ pin_dtach7: pin_dtach7 {
		ball = <P12>;
		sig_descs = <SIG_DESC(0x408, 28, 4)>;
		drive-strength-desc = <PINCFG_DESC(0x4ac, 20, 4)>;
		bias-disable-desc = <PINCFG_DESC(0x4ac, 16, 1)>;
		pull-up-disable-desc = <PINCFG_DESC(0x4ac, 18, 1)>;
	};
	/omit-if-no-ref/ pin_scl4: pin_scl4 {
		ball = <U13>;
		sig_descs = <SIG_DESC(0x40c, 0, 1)>;
		drive-strength-desc = <PINCFG_DESC(0x4b0, 4, 4)>;
		bias-disable-desc = <PINCFG_DESC(0x4b0, 0, 1)>;
		pull-up-disable-desc = <PINCFG_DESC(0x4b0, 2, 1)>;
	};
	/*
	 * Primary PWM0 path. The alternate path below (pin_dpwm0,
	 * ball U13) only takes effect while this ball's mux is not
	 * selecting PWM0 (datasheet: SCU420[18:16] not-equal 1).
	 */
	/omit-if-no-ref/ pin_pwm0: pin_pwm0 {
		ball = <C8>;
		sig_descs = <SIG_DESC(0x420, 16, 1)>;
		drive-strength-desc = <PINCFG_DESC(0x508, 4, 4)>;
		bias-disable-desc = <PINCFG_DESC(0x508, 0, 1)>;
		pull-up-disable-desc = <PINCFG_DESC(0x508, 2, 1)>;
	};
	/omit-if-no-ref/ pin_dpwm0: pin_dpwm0 {
		ball = <U13>;
		sig_descs = <SIG_DESC(0x40c, 0, 2)>;
		drive-strength-desc = <PINCFG_DESC(0x4b0, 4, 4)>;
		bias-disable-desc = <PINCFG_DESC(0x4b0, 0, 1)>;
		pull-up-disable-desc = <PINCFG_DESC(0x4b0, 2, 1)>;
	};
	/omit-if-no-ref/ pin_sda4: pin_sda4 {
		ball = <T13>;
		sig_descs = <SIG_DESC(0x40c, 4, 1)>;
		drive-strength-desc = <PINCFG_DESC(0x4b0, 20, 4)>;
		bias-disable-desc = <PINCFG_DESC(0x4b0, 16, 1)>;
		pull-up-disable-desc = <PINCFG_DESC(0x4b0, 18, 1)>;
	};
	/*
	 * Primary PWM1 path. The alternate path below (pin_dpwm1,
	 * ball T13) only takes effect while this ball's mux is not
	 * selecting PWM1 (datasheet: SCU420[22:20] not-equal 1).
	 */
	/omit-if-no-ref/ pin_pwm1: pin_pwm1 {
		ball = <D8>;
		sig_descs = <SIG_DESC(0x420, 20, 1)>;
		drive-strength-desc = <PINCFG_DESC(0x508, 20, 4)>;
		bias-disable-desc = <PINCFG_DESC(0x508, 16, 1)>;
		pull-up-disable-desc = <PINCFG_DESC(0x508, 18, 1)>;
	};
	/omit-if-no-ref/ pin_dpwm1: pin_dpwm1 {
		ball = <T13>;
		sig_descs = <SIG_DESC(0x40c, 4, 2)>;
		drive-strength-desc = <PINCFG_DESC(0x4b0, 20, 4)>;
		bias-disable-desc = <PINCFG_DESC(0x4b0, 16, 1)>;
		pull-up-disable-desc = <PINCFG_DESC(0x4b0, 18, 1)>;
	};
	/omit-if-no-ref/ pin_scl5: pin_scl5 {
		ball = <R13>;
		sig_descs = <SIG_DESC(0x40c, 8, 1)>;
		drive-strength-desc = <PINCFG_DESC(0x4b4, 4, 4)>;
		bias-disable-desc = <PINCFG_DESC(0x4b4, 0, 1)>;
		pull-up-disable-desc = <PINCFG_DESC(0x4b4, 2, 1)>;
	};
	/*
	 * Primary PWM2 path. The alternate path below (pin_dpwm2,
	 * ball R13) only takes effect while this ball's mux is not
	 * selecting PWM2 (datasheet: SCU420[26:24] not-equal 1).
	 */
	/omit-if-no-ref/ pin_pwm2: pin_pwm2 {
		ball = <A5>;
		sig_descs = <SIG_DESC(0x420, 24, 1)>;
		drive-strength-desc = <PINCFG_DESC(0x50c, 4, 4)>;
		bias-disable-desc = <PINCFG_DESC(0x50c, 0, 1)>;
		pull-up-disable-desc = <PINCFG_DESC(0x50c, 2, 1)>;
	};
	/omit-if-no-ref/ pin_dpwm2: pin_dpwm2 {
		ball = <R13>;
		sig_descs = <SIG_DESC(0x40c, 8, 2)>;
		drive-strength-desc = <PINCFG_DESC(0x4b4, 4, 4)>;
		bias-disable-desc = <PINCFG_DESC(0x4b4, 0, 1)>;
		pull-up-disable-desc = <PINCFG_DESC(0x4b4, 2, 1)>;
	};
	/omit-if-no-ref/ pin_sda5: pin_sda5 {
		ball = <U14>;
		sig_descs = <SIG_DESC(0x40c, 12, 1)>;
		drive-strength-desc = <PINCFG_DESC(0x4b4, 20, 4)>;
		bias-disable-desc = <PINCFG_DESC(0x4b4, 16, 1)>;
		pull-up-disable-desc = <PINCFG_DESC(0x4b4, 18, 1)>;
	};
	/*
	 * Primary PWM3 path. The alternate path below (pin_dpwm3,
	 * ball U14) only takes effect while this ball's mux is not
	 * selecting PWM3 (datasheet: SCU420[30:28] not-equal 1).
	 */
	/omit-if-no-ref/ pin_pwm3: pin_pwm3 {
		ball = <A4>;
		sig_descs = <SIG_DESC(0x420, 28, 1)>;
		drive-strength-desc = <PINCFG_DESC(0x50c, 20, 4)>;
		bias-disable-desc = <PINCFG_DESC(0x50c, 16, 1)>;
		pull-up-disable-desc = <PINCFG_DESC(0x50c, 18, 1)>;
	};
	/omit-if-no-ref/ pin_dpwm3: pin_dpwm3 {
		ball = <U14>;
		sig_descs = <SIG_DESC(0x40c, 12, 2)>;
		drive-strength-desc = <PINCFG_DESC(0x4b4, 20, 4)>;
		bias-disable-desc = <PINCFG_DESC(0x4b4, 16, 1)>;
		pull-up-disable-desc = <PINCFG_DESC(0x4b4, 18, 1)>;
	};
	/omit-if-no-ref/ pin_scl6: pin_scl6 {
		ball = <T14>;
		sig_descs = <SIG_DESC(0x40c, 16, 1)>;
		drive-strength-desc = <PINCFG_DESC(0x4b8, 4, 4)>;
		bias-disable-desc = <PINCFG_DESC(0x4b8, 0, 1)>;
		pull-up-disable-desc = <PINCFG_DESC(0x4b8, 2, 1)>;
	};
	/*
	 * Primary TACH0 path. The alternate path below (pin_dtach0,
	 * ball T14) only takes effect while this ball's mux is not
	 * selecting TACH0 (datasheet: SCU428[18:16] not-equal 1).
	 */
	/omit-if-no-ref/ pin_tach0: pin_tach0 {
		ball = <L4>;
		sig_descs = <SIG_DESC(0x428, 16, 1)>;
		drive-strength-desc = <PINCFG_DESC(0x528, 4, 4)>;
		bias-disable-desc = <PINCFG_DESC(0x528, 0, 1)>;
		pull-up-disable-desc = <PINCFG_DESC(0x528, 2, 1)>;
	};
	/omit-if-no-ref/ pin_dtach0: pin_dtach0 {
		ball = <T14>;
		sig_descs = <SIG_DESC(0x40c, 16, 2)>;
		drive-strength-desc = <PINCFG_DESC(0x4b8, 4, 4)>;
		bias-disable-desc = <PINCFG_DESC(0x4b8, 0, 1)>;
		pull-up-disable-desc = <PINCFG_DESC(0x4b8, 2, 1)>;
	};
	/omit-if-no-ref/ pin_sda6: pin_sda6 {
		ball = <R14>;
		sig_descs = <SIG_DESC(0x40c, 20, 1)>;
		drive-strength-desc = <PINCFG_DESC(0x4b8, 20, 4)>;
		bias-disable-desc = <PINCFG_DESC(0x4b8, 16, 1)>;
		pull-up-disable-desc = <PINCFG_DESC(0x4b8, 18, 1)>;
	};
	/*
	 * Primary TACH1 path. The alternate path below (pin_dtach1,
	 * ball R14) only takes effect while this ball's mux is not
	 * selecting TACH1 (datasheet: SCU428[22:20] not-equal 1).
	 */
	/omit-if-no-ref/ pin_tach1: pin_tach1 {
		ball = <N2>;
		sig_descs = <SIG_DESC(0x428, 20, 1)>;
		drive-strength-desc = <PINCFG_DESC(0x528, 20, 4)>;
		bias-disable-desc = <PINCFG_DESC(0x528, 16, 1)>;
		pull-up-disable-desc = <PINCFG_DESC(0x528, 18, 1)>;
	};
	/omit-if-no-ref/ pin_dtach1: pin_dtach1 {
		ball = <R14>;
		sig_descs = <SIG_DESC(0x40c, 20, 2)>;
		drive-strength-desc = <PINCFG_DESC(0x4b8, 20, 4)>;
		bias-disable-desc = <PINCFG_DESC(0x4b8, 16, 1)>;
		pull-up-disable-desc = <PINCFG_DESC(0x4b8, 18, 1)>;
	};
	/omit-if-no-ref/ pin_scl7: pin_scl7 {
		ball = <U15>;
		sig_descs = <SIG_DESC(0x40c, 24, 1)>;
		drive-strength-desc = <PINCFG_DESC(0x4bc, 4, 4)>;
		bias-disable-desc = <PINCFG_DESC(0x4bc, 0, 1)>;
		pull-up-disable-desc = <PINCFG_DESC(0x4bc, 2, 1)>;
	};
	/*
	 * Primary TACH2 path. The alternate path below (pin_dtach2,
	 * ball U15) only takes effect while this ball's mux is not
	 * selecting TACH2 (datasheet: SCU428[26:24] not-equal 1).
	 */
	/omit-if-no-ref/ pin_tach2: pin_tach2 {
		ball = <P2>;
		sig_descs = <SIG_DESC(0x428, 24, 1)>;
		drive-strength-desc = <PINCFG_DESC(0x52c, 4, 4)>;
		bias-disable-desc = <PINCFG_DESC(0x52c, 0, 1)>;
		pull-up-disable-desc = <PINCFG_DESC(0x52c, 2, 1)>;
	};
	/omit-if-no-ref/ pin_dtach2: pin_dtach2 {
		ball = <U15>;
		sig_descs = <SIG_DESC(0x40c, 24, 2)>;
		drive-strength-desc = <PINCFG_DESC(0x4bc, 4, 4)>;
		bias-disable-desc = <PINCFG_DESC(0x4bc, 0, 1)>;
		pull-up-disable-desc = <PINCFG_DESC(0x4bc, 2, 1)>;
	};
	/omit-if-no-ref/ pin_sda7: pin_sda7 {
		ball = <P13>;
		sig_descs = <SIG_DESC(0x40c, 28, 1)>;
		drive-strength-desc = <PINCFG_DESC(0x4bc, 20, 4)>;
		bias-disable-desc = <PINCFG_DESC(0x4bc, 16, 1)>;
		pull-up-disable-desc = <PINCFG_DESC(0x4bc, 18, 1)>;
	};
	/*
	 * Primary TACH3 path. The alternate path below (pin_dtach3,
	 * ball P13) only takes effect while this ball's mux is not
	 * selecting TACH3 (datasheet: SCU428[30:28] not-equal 1).
	 */
	/omit-if-no-ref/ pin_tach3: pin_tach3 {
		ball = <N4>;
		sig_descs = <SIG_DESC(0x428, 28, 1)>;
		drive-strength-desc = <PINCFG_DESC(0x52c, 20, 4)>;
		bias-disable-desc = <PINCFG_DESC(0x52c, 16, 1)>;
		pull-up-disable-desc = <PINCFG_DESC(0x52c, 18, 1)>;
	};
	/omit-if-no-ref/ pin_dtach3: pin_dtach3 {
		ball = <P13>;
		sig_descs = <SIG_DESC(0x40c, 28, 2)>;
		drive-strength-desc = <PINCFG_DESC(0x4bc, 20, 4)>;
		bias-disable-desc = <PINCFG_DESC(0x4bc, 16, 1)>;
		pull-up-disable-desc = <PINCFG_DESC(0x4bc, 18, 1)>;
	};
	/omit-if-no-ref/ pin_scl8: pin_scl8 {
		ball = <P14>;
		sig_descs = <SIG_DESC(0x410, 0, 1)>;
		drive-strength-desc = <PINCFG_DESC(0x4c0, 4, 4)>;
		bias-disable-desc = <PINCFG_DESC(0x4c0, 0, 1)>;
		pull-up-disable-desc = <PINCFG_DESC(0x4c0, 2, 1)>;
	};
	/omit-if-no-ref/ pin_sda8: pin_sda8 {
		ball = <R17>;
		sig_descs = <SIG_DESC(0x410, 4, 1)>;
		drive-strength-desc = <PINCFG_DESC(0x4c0, 20, 4)>;
		bias-disable-desc = <PINCFG_DESC(0x4c0, 16, 1)>;
		pull-up-disable-desc = <PINCFG_DESC(0x4c0, 18, 1)>;
	};
	/omit-if-no-ref/ pin_scl9: pin_scl9 {
		ball = <R16>;
		sig_descs = <SIG_DESC(0x410, 8, 1)>;
		drive-strength-desc = <PINCFG_DESC(0x4c4, 4, 4)>;
		bias-disable-desc = <PINCFG_DESC(0x4c4, 0, 1)>;
		pull-up-disable-desc = <PINCFG_DESC(0x4c4, 2, 1)>;
	};
	/omit-if-no-ref/ pin_sda9: pin_sda9 {
		ball = <N14>;
		sig_descs = <SIG_DESC(0x410, 12, 1)>;
		drive-strength-desc = <PINCFG_DESC(0x4c4, 20, 4)>;
		bias-disable-desc = <PINCFG_DESC(0x4c4, 16, 1)>;
		pull-up-disable-desc = <PINCFG_DESC(0x4c4, 18, 1)>;
	};
	/omit-if-no-ref/ pin_scl10: pin_scl10 {
		ball = <P16>;
		sig_descs = <SIG_DESC(0x410, 16, 1)>;
		drive-strength-desc = <PINCFG_DESC(0x4c8, 4, 4)>;
		bias-disable-desc = <PINCFG_DESC(0x4c8, 0, 1)>;
		pull-up-disable-desc = <PINCFG_DESC(0x4c8, 2, 1)>;
	};
	/omit-if-no-ref/ pin_smbf1sclin: pin_smbf1sclin {
		ball = <P16>;
		sig_descs = <SIG_DESC(0x410, 16, 3)>;
		drive-strength-desc = <PINCFG_DESC(0x4c8, 4, 4)>;
		bias-disable-desc = <PINCFG_DESC(0x4c8, 0, 1)>;
		pull-up-disable-desc = <PINCFG_DESC(0x4c8, 2, 1)>;
	};
	/omit-if-no-ref/ pin_sda10: pin_sda10 {
		ball = <N13>;
		sig_descs = <SIG_DESC(0x410, 20, 1)>;
		drive-strength-desc = <PINCFG_DESC(0x4c8, 20, 4)>;
		bias-disable-desc = <PINCFG_DESC(0x4c8, 16, 1)>;
		pull-up-disable-desc = <PINCFG_DESC(0x4c8, 18, 1)>;
	};
	/omit-if-no-ref/ pin_smbf1sdain: pin_smbf1sdain {
		ball = <N13>;
		sig_descs = <SIG_DESC(0x410, 20, 3)>;
		drive-strength-desc = <PINCFG_DESC(0x4c8, 20, 4)>;
		bias-disable-desc = <PINCFG_DESC(0x4c8, 16, 1)>;
		pull-up-disable-desc = <PINCFG_DESC(0x4c8, 18, 1)>;
	};
	/omit-if-no-ref/ pin_scl11: pin_scl11 {
		ball = <P17>;
		sig_descs = <SIG_DESC(0x410, 24, 1)>;
		drive-strength-desc = <PINCFG_DESC(0x4cc, 4, 4)>;
		bias-disable-desc = <PINCFG_DESC(0x4cc, 0, 1)>;
		pull-up-disable-desc = <PINCFG_DESC(0x4cc, 2, 1)>;
	};
	/omit-if-no-ref/ pin_smbf1sclout: pin_smbf1sclout {
		ball = <P17>;
		sig_descs = <SIG_DESC(0x410, 24, 3)>;
		drive-strength-desc = <PINCFG_DESC(0x4cc, 4, 4)>;
		bias-disable-desc = <PINCFG_DESC(0x4cc, 0, 1)>;
		pull-up-disable-desc = <PINCFG_DESC(0x4cc, 2, 1)>;
	};
	/omit-if-no-ref/ pin_sda11: pin_sda11 {
		ball = <M14>;
		sig_descs = <SIG_DESC(0x410, 28, 1)>;
		drive-strength-desc = <PINCFG_DESC(0x4cc, 20, 4)>;
		bias-disable-desc = <PINCFG_DESC(0x4cc, 16, 1)>;
		pull-up-disable-desc = <PINCFG_DESC(0x4cc, 18, 1)>;
	};
	/omit-if-no-ref/ pin_smbf1sdaout: pin_smbf1sdaout {
		ball = <M14>;
		sig_descs = <SIG_DESC(0x410, 28, 3)>;
		drive-strength-desc = <PINCFG_DESC(0x4cc, 20, 4)>;
		bias-disable-desc = <PINCFG_DESC(0x4cc, 16, 1)>;
		pull-up-disable-desc = <PINCFG_DESC(0x4cc, 18, 1)>;
	};
	/omit-if-no-ref/ pin_scl12: pin_scl12 {
		ball = <N16>;
		sig_descs = <SIG_DESC(0x414, 0, 1)>;
		drive-strength-desc = <PINCFG_DESC(0x4d0, 4, 4)>;
		bias-disable-desc = <PINCFG_DESC(0x4d0, 0, 1)>;
		pull-up-disable-desc = <PINCFG_DESC(0x4d0, 2, 1)>;
	};
	/omit-if-no-ref/ pin_smbf2sclin: pin_smbf2sclin {
		ball = <N16>;
		sig_descs = <SIG_DESC(0x414, 0, 3)>;
		drive-strength-desc = <PINCFG_DESC(0x4d0, 4, 4)>;
		bias-disable-desc = <PINCFG_DESC(0x4d0, 0, 1)>;
		pull-up-disable-desc = <PINCFG_DESC(0x4d0, 2, 1)>;
	};
	/omit-if-no-ref/ pin_sda12: pin_sda12 {
		ball = <N17>;
		sig_descs = <SIG_DESC(0x414, 4, 1)>;
		drive-strength-desc = <PINCFG_DESC(0x4d0, 20, 4)>;
		bias-disable-desc = <PINCFG_DESC(0x4d0, 16, 1)>;
		pull-up-disable-desc = <PINCFG_DESC(0x4d0, 18, 1)>;
	};
	/omit-if-no-ref/ pin_smbf2sdain: pin_smbf2sdain {
		ball = <N17>;
		sig_descs = <SIG_DESC(0x414, 4, 3)>;
		drive-strength-desc = <PINCFG_DESC(0x4d0, 20, 4)>;
		bias-disable-desc = <PINCFG_DESC(0x4d0, 16, 1)>;
		pull-up-disable-desc = <PINCFG_DESC(0x4d0, 18, 1)>;
	};
	/omit-if-no-ref/ pin_scl13: pin_scl13 {
		ball = <M15>;
		sig_descs = <SIG_DESC(0x414, 8, 1)>;
		drive-strength-desc = <PINCFG_DESC(0x4d4, 4, 4)>;
		bias-disable-desc = <PINCFG_DESC(0x4d4, 0, 1)>;
		pull-up-disable-desc = <PINCFG_DESC(0x4d4, 2, 1)>;
	};
	/omit-if-no-ref/ pin_smbf2sclout: pin_smbf2sclout {
		ball = <M15>;
		sig_descs = <SIG_DESC(0x414, 8, 3)>;
		drive-strength-desc = <PINCFG_DESC(0x4d4, 4, 4)>;
		bias-disable-desc = <PINCFG_DESC(0x4d4, 0, 1)>;
		pull-up-disable-desc = <PINCFG_DESC(0x4d4, 2, 1)>;
	};
	/omit-if-no-ref/ pin_sda13: pin_sda13 {
		ball = <M16>;
		sig_descs = <SIG_DESC(0x414, 12, 1)>;
		drive-strength-desc = <PINCFG_DESC(0x4d4, 20, 4)>;
		bias-disable-desc = <PINCFG_DESC(0x4d4, 16, 1)>;
		pull-up-disable-desc = <PINCFG_DESC(0x4d4, 18, 1)>;
	};
	/omit-if-no-ref/ pin_smbf2sdaout: pin_smbf2sdaout {
		ball = <M16>;
		sig_descs = <SIG_DESC(0x414, 12, 3)>;
		drive-strength-desc = <PINCFG_DESC(0x4d4, 20, 4)>;
		bias-disable-desc = <PINCFG_DESC(0x4d4, 16, 1)>;
		pull-up-disable-desc = <PINCFG_DESC(0x4d4, 18, 1)>;
	};
	/omit-if-no-ref/ pin_spif1cs0_o: pin_spif1cs0_o {
		ball = <F3>;
		sig_descs = <SIG_DESC(0x414, 16, 2)>;
		drive-strength-desc = <PINCFG_DESC(0x4d8, 4, 4)>;
		bias-disable-desc = <PINCFG_DESC(0x4d8, 0, 1)>;
		pull-up-disable-desc = <PINCFG_DESC(0x4d8, 2, 1)>;
	};
	/omit-if-no-ref/ pin_salt10: pin_salt10 {
		ball = <F3>;
		sig_descs = <SIG_DESC(0x414, 16, 3)>;
		drive-strength-desc = <PINCFG_DESC(0x4d8, 4, 4)>;
		bias-disable-desc = <PINCFG_DESC(0x4d8, 0, 1)>;
		pull-up-disable-desc = <PINCFG_DESC(0x4d8, 2, 1)>;
	};
	/omit-if-no-ref/ pin_spif1cs1_o: pin_spif1cs1_o {
		ball = <G5>;
		sig_descs = <SIG_DESC(0x414, 20, 2)>;
		drive-strength-desc = <PINCFG_DESC(0x4d8, 20, 4)>;
		bias-disable-desc = <PINCFG_DESC(0x4d8, 16, 1)>;
		pull-up-disable-desc = <PINCFG_DESC(0x4d8, 18, 1)>;
	};
	/omit-if-no-ref/ pin_salt11: pin_salt11 {
		ball = <G5>;
		sig_descs = <SIG_DESC(0x414, 20, 3)>;
		drive-strength-desc = <PINCFG_DESC(0x4d8, 20, 4)>;
		bias-disable-desc = <PINCFG_DESC(0x4d8, 16, 1)>;
		pull-up-disable-desc = <PINCFG_DESC(0x4d8, 18, 1)>;
	};
	/omit-if-no-ref/ pin_spif1ck_o: pin_spif1ck_o {
		ball = <G4>;
		sig_descs = <SIG_DESC(0x414, 24, 2)>;
		drive-strength-desc = <PINCFG_DESC(0x4dc, 4, 4)>;
		bias-disable-desc = <PINCFG_DESC(0x4dc, 0, 1)>;
		pull-up-disable-desc = <PINCFG_DESC(0x4dc, 2, 1)>;
	};
	/omit-if-no-ref/ pin_salt12: pin_salt12 {
		ball = <G4>;
		sig_descs = <SIG_DESC(0x414, 24, 3)>;
		drive-strength-desc = <PINCFG_DESC(0x4dc, 4, 4)>;
		bias-disable-desc = <PINCFG_DESC(0x4dc, 0, 1)>;
		pull-up-disable-desc = <PINCFG_DESC(0x4dc, 2, 1)>;
	};
	/omit-if-no-ref/ pin_spif1dq0_o: pin_spif1dq0_o {
		ball = <H4>;
		sig_descs = <SIG_DESC(0x414, 28, 2)>;
		drive-strength-desc = <PINCFG_DESC(0x4dc, 20, 4)>;
		bias-disable-desc = <PINCFG_DESC(0x4dc, 16, 1)>;
		pull-up-disable-desc = <PINCFG_DESC(0x4dc, 18, 1)>;
	};
	/omit-if-no-ref/ pin_salt13: pin_salt13 {
		ball = <H4>;
		sig_descs = <SIG_DESC(0x414, 28, 3)>;
		drive-strength-desc = <PINCFG_DESC(0x4dc, 20, 4)>;
		bias-disable-desc = <PINCFG_DESC(0x4dc, 16, 1)>;
		pull-up-disable-desc = <PINCFG_DESC(0x4dc, 18, 1)>;
	};
	/omit-if-no-ref/ pin_spif1dq1_o: pin_spif1dq1_o {
		ball = <H5>;
		sig_descs = <SIG_DESC(0x418, 0, 2)>;
		drive-strength-desc = <PINCFG_DESC(0x4e0, 4, 4)>;
		bias-disable-desc = <PINCFG_DESC(0x4e0, 0, 1)>;
		pull-up-disable-desc = <PINCFG_DESC(0x4e0, 2, 1)>;
	};
	/omit-if-no-ref/ pin_salt0: pin_salt0 {
		ball = <H5>;
		sig_descs = <SIG_DESC(0x418, 0, 3)>;
		drive-strength-desc = <PINCFG_DESC(0x4e0, 4, 4)>;
		bias-disable-desc = <PINCFG_DESC(0x4e0, 0, 1)>;
		pull-up-disable-desc = <PINCFG_DESC(0x4e0, 2, 1)>;
	};
	/omit-if-no-ref/ pin_ncts0: pin_ncts0 {
		ball = <H5>;
		sig_descs = <SIG_DESC(0x418, 0, 4)>;
		drive-strength-desc = <PINCFG_DESC(0x4e0, 4, 4)>;
		bias-disable-desc = <PINCFG_DESC(0x4e0, 0, 1)>;
		pull-up-disable-desc = <PINCFG_DESC(0x4e0, 2, 1)>;
	};
	/omit-if-no-ref/ pin_spif1dq2_o: pin_spif1dq2_o {
		ball = <J3>;
		sig_descs = <SIG_DESC(0x418, 4, 2)>;
		drive-strength-desc = <PINCFG_DESC(0x4e0, 20, 4)>;
		bias-disable-desc = <PINCFG_DESC(0x4e0, 16, 1)>;
		pull-up-disable-desc = <PINCFG_DESC(0x4e0, 18, 1)>;
	};
	/omit-if-no-ref/ pin_salt1: pin_salt1 {
		ball = <J3>;
		sig_descs = <SIG_DESC(0x418, 4, 3)>;
		drive-strength-desc = <PINCFG_DESC(0x4e0, 20, 4)>;
		bias-disable-desc = <PINCFG_DESC(0x4e0, 16, 1)>;
		pull-up-disable-desc = <PINCFG_DESC(0x4e0, 18, 1)>;
	};
	/omit-if-no-ref/ pin_nrts0: pin_nrts0 {
		ball = <J3>;
		sig_descs = <SIG_DESC(0x418, 4, 4)>;
		drive-strength-desc = <PINCFG_DESC(0x4e0, 20, 4)>;
		bias-disable-desc = <PINCFG_DESC(0x4e0, 16, 1)>;
		pull-up-disable-desc = <PINCFG_DESC(0x4e0, 18, 1)>;
	};
	/omit-if-no-ref/ pin_spif1dq3_o: pin_spif1dq3_o {
		ball = <K3>;
		sig_descs = <SIG_DESC(0x418, 8, 2)>;
		drive-strength-desc = <PINCFG_DESC(0x4e4, 4, 4)>;
		bias-disable-desc = <PINCFG_DESC(0x4e4, 0, 1)>;
		pull-up-disable-desc = <PINCFG_DESC(0x4e4, 2, 1)>;
	};
	/omit-if-no-ref/ pin_salt2: pin_salt2 {
		ball = <K3>;
		sig_descs = <SIG_DESC(0x418, 8, 3)>;
		drive-strength-desc = <PINCFG_DESC(0x4e4, 4, 4)>;
		bias-disable-desc = <PINCFG_DESC(0x4e4, 0, 1)>;
		pull-up-disable-desc = <PINCFG_DESC(0x4e4, 2, 1)>;
	};
	/omit-if-no-ref/ pin_ncts1: pin_ncts1 {
		ball = <K3>;
		sig_descs = <SIG_DESC(0x418, 8, 4)>;
		drive-strength-desc = <PINCFG_DESC(0x4e4, 4, 4)>;
		bias-disable-desc = <PINCFG_DESC(0x4e4, 0, 1)>;
		pull-up-disable-desc = <PINCFG_DESC(0x4e4, 2, 1)>;
	};
	/omit-if-no-ref/ pin_spif1cs0_i: pin_spif1cs0_i {
		ball = <F4>;
		sig_descs = <SIG_DESC(0x418, 12, 2)>;
		drive-strength-desc = <PINCFG_DESC(0x4e4, 20, 4)>;
		bias-disable-desc = <PINCFG_DESC(0x4e4, 16, 1)>;
		pull-up-disable-desc = <PINCFG_DESC(0x4e4, 18, 1)>;
	};
	/omit-if-no-ref/ pin_salt3: pin_salt3 {
		ball = <F4>;
		sig_descs = <SIG_DESC(0x418, 12, 3)>;
		drive-strength-desc = <PINCFG_DESC(0x4e4, 20, 4)>;
		bias-disable-desc = <PINCFG_DESC(0x4e4, 16, 1)>;
		pull-up-disable-desc = <PINCFG_DESC(0x4e4, 18, 1)>;
	};
	/omit-if-no-ref/ pin_nrts1: pin_nrts1 {
		ball = <F4>;
		sig_descs = <SIG_DESC(0x418, 12, 4)>;
		drive-strength-desc = <PINCFG_DESC(0x4e4, 20, 4)>;
		bias-disable-desc = <PINCFG_DESC(0x4e4, 16, 1)>;
		pull-up-disable-desc = <PINCFG_DESC(0x4e4, 18, 1)>;
	};
	/omit-if-no-ref/ pin_txd4: pin_txd4 {
		ball = <G1>;
		sig_descs = <SIG_DESC(0x418, 16, 1)>;
		drive-strength-desc = <PINCFG_DESC(0x4e8, 4, 4)>;
		bias-disable-desc = <PINCFG_DESC(0x4e8, 0, 1)>;
		pull-up-disable-desc = <PINCFG_DESC(0x4e8, 2, 1)>;
	};
	/omit-if-no-ref/ pin_spif1cs1_i: pin_spif1cs1_i {
		ball = <G1>;
		sig_descs = <SIG_DESC(0x418, 16, 2)>;
		drive-strength-desc = <PINCFG_DESC(0x4e8, 4, 4)>;
		bias-disable-desc = <PINCFG_DESC(0x4e8, 0, 1)>;
		pull-up-disable-desc = <PINCFG_DESC(0x4e8, 2, 1)>;
	};
	/omit-if-no-ref/ pin_salt4: pin_salt4 {
		ball = <G1>;
		sig_descs = <SIG_DESC(0x418, 16, 3)>;
		drive-strength-desc = <PINCFG_DESC(0x4e8, 4, 4)>;
		bias-disable-desc = <PINCFG_DESC(0x4e8, 0, 1)>;
		pull-up-disable-desc = <PINCFG_DESC(0x4e8, 2, 1)>;
	};
	/omit-if-no-ref/ pin_siopwreq: pin_siopwreq {
		ball = <G1>;
		sig_descs = <SIG_DESC(0x418, 16, 4)>;
		drive-strength-desc = <PINCFG_DESC(0x4e8, 4, 4)>;
		bias-disable-desc = <PINCFG_DESC(0x4e8, 0, 1)>;
		pull-up-disable-desc = <PINCFG_DESC(0x4e8, 2, 1)>;
	};
	/omit-if-no-ref/ pin_rxd4: pin_rxd4 {
		ball = <G3>;
		sig_descs = <SIG_DESC(0x418, 20, 1)>;
		drive-strength-desc = <PINCFG_DESC(0x4e8, 20, 4)>;
		bias-disable-desc = <PINCFG_DESC(0x4e8, 16, 1)>;
		pull-up-disable-desc = <PINCFG_DESC(0x4e8, 18, 1)>;
	};
	/omit-if-no-ref/ pin_spif1ck_i: pin_spif1ck_i {
		ball = <G3>;
		sig_descs = <SIG_DESC(0x418, 20, 2)>;
		drive-strength-desc = <PINCFG_DESC(0x4e8, 20, 4)>;
		bias-disable-desc = <PINCFG_DESC(0x4e8, 16, 1)>;
		pull-up-disable-desc = <PINCFG_DESC(0x4e8, 18, 1)>;
	};
	/omit-if-no-ref/ pin_salt5: pin_salt5 {
		ball = <G3>;
		sig_descs = <SIG_DESC(0x418, 20, 3)>;
		drive-strength-desc = <PINCFG_DESC(0x4e8, 20, 4)>;
		bias-disable-desc = <PINCFG_DESC(0x4e8, 16, 1)>;
		pull-up-disable-desc = <PINCFG_DESC(0x4e8, 18, 1)>;
	};
	/omit-if-no-ref/ pin_sios5: pin_sios5 {
		ball = <G3>;
		sig_descs = <SIG_DESC(0x418, 20, 4)>;
		drive-strength-desc = <PINCFG_DESC(0x4e8, 20, 4)>;
		bias-disable-desc = <PINCFG_DESC(0x4e8, 16, 1)>;
		pull-up-disable-desc = <PINCFG_DESC(0x4e8, 18, 1)>;
	};
	/omit-if-no-ref/ pin_txd5_g2: pin_txd5_g2 {
		ball = <G2>;
		sig_descs = <SIG_DESC(0x418, 24, 1)>;
		drive-strength-desc = <PINCFG_DESC(0x4ec, 4, 4)>;
		bias-disable-desc = <PINCFG_DESC(0x4ec, 0, 1)>;
		pull-up-disable-desc = <PINCFG_DESC(0x4ec, 2, 1)>;
	};
	/omit-if-no-ref/ pin_spif1dq0_i: pin_spif1dq0_i {
		ball = <G2>;
		sig_descs = <SIG_DESC(0x418, 24, 2)>;
		drive-strength-desc = <PINCFG_DESC(0x4ec, 4, 4)>;
		bias-disable-desc = <PINCFG_DESC(0x4ec, 0, 1)>;
		pull-up-disable-desc = <PINCFG_DESC(0x4ec, 2, 1)>;
	};
	/omit-if-no-ref/ pin_rxd5_h1: pin_rxd5_h1 {
		ball = <H1>;
		sig_descs = <SIG_DESC(0x418, 28, 1)>;
		drive-strength-desc = <PINCFG_DESC(0x4ec, 20, 4)>;
		bias-disable-desc = <PINCFG_DESC(0x4ec, 16, 1)>;
		pull-up-disable-desc = <PINCFG_DESC(0x4ec, 18, 1)>;
	};
	/omit-if-no-ref/ pin_spif1dq1_i: pin_spif1dq1_i {
		ball = <H1>;
		sig_descs = <SIG_DESC(0x418, 28, 2)>;
		drive-strength-desc = <PINCFG_DESC(0x4ec, 20, 4)>;
		bias-disable-desc = <PINCFG_DESC(0x4ec, 16, 1)>;
		pull-up-disable-desc = <PINCFG_DESC(0x4ec, 18, 1)>;
	};
	/omit-if-no-ref/ pin_txd6_h3: pin_txd6_h3 {
		ball = <H3>;
		sig_descs = <SIG_DESC(0x41c, 0, 1)>;
		drive-strength-desc = <PINCFG_DESC(0x4f0, 4, 4)>;
		bias-disable-desc = <PINCFG_DESC(0x4f0, 0, 1)>;
		pull-up-disable-desc = <PINCFG_DESC(0x4f0, 2, 1)>;
	};
	/omit-if-no-ref/ pin_spif1dq2_i: pin_spif1dq2_i {
		ball = <H3>;
		sig_descs = <SIG_DESC(0x41c, 0, 2)>;
		drive-strength-desc = <PINCFG_DESC(0x4f0, 4, 4)>;
		bias-disable-desc = <PINCFG_DESC(0x4f0, 0, 1)>;
		pull-up-disable-desc = <PINCFG_DESC(0x4f0, 2, 1)>;
	};
	/omit-if-no-ref/ pin_rxd6_h2: pin_rxd6_h2 {
		ball = <H2>;
		sig_descs = <SIG_DESC(0x41c, 4, 1)>;
		drive-strength-desc = <PINCFG_DESC(0x4f0, 20, 4)>;
		bias-disable-desc = <PINCFG_DESC(0x4f0, 16, 1)>;
		pull-up-disable-desc = <PINCFG_DESC(0x4f0, 18, 1)>;
	};
	/omit-if-no-ref/ pin_spif1dq3_i: pin_spif1dq3_i {
		ball = <H2>;
		sig_descs = <SIG_DESC(0x41c, 4, 2)>;
		drive-strength-desc = <PINCFG_DESC(0x4f0, 20, 4)>;
		bias-disable-desc = <PINCFG_DESC(0x4f0, 16, 1)>;
		pull-up-disable-desc = <PINCFG_DESC(0x4f0, 18, 1)>;
	};
	/omit-if-no-ref/ pin_txd7: pin_txd7 {
		ball = <R4>;
		sig_descs = <SIG_DESC(0x41c, 8, 1)>;
		drive-strength-desc = <PINCFG_DESC(0x4f4, 4, 4)>;
		bias-disable-desc = <PINCFG_DESC(0x4f4, 0, 1)>;
		pull-up-disable-desc = <PINCFG_DESC(0x4f4, 2, 1)>;
	};
	/omit-if-no-ref/ pin_ci3csda: pin_ci3csda {
		ball = <R4>;
		sig_descs = <SIG_DESC(0x41c, 8, 3)>;
		drive-strength-desc = <PINCFG_DESC(0x4f4, 4, 4)>;
		bias-disable-desc = <PINCFG_DESC(0x4f4, 0, 1)>;
		pull-up-disable-desc = <PINCFG_DESC(0x4f4, 2, 1)>;
	};
	/omit-if-no-ref/ pin_sioonctrl: pin_sioonctrl {
		ball = <R4>;
		sig_descs = <SIG_DESC(0x41c, 8, 4)>;
		drive-strength-desc = <PINCFG_DESC(0x4f4, 4, 4)>;
		bias-disable-desc = <PINCFG_DESC(0x4f4, 0, 1)>;
		pull-up-disable-desc = <PINCFG_DESC(0x4f4, 2, 1)>;
	};
	/omit-if-no-ref/ pin_rxd7: pin_rxd7 {
		ball = <T4>;
		sig_descs = <SIG_DESC(0x41c, 12, 1)>;
		drive-strength-desc = <PINCFG_DESC(0x4f4, 20, 4)>;
		bias-disable-desc = <PINCFG_DESC(0x4f4, 16, 1)>;
		pull-up-disable-desc = <PINCFG_DESC(0x4f4, 18, 1)>;
	};
	/omit-if-no-ref/ pin_ci3cscl: pin_ci3cscl {
		ball = <T4>;
		sig_descs = <SIG_DESC(0x41c, 12, 3)>;
		drive-strength-desc = <PINCFG_DESC(0x4f4, 20, 4)>;
		bias-disable-desc = <PINCFG_DESC(0x4f4, 16, 1)>;
		pull-up-disable-desc = <PINCFG_DESC(0x4f4, 18, 1)>;
	};
	/omit-if-no-ref/ pin_siopwrgd: pin_siopwrgd {
		ball = <T4>;
		sig_descs = <SIG_DESC(0x41c, 12, 4)>;
		drive-strength-desc = <PINCFG_DESC(0x4f4, 20, 4)>;
		bias-disable-desc = <PINCFG_DESC(0x4f4, 16, 1)>;
		pull-up-disable-desc = <PINCFG_DESC(0x4f4, 18, 1)>;
	};
	/omit-if-no-ref/ pin_txd8: pin_txd8 {
		ball = <M17>;
		sig_descs = <SIG_DESC(0x41c, 16, 1)>;
		drive-strength-desc = <PINCFG_DESC(0x4f8, 4, 4)>;
		bias-disable-desc = <PINCFG_DESC(0x4f8, 0, 1)>;
		pull-up-disable-desc = <PINCFG_DESC(0x4f8, 2, 1)>;
	};
	/omit-if-no-ref/ pin_salt6: pin_salt6 {
		ball = <M17>;
		sig_descs = <SIG_DESC(0x41c, 16, 3)>;
		drive-strength-desc = <PINCFG_DESC(0x4f8, 4, 4)>;
		bias-disable-desc = <PINCFG_DESC(0x4f8, 0, 1)>;
		pull-up-disable-desc = <PINCFG_DESC(0x4f8, 2, 1)>;
	};
	/*
	 * Primary PWM12 path. The alternate path below (pin_dpwm12,
	 * ball M17) only takes effect while this ball's mux is not
	 * selecting PWM12 (datasheet: SCU428[02:00] not-equal 1).
	 */
	/omit-if-no-ref/ pin_pwm12: pin_pwm12 {
		ball = <N5>;
		sig_descs = <SIG_DESC(0x428, 0, 1)>;
		drive-strength-desc = <PINCFG_DESC(0x520, 4, 4)>;
		bias-disable-desc = <PINCFG_DESC(0x520, 0, 1)>;
		pull-up-disable-desc = <PINCFG_DESC(0x520, 2, 1)>;
	};
	/omit-if-no-ref/ pin_dpwm12: pin_dpwm12 {
		ball = <M17>;
		sig_descs = <SIG_DESC(0x41c, 16, 4)>;
		drive-strength-desc = <PINCFG_DESC(0x4f8, 4, 4)>;
		bias-disable-desc = <PINCFG_DESC(0x4f8, 0, 1)>;
		pull-up-disable-desc = <PINCFG_DESC(0x4f8, 2, 1)>;
	};
	/omit-if-no-ref/ pin_rxd8: pin_rxd8 {
		ball = <L14>;
		sig_descs = <SIG_DESC(0x41c, 20, 1)>;
		drive-strength-desc = <PINCFG_DESC(0x4f8, 20, 4)>;
		bias-disable-desc = <PINCFG_DESC(0x4f8, 16, 1)>;
		pull-up-disable-desc = <PINCFG_DESC(0x4f8, 18, 1)>;
	};
	/omit-if-no-ref/ pin_salt7: pin_salt7 {
		ball = <L14>;
		sig_descs = <SIG_DESC(0x41c, 20, 3)>;
		drive-strength-desc = <PINCFG_DESC(0x4f8, 20, 4)>;
		bias-disable-desc = <PINCFG_DESC(0x4f8, 16, 1)>;
		pull-up-disable-desc = <PINCFG_DESC(0x4f8, 18, 1)>;
	};
	/*
	 * Primary PWM13 path. The alternate path below (pin_dpwm13,
	 * ball L14) only takes effect while this ball's mux is not
	 * selecting PWM13 (datasheet: SCU428[06:04] not-equal 1).
	 */
	/omit-if-no-ref/ pin_pwm13: pin_pwm13 {
		ball = <R1>;
		sig_descs = <SIG_DESC(0x428, 4, 1)>;
		drive-strength-desc = <PINCFG_DESC(0x520, 20, 4)>;
		bias-disable-desc = <PINCFG_DESC(0x520, 16, 1)>;
		pull-up-disable-desc = <PINCFG_DESC(0x520, 18, 1)>;
	};
	/omit-if-no-ref/ pin_dpwm13: pin_dpwm13 {
		ball = <L14>;
		sig_descs = <SIG_DESC(0x41c, 20, 4)>;
		drive-strength-desc = <PINCFG_DESC(0x4f8, 20, 4)>;
		bias-disable-desc = <PINCFG_DESC(0x4f8, 16, 1)>;
		pull-up-disable-desc = <PINCFG_DESC(0x4f8, 18, 1)>;
	};
	/omit-if-no-ref/ pin_txd9: pin_txd9 {
		ball = <L15>;
		sig_descs = <SIG_DESC(0x41c, 24, 1)>;
		drive-strength-desc = <PINCFG_DESC(0x4fc, 4, 4)>;
		bias-disable-desc = <PINCFG_DESC(0x4fc, 0, 1)>;
		pull-up-disable-desc = <PINCFG_DESC(0x4fc, 2, 1)>;
	};
	/omit-if-no-ref/ pin_salt8: pin_salt8 {
		ball = <L15>;
		sig_descs = <SIG_DESC(0x41c, 24, 3)>;
		drive-strength-desc = <PINCFG_DESC(0x4fc, 4, 4)>;
		bias-disable-desc = <PINCFG_DESC(0x4fc, 0, 1)>;
		pull-up-disable-desc = <PINCFG_DESC(0x4fc, 2, 1)>;
	};
	/*
	 * Primary PWM14 path. The alternate path below (pin_dpwm14,
	 * ball L15) only takes effect while this ball's mux is not
	 * selecting PWM14 (datasheet: SCU428[10:08] not-equal 1).
	 */
	/omit-if-no-ref/ pin_pwm14: pin_pwm14 {
		ball = <L2>;
		sig_descs = <SIG_DESC(0x428, 8, 1)>;
		drive-strength-desc = <PINCFG_DESC(0x524, 4, 4)>;
		bias-disable-desc = <PINCFG_DESC(0x524, 0, 1)>;
		pull-up-disable-desc = <PINCFG_DESC(0x524, 2, 1)>;
	};
	/omit-if-no-ref/ pin_dpwm14: pin_dpwm14 {
		ball = <L15>;
		sig_descs = <SIG_DESC(0x41c, 24, 4)>;
		drive-strength-desc = <PINCFG_DESC(0x4fc, 4, 4)>;
		bias-disable-desc = <PINCFG_DESC(0x4fc, 0, 1)>;
		pull-up-disable-desc = <PINCFG_DESC(0x4fc, 2, 1)>;
	};
	/omit-if-no-ref/ pin_rxd9: pin_rxd9 {
		ball = <L16>;
		sig_descs = <SIG_DESC(0x41c, 28, 1)>;
		drive-strength-desc = <PINCFG_DESC(0x4fc, 20, 4)>;
		bias-disable-desc = <PINCFG_DESC(0x4fc, 16, 1)>;
		pull-up-disable-desc = <PINCFG_DESC(0x4fc, 18, 1)>;
	};
	/omit-if-no-ref/ pin_salt9: pin_salt9 {
		ball = <L16>;
		sig_descs = <SIG_DESC(0x41c, 28, 3)>;
		drive-strength-desc = <PINCFG_DESC(0x4fc, 20, 4)>;
		bias-disable-desc = <PINCFG_DESC(0x4fc, 16, 1)>;
		pull-up-disable-desc = <PINCFG_DESC(0x4fc, 18, 1)>;
	};
	/*
	 * Primary PWM15 path. The alternate path below (pin_dpwm15,
	 * ball L16) only takes effect while this ball's mux is not
	 * selecting PWM15 (datasheet: SCU428[14:12] not-equal 1).
	 */
	/omit-if-no-ref/ pin_pwm15: pin_pwm15 {
		ball = <M2>;
		sig_descs = <SIG_DESC(0x428, 12, 1)>;
		drive-strength-desc = <PINCFG_DESC(0x524, 20, 4)>;
		bias-disable-desc = <PINCFG_DESC(0x524, 16, 1)>;
		pull-up-disable-desc = <PINCFG_DESC(0x524, 18, 1)>;
	};
	/omit-if-no-ref/ pin_dpwm15: pin_dpwm15 {
		ball = <L16>;
		sig_descs = <SIG_DESC(0x41c, 28, 4)>;
		drive-strength-desc = <PINCFG_DESC(0x4fc, 20, 4)>;
		bias-disable-desc = <PINCFG_DESC(0x4fc, 16, 1)>;
		pull-up-disable-desc = <PINCFG_DESC(0x4fc, 18, 1)>;
	};
	/omit-if-no-ref/ pin_txd10: pin_txd10 {
		ball = <L17>;
		sig_descs = <SIG_DESC(0x420, 0, 1)>;
		drive-strength-desc = <PINCFG_DESC(0x500, 4, 4)>;
		bias-disable-desc = <PINCFG_DESC(0x500, 0, 1)>;
		pull-up-disable-desc = <PINCFG_DESC(0x500, 2, 1)>;
	};
	/*
	 * Primary TACH12 path. The alternate path below (pin_dtach12,
	 * ball L17) only takes effect while this ball's mux is not
	 * selecting TACH12 (datasheet: SCU430[02:00] not-equal 1).
	 */
	/omit-if-no-ref/ pin_tach12: pin_tach12 {
		ball = <G17>;
		sig_descs = <SIG_DESC(0x430, 0, 1)>;
		drive-strength-desc = <PINCFG_DESC(0x540, 4, 4)>;
		bias-disable-desc = <PINCFG_DESC(0x540, 0, 1)>;
		pull-up-disable-desc = <PINCFG_DESC(0x540, 2, 1)>;
	};
	/omit-if-no-ref/ pin_dtach12: pin_dtach12 {
		ball = <L17>;
		sig_descs = <SIG_DESC(0x420, 0, 4)>;
		drive-strength-desc = <PINCFG_DESC(0x500, 4, 4)>;
		bias-disable-desc = <PINCFG_DESC(0x500, 0, 1)>;
		pull-up-disable-desc = <PINCFG_DESC(0x500, 2, 1)>;
	};
	/omit-if-no-ref/ pin_rxd10: pin_rxd10 {
		ball = <K16>;
		sig_descs = <SIG_DESC(0x420, 4, 1)>;
		drive-strength-desc = <PINCFG_DESC(0x500, 20, 4)>;
		bias-disable-desc = <PINCFG_DESC(0x500, 16, 1)>;
		pull-up-disable-desc = <PINCFG_DESC(0x500, 18, 1)>;
	};
	/*
	 * Primary TACH13 path. The alternate path below (pin_dtach13,
	 * ball K16) only takes effect while this ball's mux is not
	 * selecting TACH13 (datasheet: SCU430[06:04] not-equal 1).
	 */
	/omit-if-no-ref/ pin_tach13: pin_tach13 {
		ball = <H14>;
		sig_descs = <SIG_DESC(0x430, 4, 1)>;
		drive-strength-desc = <PINCFG_DESC(0x540, 20, 4)>;
		bias-disable-desc = <PINCFG_DESC(0x540, 16, 1)>;
		pull-up-disable-desc = <PINCFG_DESC(0x540, 18, 1)>;
	};
	/omit-if-no-ref/ pin_dtach13: pin_dtach13 {
		ball = <K16>;
		sig_descs = <SIG_DESC(0x420, 4, 4)>;
		drive-strength-desc = <PINCFG_DESC(0x500, 20, 4)>;
		bias-disable-desc = <PINCFG_DESC(0x500, 16, 1)>;
		pull-up-disable-desc = <PINCFG_DESC(0x500, 18, 1)>;
	};
	/omit-if-no-ref/ pin_txd11: pin_txd11 {
		ball = <K14>;
		sig_descs = <SIG_DESC(0x420, 8, 1)>;
		drive-strength-desc = <PINCFG_DESC(0x504, 4, 4)>;
		bias-disable-desc = <PINCFG_DESC(0x504, 0, 1)>;
		pull-up-disable-desc = <PINCFG_DESC(0x504, 2, 1)>;
	};
	/*
	 * Primary TACH14 path. The alternate path below (pin_dtach14,
	 * ball K14) only takes effect while this ball's mux is not
	 * selecting TACH14 (datasheet: SCU430[10:08] not-equal 1).
	 */
	/omit-if-no-ref/ pin_tach14: pin_tach14 {
		ball = <G16>;
		sig_descs = <SIG_DESC(0x430, 8, 1)>;
		drive-strength-desc = <PINCFG_DESC(0x544, 4, 4)>;
		bias-disable-desc = <PINCFG_DESC(0x544, 0, 1)>;
		pull-up-disable-desc = <PINCFG_DESC(0x544, 2, 1)>;
	};
	/omit-if-no-ref/ pin_dtach14: pin_dtach14 {
		ball = <K14>;
		sig_descs = <SIG_DESC(0x420, 8, 4)>;
		drive-strength-desc = <PINCFG_DESC(0x504, 4, 4)>;
		bias-disable-desc = <PINCFG_DESC(0x504, 0, 1)>;
		pull-up-disable-desc = <PINCFG_DESC(0x504, 2, 1)>;
	};
	/omit-if-no-ref/ pin_rxd11: pin_rxd11 {
		ball = <K15>;
		sig_descs = <SIG_DESC(0x420, 12, 1)>;
		drive-strength-desc = <PINCFG_DESC(0x504, 20, 4)>;
		bias-disable-desc = <PINCFG_DESC(0x504, 16, 1)>;
		pull-up-disable-desc = <PINCFG_DESC(0x504, 18, 1)>;
	};
	/*
	 * Primary TACH15 path. The alternate path below (pin_dtach15,
	 * ball K15) only takes effect while this ball's mux is not
	 * selecting TACH15 (datasheet: SCU430[14:12] not-equal 1).
	 */
	/omit-if-no-ref/ pin_tach15: pin_tach15 {
		ball = <F17>;
		sig_descs = <SIG_DESC(0x430, 12, 1)>;
		drive-strength-desc = <PINCFG_DESC(0x544, 20, 4)>;
		bias-disable-desc = <PINCFG_DESC(0x544, 16, 1)>;
		pull-up-disable-desc = <PINCFG_DESC(0x544, 18, 1)>;
	};
	/omit-if-no-ref/ pin_dtach15: pin_dtach15 {
		ball = <K15>;
		sig_descs = <SIG_DESC(0x420, 12, 4)>;
		drive-strength-desc = <PINCFG_DESC(0x504, 20, 4)>;
		bias-disable-desc = <PINCFG_DESC(0x504, 16, 1)>;
		pull-up-disable-desc = <PINCFG_DESC(0x504, 18, 1)>;
	};
	/omit-if-no-ref/ pin_pwm8: pin_pwm8 {
		ball = <N6>;
		sig_descs = <SIG_DESC(0x424, 16, 1)>;
		drive-strength-desc = <PINCFG_DESC(0x518, 4, 4)>;
		bias-disable-desc = <PINCFG_DESC(0x518, 0, 1)>;
		pull-up-disable-desc = <PINCFG_DESC(0x518, 2, 1)>;
	};
	/omit-if-no-ref/ pin_pwm9: pin_pwm9 {
		ball = <M4>;
		sig_descs = <SIG_DESC(0x424, 20, 1)>;
		drive-strength-desc = <PINCFG_DESC(0x518, 20, 4)>;
		bias-disable-desc = <PINCFG_DESC(0x518, 16, 1)>;
		pull-up-disable-desc = <PINCFG_DESC(0x518, 18, 1)>;
	};
	/omit-if-no-ref/ pin_pwm10: pin_pwm10 {
		ball = <P1>;
		sig_descs = <SIG_DESC(0x424, 24, 1)>;
		drive-strength-desc = <PINCFG_DESC(0x51c, 4, 4)>;
		bias-disable-desc = <PINCFG_DESC(0x51c, 0, 1)>;
		pull-up-disable-desc = <PINCFG_DESC(0x51c, 2, 1)>;
	};
	/omit-if-no-ref/ pin_pwm11: pin_pwm11 {
		ball = <N3>;
		sig_descs = <SIG_DESC(0x424, 28, 1)>;
		drive-strength-desc = <PINCFG_DESC(0x51c, 20, 4)>;
		bias-disable-desc = <PINCFG_DESC(0x51c, 16, 1)>;
		pull-up-disable-desc = <PINCFG_DESC(0x51c, 18, 1)>;
	};
	/omit-if-no-ref/ pin_tach8: pin_tach8 {
		ball = <H17>;
		sig_descs = <SIG_DESC(0x42c, 16, 1)>;
		drive-strength-desc = <PINCFG_DESC(0x538, 4, 4)>;
		bias-disable-desc = <PINCFG_DESC(0x538, 0, 1)>;
		pull-up-disable-desc = <PINCFG_DESC(0x538, 2, 1)>;
	};
	/omit-if-no-ref/ pin_tach9: pin_tach9 {
		ball = <H16>;
		sig_descs = <SIG_DESC(0x42c, 20, 1)>;
		drive-strength-desc = <PINCFG_DESC(0x538, 20, 4)>;
		bias-disable-desc = <PINCFG_DESC(0x538, 16, 1)>;
		pull-up-disable-desc = <PINCFG_DESC(0x538, 18, 1)>;
	};
	/omit-if-no-ref/ pin_tach10: pin_tach10 {
		ball = <H15>;
		sig_descs = <SIG_DESC(0x42c, 24, 1)>;
		drive-strength-desc = <PINCFG_DESC(0x53c, 4, 4)>;
		bias-disable-desc = <PINCFG_DESC(0x53c, 0, 1)>;
		pull-up-disable-desc = <PINCFG_DESC(0x53c, 2, 1)>;
	};
	/omit-if-no-ref/ pin_tach11: pin_tach11 {
		ball = <J13>;
		sig_descs = <SIG_DESC(0x42c, 28, 1)>;
		drive-strength-desc = <PINCFG_DESC(0x53c, 20, 4)>;
		bias-disable-desc = <PINCFG_DESC(0x53c, 16, 1)>;
		pull-up-disable-desc = <PINCFG_DESC(0x53c, 18, 1)>;
	};
	/omit-if-no-ref/ pin_thruin0: pin_thruin0 {
		ball = <G15>;
		sig_descs = <SIG_DESC(0x430, 16, 1)>;
		drive-strength-desc = <PINCFG_DESC(0x548, 4, 4)>;
		bias-disable-desc = <PINCFG_DESC(0x548, 0, 1)>;
		pull-up-disable-desc = <PINCFG_DESC(0x548, 2, 1)>;
	};
	/omit-if-no-ref/ pin_thruout0: pin_thruout0 {
		ball = <G13>;
		sig_descs = <SIG_DESC(0x430, 20, 1)>;
		drive-strength-desc = <PINCFG_DESC(0x548, 20, 4)>;
		bias-disable-desc = <PINCFG_DESC(0x548, 16, 1)>;
		pull-up-disable-desc = <PINCFG_DESC(0x548, 18, 1)>;
	};
	/omit-if-no-ref/ pin_thruin1: pin_thruin1 {
		ball = <F16>;
		sig_descs = <SIG_DESC(0x430, 24, 1)>;
		drive-strength-desc = <PINCFG_DESC(0x54c, 4, 4)>;
		bias-disable-desc = <PINCFG_DESC(0x54c, 0, 1)>;
		pull-up-disable-desc = <PINCFG_DESC(0x54c, 2, 1)>;
	};
	/omit-if-no-ref/ pin_thruout1: pin_thruout1 {
		ball = <E17>;
		sig_descs = <SIG_DESC(0x430, 28, 1)>;
		drive-strength-desc = <PINCFG_DESC(0x54c, 20, 4)>;
		bias-disable-desc = <PINCFG_DESC(0x54c, 16, 1)>;
		pull-up-disable-desc = <PINCFG_DESC(0x54c, 18, 1)>;
	};
	/omit-if-no-ref/ pin_thruin2: pin_thruin2 {
		ball = <G14>;
		sig_descs = <SIG_DESC(0x434, 0, 1)>;
		drive-strength-desc = <PINCFG_DESC(0x550, 4, 4)>;
		bias-disable-desc = <PINCFG_DESC(0x550, 0, 1)>;
		pull-up-disable-desc = <PINCFG_DESC(0x550, 2, 1)>;
	};
	/omit-if-no-ref/ pin_thruout2: pin_thruout2 {
		ball = <F15>;
		sig_descs = <SIG_DESC(0x434, 4, 1)>;
		drive-strength-desc = <PINCFG_DESC(0x550, 20, 4)>;
		bias-disable-desc = <PINCFG_DESC(0x550, 16, 1)>;
		pull-up-disable-desc = <PINCFG_DESC(0x550, 18, 1)>;
	};
	/omit-if-no-ref/ pin_thruin3: pin_thruin3 {
		ball = <E16>;
		sig_descs = <SIG_DESC(0x434, 8, 1)>;
		drive-strength-desc = <PINCFG_DESC(0x554, 4, 4)>;
		bias-disable-desc = <PINCFG_DESC(0x554, 0, 1)>;
		pull-up-disable-desc = <PINCFG_DESC(0x554, 2, 1)>;
	};
	/omit-if-no-ref/ pin_thruout3: pin_thruout3 {
		ball = <E14>;
		sig_descs = <SIG_DESC(0x434, 12, 1)>;
		drive-strength-desc = <PINCFG_DESC(0x554, 20, 4)>;
		bias-disable-desc = <PINCFG_DESC(0x554, 16, 1)>;
		pull-up-disable-desc = <PINCFG_DESC(0x554, 18, 1)>;
	};
	/omit-if-no-ref/ pin_sgpm0clk: pin_sgpm0clk {
		ball = <B2>;
		sig_descs = <SIG_DESC(0x438, 24, 1)>;
		drive-strength-desc = <PINCFG_DESC(0x56c, 4, 4)>;
		bias-disable-desc = <PINCFG_DESC(0x56c, 0, 1)>;
		pull-up-disable-desc = <PINCFG_DESC(0x56c, 2, 1)>;
	};
	/omit-if-no-ref/ pin_siopbo: pin_siopbo {
		ball = <B2>;
		sig_descs = <SIG_DESC(0x438, 24, 2)>;
		drive-strength-desc = <PINCFG_DESC(0x56c, 4, 4)>;
		bias-disable-desc = <PINCFG_DESC(0x56c, 0, 1)>;
		pull-up-disable-desc = <PINCFG_DESC(0x56c, 2, 1)>;
	};
	/omit-if-no-ref/ pin_sgpm0ld: pin_sgpm0ld {
		ball = <B3>;
		sig_descs = <SIG_DESC(0x438, 28, 1)>;
		drive-strength-desc = <PINCFG_DESC(0x56c, 20, 4)>;
		bias-disable-desc = <PINCFG_DESC(0x56c, 16, 1)>;
		pull-up-disable-desc = <PINCFG_DESC(0x56c, 18, 1)>;
	};
	/omit-if-no-ref/ pin_siopbi: pin_siopbi {
		ball = <B3>;
		sig_descs = <SIG_DESC(0x438, 28, 2)>;
		drive-strength-desc = <PINCFG_DESC(0x56c, 20, 4)>;
		bias-disable-desc = <PINCFG_DESC(0x56c, 16, 1)>;
		pull-up-disable-desc = <PINCFG_DESC(0x56c, 18, 1)>;
	};
	/omit-if-no-ref/ pin_sgpm0out: pin_sgpm0out {
		ball = <C6>;
		sig_descs = <SIG_DESC(0x43c, 0, 1)>;
		drive-strength-desc = <PINCFG_DESC(0x570, 4, 4)>;
		bias-disable-desc = <PINCFG_DESC(0x570, 0, 1)>;
		pull-up-disable-desc = <PINCFG_DESC(0x570, 2, 1)>;
	};
	/omit-if-no-ref/ pin_siosci: pin_siosci {
		ball = <C6>;
		sig_descs = <SIG_DESC(0x43c, 0, 2)>;
		drive-strength-desc = <PINCFG_DESC(0x570, 4, 4)>;
		bias-disable-desc = <PINCFG_DESC(0x570, 0, 1)>;
		pull-up-disable-desc = <PINCFG_DESC(0x570, 2, 1)>;
	};
	/omit-if-no-ref/ pin_sgpm0in: pin_sgpm0in {
		ball = <D7>;
		sig_descs = <SIG_DESC(0x43c, 4, 1)>;
		drive-strength-desc = <PINCFG_DESC(0x570, 20, 4)>;
		bias-disable-desc = <PINCFG_DESC(0x570, 16, 1)>;
		pull-up-disable-desc = <PINCFG_DESC(0x570, 18, 1)>;
	};
	/omit-if-no-ref/ pin_sios3: pin_sios3 {
		ball = <D7>;
		sig_descs = <SIG_DESC(0x43c, 4, 2)>;
		drive-strength-desc = <PINCFG_DESC(0x570, 20, 4)>;
		bias-disable-desc = <PINCFG_DESC(0x570, 16, 1)>;
		pull-up-disable-desc = <PINCFG_DESC(0x570, 18, 1)>;
	};
	/omit-if-no-ref/ pin_sgpm1clk: pin_sgpm1clk {
		ball = <E7>;
		sig_descs = <SIG_DESC(0x43c, 8, 1)>;
		drive-strength-desc = <PINCFG_DESC(0x574, 4, 4)>;
		bias-disable-desc = <PINCFG_DESC(0x574, 0, 1)>;
		pull-up-disable-desc = <PINCFG_DESC(0x574, 2, 1)>;
	};
	/omit-if-no-ref/ pin_wdt4: pin_wdt4 {
		ball = <E7>;
		sig_descs = <SIG_DESC(0x43c, 8, 4)>;
		drive-strength-desc = <PINCFG_DESC(0x574, 4, 4)>;
		bias-disable-desc = <PINCFG_DESC(0x574, 0, 1)>;
		pull-up-disable-desc = <PINCFG_DESC(0x574, 2, 1)>;
	};
	/omit-if-no-ref/ pin_sgpm1ld: pin_sgpm1ld {
		ball = <C7>;
		sig_descs = <SIG_DESC(0x43c, 12, 1)>;
		drive-strength-desc = <PINCFG_DESC(0x574, 20, 4)>;
		bias-disable-desc = <PINCFG_DESC(0x574, 16, 1)>;
		pull-up-disable-desc = <PINCFG_DESC(0x574, 18, 1)>;
	};
	/omit-if-no-ref/ pin_wdt5: pin_wdt5 {
		ball = <C7>;
		sig_descs = <SIG_DESC(0x43c, 12, 4)>;
		drive-strength-desc = <PINCFG_DESC(0x574, 20, 4)>;
		bias-disable-desc = <PINCFG_DESC(0x574, 16, 1)>;
		pull-up-disable-desc = <PINCFG_DESC(0x574, 18, 1)>;
	};
	/omit-if-no-ref/ pin_sgpm1out: pin_sgpm1out {
		ball = <B4>;
		sig_descs = <SIG_DESC(0x43c, 16, 1)>;
		drive-strength-desc = <PINCFG_DESC(0x578, 4, 4)>;
		bias-disable-desc = <PINCFG_DESC(0x578, 0, 1)>;
		pull-up-disable-desc = <PINCFG_DESC(0x578, 2, 1)>;
	};
	/omit-if-no-ref/ pin_wdt6: pin_wdt6 {
		ball = <B4>;
		sig_descs = <SIG_DESC(0x43c, 16, 4)>;
		drive-strength-desc = <PINCFG_DESC(0x578, 4, 4)>;
		bias-disable-desc = <PINCFG_DESC(0x578, 0, 1)>;
		pull-up-disable-desc = <PINCFG_DESC(0x578, 2, 1)>;
	};
	/omit-if-no-ref/ pin_sgpm1in: pin_sgpm1in {
		ball = <B5>;
		sig_descs = <SIG_DESC(0x43c, 20, 1)>;
		drive-strength-desc = <PINCFG_DESC(0x578, 20, 4)>;
		bias-disable-desc = <PINCFG_DESC(0x578, 16, 1)>;
		pull-up-disable-desc = <PINCFG_DESC(0x578, 18, 1)>;
	};
	/omit-if-no-ref/ pin_wdt7: pin_wdt7 {
		ball = <B5>;
		sig_descs = <SIG_DESC(0x43c, 20, 4)>;
		drive-strength-desc = <PINCFG_DESC(0x578, 20, 4)>;
		bias-disable-desc = <PINCFG_DESC(0x578, 16, 1)>;
		pull-up-disable-desc = <PINCFG_DESC(0x578, 18, 1)>;
	};
	/omit-if-no-ref/ pin_espid0: pin_espid0 {
		ball = <P5>;
		sig_descs = <SIG_DESC(0x43c, 24, 1)>;
		drive-strength-desc = <PINCFG_DESC(0x57c, 4, 4)>;
		bias-disable-desc = <PINCFG_DESC(0x57c, 0, 1)>;
		pull-up-disable-desc = <PINCFG_DESC(0x57c, 2, 1)>;
	};
	/omit-if-no-ref/ pin_espid1: pin_espid1 {
		ball = <P4>;
		sig_descs = <SIG_DESC(0x43c, 28, 1)>;
		drive-strength-desc = <PINCFG_DESC(0x57c, 20, 4)>;
		bias-disable-desc = <PINCFG_DESC(0x57c, 16, 1)>;
		pull-up-disable-desc = <PINCFG_DESC(0x57c, 18, 1)>;
	};
	/omit-if-no-ref/ pin_espid2: pin_espid2 {
		ball = <R2>;
		sig_descs = <SIG_DESC(0x440, 0, 1)>;
		drive-strength-desc = <PINCFG_DESC(0x580, 4, 4)>;
		bias-disable-desc = <PINCFG_DESC(0x580, 0, 1)>;
		pull-up-disable-desc = <PINCFG_DESC(0x580, 2, 1)>;
	};
	/omit-if-no-ref/ pin_espid3: pin_espid3 {
		ball = <T2>;
		sig_descs = <SIG_DESC(0x440, 4, 1)>;
		drive-strength-desc = <PINCFG_DESC(0x580, 20, 4)>;
		bias-disable-desc = <PINCFG_DESC(0x580, 16, 1)>;
		pull-up-disable-desc = <PINCFG_DESC(0x580, 18, 1)>;
	};
	/omit-if-no-ref/ pin_espick: pin_espick {
		ball = <U2>;
		sig_descs = <SIG_DESC(0x440, 8, 1)>;
		drive-strength-desc = <PINCFG_DESC(0x584, 4, 4)>;
		bias-disable-desc = <PINCFG_DESC(0x584, 0, 1)>;
		pull-up-disable-desc = <PINCFG_DESC(0x584, 2, 1)>;
	};
	/omit-if-no-ref/ pin_espics: pin_espics {
		ball = <P3>;
		sig_descs = <SIG_DESC(0x440, 12, 1)>;
		drive-strength-desc = <PINCFG_DESC(0x584, 20, 4)>;
		bias-disable-desc = <PINCFG_DESC(0x584, 16, 1)>;
		pull-up-disable-desc = <PINCFG_DESC(0x584, 18, 1)>;
	};
	/omit-if-no-ref/ pin_espialt: pin_espialt {
		ball = <T3>;
		sig_descs = <SIG_DESC(0x440, 16, 1)>;
		drive-strength-desc = <PINCFG_DESC(0x588, 4, 4)>;
		bias-disable-desc = <PINCFG_DESC(0x588, 0, 1)>;
		pull-up-disable-desc = <PINCFG_DESC(0x588, 2, 1)>;
	};
	/omit-if-no-ref/ pin_espirst: pin_espirst {
		ball = <U3>;
		sig_descs = <SIG_DESC(0x440, 20, 1)>;
		drive-strength-desc = <PINCFG_DESC(0x588, 20, 4)>;
		bias-disable-desc = <PINCFG_DESC(0x588, 16, 1)>;
		pull-up-disable-desc = <PINCFG_DESC(0x588, 18, 1)>;
	};
	/omit-if-no-ref/ pin_mntrst0: pin_mntrst0 {
		ball = <K17>;
		sig_descs = <SIG_DESC(0x440, 24, 1)>;
		drive-strength-desc = <PINCFG_DESC(0x58c, 4, 4)>;
		bias-disable-desc = <PINCFG_DESC(0x58c, 0, 1)>;
		pull-up-disable-desc = <PINCFG_DESC(0x58c, 2, 1)>;
	};
	/omit-if-no-ref/ pin_pspntrst: pin_pspntrst {
		ball = <K17>;
		sig_descs = <SIG_DESC(0x440, 24, 2)>;
		drive-strength-desc = <PINCFG_DESC(0x58c, 4, 4)>;
		bias-disable-desc = <PINCFG_DESC(0x58c, 0, 1)>;
		pull-up-disable-desc = <PINCFG_DESC(0x58c, 2, 1)>;
	};
	/omit-if-no-ref/ pin_mtck0: pin_mtck0 {
		ball = <J17>;
		sig_descs = <SIG_DESC(0x440, 28, 1)>;
		drive-strength-desc = <PINCFG_DESC(0x58c, 20, 4)>;
		bias-disable-desc = <PINCFG_DESC(0x58c, 16, 1)>;
		pull-up-disable-desc = <PINCFG_DESC(0x58c, 18, 1)>;
	};
	/omit-if-no-ref/ pin_pspswclktck: pin_pspswclktck {
		ball = <J17>;
		sig_descs = <SIG_DESC(0x440, 28, 2)>;
		drive-strength-desc = <PINCFG_DESC(0x58c, 20, 4)>;
		bias-disable-desc = <PINCFG_DESC(0x58c, 16, 1)>;
		pull-up-disable-desc = <PINCFG_DESC(0x58c, 18, 1)>;
	};
	/omit-if-no-ref/ pin_mtdi0: pin_mtdi0 {
		ball = <J16>;
		sig_descs = <SIG_DESC(0x444, 0, 1)>;
		drive-strength-desc = <PINCFG_DESC(0x590, 4, 4)>;
		bias-disable-desc = <PINCFG_DESC(0x590, 0, 1)>;
		pull-up-disable-desc = <PINCFG_DESC(0x590, 2, 1)>;
	};
	/omit-if-no-ref/ pin_psptdi: pin_psptdi {
		ball = <J16>;
		sig_descs = <SIG_DESC(0x444, 0, 2)>;
		drive-strength-desc = <PINCFG_DESC(0x590, 4, 4)>;
		bias-disable-desc = <PINCFG_DESC(0x590, 0, 1)>;
		pull-up-disable-desc = <PINCFG_DESC(0x590, 2, 1)>;
	};
	/omit-if-no-ref/ pin_mtdo0: pin_mtdo0 {
		ball = <J15>;
		sig_descs = <SIG_DESC(0x444, 4, 1)>;
		drive-strength-desc = <PINCFG_DESC(0x590, 20, 4)>;
		bias-disable-desc = <PINCFG_DESC(0x590, 16, 1)>;
		pull-up-disable-desc = <PINCFG_DESC(0x590, 18, 1)>;
	};
	/omit-if-no-ref/ pin_psptdo: pin_psptdo {
		ball = <J15>;
		sig_descs = <SIG_DESC(0x444, 4, 2)>;
		drive-strength-desc = <PINCFG_DESC(0x590, 20, 4)>;
		bias-disable-desc = <PINCFG_DESC(0x590, 16, 1)>;
		pull-up-disable-desc = <PINCFG_DESC(0x590, 18, 1)>;
	};
	/omit-if-no-ref/ pin_mtms0: pin_mtms0 {
		ball = <K12>;
		sig_descs = <SIG_DESC(0x444, 8, 1)>;
		drive-strength-desc = <PINCFG_DESC(0x594, 4, 4)>;
		bias-disable-desc = <PINCFG_DESC(0x594, 0, 1)>;
		pull-up-disable-desc = <PINCFG_DESC(0x594, 2, 1)>;
	};
	/omit-if-no-ref/ pin_pspswditms: pin_pspswditms {
		ball = <K12>;
		sig_descs = <SIG_DESC(0x444, 8, 2)>;
		drive-strength-desc = <PINCFG_DESC(0x594, 4, 4)>;
		bias-disable-desc = <PINCFG_DESC(0x594, 0, 1)>;
		pull-up-disable-desc = <PINCFG_DESC(0x594, 2, 1)>;
	};
	/omit-if-no-ref/ pin_mntrst1: pin_mntrst1 {
		ball = <C5>;
		sig_descs = <SIG_DESC(0x444, 12, 1)>;
		drive-strength-desc = <PINCFG_DESC(0x594, 20, 4)>;
		bias-disable-desc = <PINCFG_DESC(0x594, 16, 1)>;
		pull-up-disable-desc = <PINCFG_DESC(0x594, 18, 1)>;
	};
	/omit-if-no-ref/ pin_cptratrstn: pin_cptratrstn {
		ball = <C5>;
		sig_descs = <SIG_DESC(0x444, 12, 2)>;
		drive-strength-desc = <PINCFG_DESC(0x594, 20, 4)>;
		bias-disable-desc = <PINCFG_DESC(0x594, 16, 1)>;
		pull-up-disable-desc = <PINCFG_DESC(0x594, 18, 1)>;
	};
	/omit-if-no-ref/ pin_mtck1: pin_mtck1 {
		ball = <D4>;
		sig_descs = <SIG_DESC(0x444, 16, 1)>;
		drive-strength-desc = <PINCFG_DESC(0x598, 4, 4)>;
		bias-disable-desc = <PINCFG_DESC(0x598, 0, 1)>;
		pull-up-disable-desc = <PINCFG_DESC(0x598, 2, 1)>;
	};
	/omit-if-no-ref/ pin_cptratck: pin_cptratck {
		ball = <D4>;
		sig_descs = <SIG_DESC(0x444, 16, 2)>;
		drive-strength-desc = <PINCFG_DESC(0x598, 4, 4)>;
		bias-disable-desc = <PINCFG_DESC(0x598, 0, 1)>;
		pull-up-disable-desc = <PINCFG_DESC(0x598, 2, 1)>;
	};
	/omit-if-no-ref/ pin_mtdi1: pin_mtdi1 {
		ball = <D6>;
		sig_descs = <SIG_DESC(0x444, 20, 1)>;
		drive-strength-desc = <PINCFG_DESC(0x598, 20, 4)>;
		bias-disable-desc = <PINCFG_DESC(0x598, 16, 1)>;
		pull-up-disable-desc = <PINCFG_DESC(0x598, 18, 1)>;
	};
	/omit-if-no-ref/ pin_cptratdi: pin_cptratdi {
		ball = <D6>;
		sig_descs = <SIG_DESC(0x444, 20, 2)>;
		drive-strength-desc = <PINCFG_DESC(0x598, 20, 4)>;
		bias-disable-desc = <PINCFG_DESC(0x598, 16, 1)>;
		pull-up-disable-desc = <PINCFG_DESC(0x598, 18, 1)>;
	};
	/omit-if-no-ref/ pin_mtdo1: pin_mtdo1 {
		ball = <C4>;
		sig_descs = <SIG_DESC(0x444, 24, 1)>;
		drive-strength-desc = <PINCFG_DESC(0x59c, 4, 4)>;
		bias-disable-desc = <PINCFG_DESC(0x59c, 0, 1)>;
		pull-up-disable-desc = <PINCFG_DESC(0x59c, 2, 1)>;
	};
	/omit-if-no-ref/ pin_cptratdo: pin_cptratdo {
		ball = <C4>;
		sig_descs = <SIG_DESC(0x444, 24, 2)>;
		drive-strength-desc = <PINCFG_DESC(0x59c, 4, 4)>;
		bias-disable-desc = <PINCFG_DESC(0x59c, 0, 1)>;
		pull-up-disable-desc = <PINCFG_DESC(0x59c, 2, 1)>;
	};
	/omit-if-no-ref/ pin_mtms1: pin_mtms1 {
		ball = <B1>;
		sig_descs = <SIG_DESC(0x444, 28, 1)>;
		drive-strength-desc = <PINCFG_DESC(0x59c, 20, 4)>;
		bias-disable-desc = <PINCFG_DESC(0x59c, 16, 1)>;
		pull-up-disable-desc = <PINCFG_DESC(0x59c, 18, 1)>;
	};
	/omit-if-no-ref/ pin_cptratms: pin_cptratms {
		ball = <B1>;
		sig_descs = <SIG_DESC(0x444, 28, 2)>;
		drive-strength-desc = <PINCFG_DESC(0x59c, 20, 4)>;
		bias-disable-desc = <PINCFG_DESC(0x59c, 16, 1)>;
		pull-up-disable-desc = <PINCFG_DESC(0x59c, 18, 1)>;
	};
	/omit-if-no-ref/ pin_fwspidq2: pin_fwspidq2 {
		ball = <T16>;
		sig_descs = <SIG_DESC(0x448, 0, 1)>;
		drive-strength-desc = <PINCFG_DESC(0x5a0, 4, 4)>;
		bias-disable-desc = <PINCFG_DESC(0x5a0, 0, 1)>;
		pull-up-disable-desc = <PINCFG_DESC(0x5a0, 2, 1)>;
	};
	/omit-if-no-ref/ pin_wdt0: pin_wdt0 {
		ball = <T16>;
		sig_descs = <SIG_DESC(0x448, 0, 4)>;
		drive-strength-desc = <PINCFG_DESC(0x5a0, 4, 4)>;
		bias-disable-desc = <PINCFG_DESC(0x5a0, 0, 1)>;
		pull-up-disable-desc = <PINCFG_DESC(0x5a0, 2, 1)>;
	};
	/omit-if-no-ref/ pin_fwspidq3: pin_fwspidq3 {
		ball = <N15>;
		sig_descs = <SIG_DESC(0x448, 4, 1)>;
		drive-strength-desc = <PINCFG_DESC(0x5a0, 20, 4)>;
		bias-disable-desc = <PINCFG_DESC(0x5a0, 16, 1)>;
		pull-up-disable-desc = <PINCFG_DESC(0x5a0, 18, 1)>;
	};
	/omit-if-no-ref/ pin_wdt1: pin_wdt1 {
		ball = <N15>;
		sig_descs = <SIG_DESC(0x448, 4, 4)>;
		drive-strength-desc = <PINCFG_DESC(0x5a0, 20, 4)>;
		bias-disable-desc = <PINCFG_DESC(0x5a0, 16, 1)>;
		pull-up-disable-desc = <PINCFG_DESC(0x5a0, 18, 1)>;
	};
	/omit-if-no-ref/ pin_spim1ck: pin_spim1ck {
		ball = <K4>;
		sig_descs = <SIG_DESC(0x448, 8, 1)>;
		drive-strength-desc = <PINCFG_DESC(0x5a4, 4, 4)>;
		bias-disable-desc = <PINCFG_DESC(0x5a4, 0, 1)>;
		pull-up-disable-desc = <PINCFG_DESC(0x5a4, 2, 1)>;
	};
	/omit-if-no-ref/ pin_spif2ck_o: pin_spif2ck_o {
		ball = <K4>;
		sig_descs = <SIG_DESC(0x448, 8, 2)>;
		drive-strength-desc = <PINCFG_DESC(0x5a4, 4, 4)>;
		bias-disable-desc = <PINCFG_DESC(0x5a4, 0, 1)>;
		pull-up-disable-desc = <PINCFG_DESC(0x5a4, 2, 1)>;
	};
	/omit-if-no-ref/ pin_spis1ck: pin_spis1ck {
		ball = <K4>;
		sig_descs = <SIG_DESC(0x448, 8, 3)>;
		drive-strength-desc = <PINCFG_DESC(0x5a4, 4, 4)>;
		bias-disable-desc = <PINCFG_DESC(0x5a4, 0, 1)>;
		pull-up-disable-desc = <PINCFG_DESC(0x5a4, 2, 1)>;
	};
	/omit-if-no-ref/ pin_spim1dq0: pin_spim1dq0 {
		ball = <K5>;
		sig_descs = <SIG_DESC(0x448, 12, 1)>;
		drive-strength-desc = <PINCFG_DESC(0x5a4, 20, 4)>;
		bias-disable-desc = <PINCFG_DESC(0x5a4, 16, 1)>;
		pull-up-disable-desc = <PINCFG_DESC(0x5a4, 18, 1)>;
	};
	/omit-if-no-ref/ pin_spif2dq0_o: pin_spif2dq0_o {
		ball = <K5>;
		sig_descs = <SIG_DESC(0x448, 12, 2)>;
		drive-strength-desc = <PINCFG_DESC(0x5a4, 20, 4)>;
		bias-disable-desc = <PINCFG_DESC(0x5a4, 16, 1)>;
		pull-up-disable-desc = <PINCFG_DESC(0x5a4, 18, 1)>;
	};
	/omit-if-no-ref/ pin_spis1dq0: pin_spis1dq0 {
		ball = <K5>;
		sig_descs = <SIG_DESC(0x448, 12, 3)>;
		drive-strength-desc = <PINCFG_DESC(0x5a4, 20, 4)>;
		bias-disable-desc = <PINCFG_DESC(0x5a4, 16, 1)>;
		pull-up-disable-desc = <PINCFG_DESC(0x5a4, 18, 1)>;
	};
	/omit-if-no-ref/ pin_spim1dq1: pin_spim1dq1 {
		ball = <L5>;
		sig_descs = <SIG_DESC(0x448, 16, 1)>;
		drive-strength-desc = <PINCFG_DESC(0x5a8, 4, 4)>;
		bias-disable-desc = <PINCFG_DESC(0x5a8, 0, 1)>;
		pull-up-disable-desc = <PINCFG_DESC(0x5a8, 2, 1)>;
	};
	/omit-if-no-ref/ pin_spif2dq1_o: pin_spif2dq1_o {
		ball = <L5>;
		sig_descs = <SIG_DESC(0x448, 16, 2)>;
		drive-strength-desc = <PINCFG_DESC(0x5a8, 4, 4)>;
		bias-disable-desc = <PINCFG_DESC(0x5a8, 0, 1)>;
		pull-up-disable-desc = <PINCFG_DESC(0x5a8, 2, 1)>;
	};
	/omit-if-no-ref/ pin_spis1dq1: pin_spis1dq1 {
		ball = <L5>;
		sig_descs = <SIG_DESC(0x448, 16, 3)>;
		drive-strength-desc = <PINCFG_DESC(0x5a8, 4, 4)>;
		bias-disable-desc = <PINCFG_DESC(0x5a8, 0, 1)>;
		pull-up-disable-desc = <PINCFG_DESC(0x5a8, 2, 1)>;
	};
	/omit-if-no-ref/ pin_spim1dq2: pin_spim1dq2 {
		ball = <M5>;
		sig_descs = <SIG_DESC(0x448, 20, 1)>;
		drive-strength-desc = <PINCFG_DESC(0x5a8, 20, 4)>;
		bias-disable-desc = <PINCFG_DESC(0x5a8, 16, 1)>;
		pull-up-disable-desc = <PINCFG_DESC(0x5a8, 18, 1)>;
	};
	/omit-if-no-ref/ pin_spif2dq2_o: pin_spif2dq2_o {
		ball = <M5>;
		sig_descs = <SIG_DESC(0x448, 20, 2)>;
		drive-strength-desc = <PINCFG_DESC(0x5a8, 20, 4)>;
		bias-disable-desc = <PINCFG_DESC(0x5a8, 16, 1)>;
		pull-up-disable-desc = <PINCFG_DESC(0x5a8, 18, 1)>;
	};
	/omit-if-no-ref/ pin_spis1dq2: pin_spis1dq2 {
		ball = <M5>;
		sig_descs = <SIG_DESC(0x448, 20, 3)>;
		drive-strength-desc = <PINCFG_DESC(0x5a8, 20, 4)>;
		bias-disable-desc = <PINCFG_DESC(0x5a8, 16, 1)>;
		pull-up-disable-desc = <PINCFG_DESC(0x5a8, 18, 1)>;
	};
	/*
	 * SCU5AC's high half (GPIO151/J1 below) does not take pincfg
	 * writes on AST10x0-G2 A0: writes report success but never take
	 * effect, confirmed on real hardware. Values are still provided
	 * here (correct per the datasheet) for A1/later revisions.
	 */
	/omit-if-no-ref/ pin_spim1dq3: pin_spim1dq3 {
		ball = <M3>;
		sig_descs = <SIG_DESC(0x448, 24, 1)>;
		drive-strength-desc = <PINCFG_DESC(0x5ac, 4, 4)>;
		bias-disable-desc = <PINCFG_DESC(0x5ac, 0, 1)>;
		pull-up-disable-desc = <PINCFG_DESC(0x5ac, 2, 1)>;
	};
	/omit-if-no-ref/ pin_spif2dq3_o: pin_spif2dq3_o {
		ball = <M3>;
		sig_descs = <SIG_DESC(0x448, 24, 2)>;
		drive-strength-desc = <PINCFG_DESC(0x5ac, 4, 4)>;
		bias-disable-desc = <PINCFG_DESC(0x5ac, 0, 1)>;
		pull-up-disable-desc = <PINCFG_DESC(0x5ac, 2, 1)>;
	};
	/omit-if-no-ref/ pin_spis1dq3: pin_spis1dq3 {
		ball = <M3>;
		sig_descs = <SIG_DESC(0x448, 24, 3)>;
		drive-strength-desc = <PINCFG_DESC(0x5ac, 4, 4)>;
		bias-disable-desc = <PINCFG_DESC(0x5ac, 0, 1)>;
		pull-up-disable-desc = <PINCFG_DESC(0x5ac, 2, 1)>;
	};
	/omit-if-no-ref/ pin_spif2cs0_i: pin_spif2cs0_i {
		ball = <J1>;
		sig_descs = <SIG_DESC(0x448, 28, 2)>;
		drive-strength-desc = <PINCFG_DESC(0x5ac, 20, 4)>;
		bias-disable-desc = <PINCFG_DESC(0x5ac, 16, 1)>;
		pull-up-disable-desc = <PINCFG_DESC(0x5ac, 18, 1)>;
	};
	/omit-if-no-ref/ pin_spif2cs1_i: pin_spif2cs1_i {
		ball = <J2>;
		sig_descs = <SIG_DESC(0x44c, 0, 2)>;
		drive-strength-desc = <PINCFG_DESC(0x5b0, 4, 4)>;
		bias-disable-desc = <PINCFG_DESC(0x5b0, 0, 1)>;
		pull-up-disable-desc = <PINCFG_DESC(0x5b0, 2, 1)>;
	};
	/omit-if-no-ref/ pin_spif2ck_i: pin_spif2ck_i {
		ball = <K1>;
		sig_descs = <SIG_DESC(0x44c, 4, 2)>;
		drive-strength-desc = <PINCFG_DESC(0x5b0, 20, 4)>;
		bias-disable-desc = <PINCFG_DESC(0x5b0, 16, 1)>;
		pull-up-disable-desc = <PINCFG_DESC(0x5b0, 18, 1)>;
	};
	/omit-if-no-ref/ pin_spif2dq0_i: pin_spif2dq0_i {
		ball = <L1>;
		sig_descs = <SIG_DESC(0x44c, 8, 2)>;
		drive-strength-desc = <PINCFG_DESC(0x5b4, 4, 4)>;
		bias-disable-desc = <PINCFG_DESC(0x5b4, 0, 1)>;
		pull-up-disable-desc = <PINCFG_DESC(0x5b4, 2, 1)>;
	};
	/omit-if-no-ref/ pin_spif2dq1_i: pin_spif2dq1_i {
		ball = <K2>;
		sig_descs = <SIG_DESC(0x44c, 12, 2)>;
		drive-strength-desc = <PINCFG_DESC(0x5b4, 20, 4)>;
		bias-disable-desc = <PINCFG_DESC(0x5b4, 16, 1)>;
		pull-up-disable-desc = <PINCFG_DESC(0x5b4, 18, 1)>;
	};
	/omit-if-no-ref/ pin_ndcd0: pin_ndcd0 {
		ball = <K2>;
		sig_descs = <SIG_DESC(0x44c, 12, 5)>;
		drive-strength-desc = <PINCFG_DESC(0x5b4, 20, 4)>;
		bias-disable-desc = <PINCFG_DESC(0x5b4, 16, 1)>;
		pull-up-disable-desc = <PINCFG_DESC(0x5b4, 18, 1)>;
	};
	/omit-if-no-ref/ pin_spif2dq2_i: pin_spif2dq2_i {
		ball = <N1>;
		sig_descs = <SIG_DESC(0x44c, 16, 2)>;
		drive-strength-desc = <PINCFG_DESC(0x5b8, 4, 4)>;
		bias-disable-desc = <PINCFG_DESC(0x5b8, 0, 1)>;
		pull-up-disable-desc = <PINCFG_DESC(0x5b8, 2, 1)>;
	};
	/omit-if-no-ref/ pin_ndsr0: pin_ndsr0 {
		ball = <N1>;
		sig_descs = <SIG_DESC(0x44c, 16, 5)>;
		drive-strength-desc = <PINCFG_DESC(0x5b8, 4, 4)>;
		bias-disable-desc = <PINCFG_DESC(0x5b8, 0, 1)>;
		pull-up-disable-desc = <PINCFG_DESC(0x5b8, 2, 1)>;
	};
	/omit-if-no-ref/ pin_spif2dq3_i: pin_spif2dq3_i {
		ball = <M1>;
		sig_descs = <SIG_DESC(0x44c, 20, 2)>;
		drive-strength-desc = <PINCFG_DESC(0x5b8, 20, 4)>;
		bias-disable-desc = <PINCFG_DESC(0x5b8, 16, 1)>;
		pull-up-disable-desc = <PINCFG_DESC(0x5b8, 18, 1)>;
	};
	/omit-if-no-ref/ pin_nri0: pin_nri0 {
		ball = <M1>;
		sig_descs = <SIG_DESC(0x44c, 20, 5)>;
		drive-strength-desc = <PINCFG_DESC(0x5b8, 20, 4)>;
		bias-disable-desc = <PINCFG_DESC(0x5b8, 16, 1)>;
		pull-up-disable-desc = <PINCFG_DESC(0x5b8, 18, 1)>;
	};
	/omit-if-no-ref/ pin_spif0cs0_i: pin_spif0cs0_i {
		ball = <C2>;
		sig_descs = <SIG_DESC(0x44c, 24, 2)>;
		drive-strength-desc = <PINCFG_DESC(0x5bc, 4, 4)>;
		bias-disable-desc = <PINCFG_DESC(0x5bc, 0, 1)>;
		pull-up-disable-desc = <PINCFG_DESC(0x5bc, 2, 1)>;
	};
	/omit-if-no-ref/ pin_wdt2: pin_wdt2 {
		ball = <C2>;
		sig_descs = <SIG_DESC(0x44c, 24, 4)>;
		drive-strength-desc = <PINCFG_DESC(0x5bc, 4, 4)>;
		bias-disable-desc = <PINCFG_DESC(0x5bc, 0, 1)>;
		pull-up-disable-desc = <PINCFG_DESC(0x5bc, 2, 1)>;
	};
	/omit-if-no-ref/ pin_ndtr0: pin_ndtr0 {
		ball = <C2>;
		sig_descs = <SIG_DESC(0x44c, 24, 5)>;
		drive-strength-desc = <PINCFG_DESC(0x5bc, 4, 4)>;
		bias-disable-desc = <PINCFG_DESC(0x5bc, 0, 1)>;
		pull-up-disable-desc = <PINCFG_DESC(0x5bc, 2, 1)>;
	};
	/omit-if-no-ref/ pin_spif0cs1_i: pin_spif0cs1_i {
		ball = <C1>;
		sig_descs = <SIG_DESC(0x44c, 28, 2)>;
		drive-strength-desc = <PINCFG_DESC(0x5bc, 20, 4)>;
		bias-disable-desc = <PINCFG_DESC(0x5bc, 16, 1)>;
		pull-up-disable-desc = <PINCFG_DESC(0x5bc, 18, 1)>;
	};
	/omit-if-no-ref/ pin_oscclk: pin_oscclk {
		ball = <C1>;
		sig_descs = <SIG_DESC(0x44c, 28, 4)>;
		drive-strength-desc = <PINCFG_DESC(0x5bc, 20, 4)>;
		bias-disable-desc = <PINCFG_DESC(0x5bc, 16, 1)>;
		pull-up-disable-desc = <PINCFG_DESC(0x5bc, 18, 1)>;
	};
	/omit-if-no-ref/ pin_spif0ck_i: pin_spif0ck_i {
		ball = <D3>;
		sig_descs = <SIG_DESC(0x450, 0, 2)>;
		drive-strength-desc = <PINCFG_DESC(0x5c0, 4, 4)>;
		bias-disable-desc = <PINCFG_DESC(0x5c0, 0, 1)>;
		pull-up-disable-desc = <PINCFG_DESC(0x5c0, 2, 1)>;
	};
	/omit-if-no-ref/ pin_ndcd1: pin_ndcd1 {
		ball = <D3>;
		sig_descs = <SIG_DESC(0x450, 0, 5)>;
		drive-strength-desc = <PINCFG_DESC(0x5c0, 4, 4)>;
		bias-disable-desc = <PINCFG_DESC(0x5c0, 0, 1)>;
		pull-up-disable-desc = <PINCFG_DESC(0x5c0, 2, 1)>;
	};
	/omit-if-no-ref/ pin_spif0dq0_i: pin_spif0dq0_i {
		ball = <D1>;
		sig_descs = <SIG_DESC(0x450, 4, 2)>;
		drive-strength-desc = <PINCFG_DESC(0x5c0, 20, 4)>;
		bias-disable-desc = <PINCFG_DESC(0x5c0, 16, 1)>;
		pull-up-disable-desc = <PINCFG_DESC(0x5c0, 18, 1)>;
	};
	/omit-if-no-ref/ pin_wdt3: pin_wdt3 {
		ball = <D1>;
		sig_descs = <SIG_DESC(0x450, 4, 4)>;
		drive-strength-desc = <PINCFG_DESC(0x5c0, 20, 4)>;
		bias-disable-desc = <PINCFG_DESC(0x5c0, 16, 1)>;
		pull-up-disable-desc = <PINCFG_DESC(0x5c0, 18, 1)>;
	};
	/omit-if-no-ref/ pin_ndsr1: pin_ndsr1 {
		ball = <D1>;
		sig_descs = <SIG_DESC(0x450, 4, 5)>;
		drive-strength-desc = <PINCFG_DESC(0x5c0, 20, 4)>;
		bias-disable-desc = <PINCFG_DESC(0x5c0, 16, 1)>;
		pull-up-disable-desc = <PINCFG_DESC(0x5c0, 18, 1)>;
	};
	/omit-if-no-ref/ pin_spif0dq1_i: pin_spif0dq1_i {
		ball = <E1>;
		sig_descs = <SIG_DESC(0x450, 8, 2)>;
		drive-strength-desc = <PINCFG_DESC(0x5c4, 4, 4)>;
		bias-disable-desc = <PINCFG_DESC(0x5c4, 0, 1)>;
		pull-up-disable-desc = <PINCFG_DESC(0x5c4, 2, 1)>;
	};
	/omit-if-no-ref/ pin_nri1: pin_nri1 {
		ball = <E1>;
		sig_descs = <SIG_DESC(0x450, 8, 5)>;
		drive-strength-desc = <PINCFG_DESC(0x5c4, 4, 4)>;
		bias-disable-desc = <PINCFG_DESC(0x5c4, 0, 1)>;
		pull-up-disable-desc = <PINCFG_DESC(0x5c4, 2, 1)>;
	};
	/omit-if-no-ref/ pin_spif0dq2_i: pin_spif0dq2_i {
		ball = <E3>;
		sig_descs = <SIG_DESC(0x450, 12, 2)>;
		drive-strength-desc = <PINCFG_DESC(0x5c4, 20, 4)>;
		bias-disable-desc = <PINCFG_DESC(0x5c4, 16, 1)>;
		pull-up-disable-desc = <PINCFG_DESC(0x5c4, 18, 1)>;
	};
	/omit-if-no-ref/ pin_ndtr1: pin_ndtr1 {
		ball = <E3>;
		sig_descs = <SIG_DESC(0x450, 12, 5)>;
		drive-strength-desc = <PINCFG_DESC(0x5c4, 20, 4)>;
		bias-disable-desc = <PINCFG_DESC(0x5c4, 16, 1)>;
		pull-up-disable-desc = <PINCFG_DESC(0x5c4, 18, 1)>;
	};
	/omit-if-no-ref/ pin_spif0dq3_i: pin_spif0dq3_i {
		ball = <F1>;
		sig_descs = <SIG_DESC(0x450, 16, 2)>;
		drive-strength-desc = <PINCFG_DESC(0x5c8, 4, 4)>;
		bias-disable-desc = <PINCFG_DESC(0x5c8, 0, 1)>;
		pull-up-disable-desc = <PINCFG_DESC(0x5c8, 2, 1)>;
	};
	/omit-if-no-ref/ pin_hbled: pin_hbled {
		ball = <U4>;
		sig_descs = <SIG_DESC(0x450, 20, 2)>;
		drive-strength-desc = <PINCFG_DESC(0x5c8, 20, 4)>;
		bias-disable-desc = <PINCFG_DESC(0x5c8, 16, 1)>;
		pull-up-disable-desc = <PINCFG_DESC(0x5c8, 18, 1)>;
	};
	/omit-if-no-ref/ pin_spim0ck: pin_spim0ck {
		ball = <F5>;
		sig_descs = <SIG_DESC(0x450, 24, 1)>;
		drive-strength-desc = <PINCFG_DESC(0x5cc, 4, 4)>;
		bias-disable-desc = <PINCFG_DESC(0x5cc, 0, 1)>;
		pull-up-disable-desc = <PINCFG_DESC(0x5cc, 2, 1)>;
	};
	/omit-if-no-ref/ pin_spif0ck_o: pin_spif0ck_o {
		ball = <F5>;
		sig_descs = <SIG_DESC(0x450, 24, 2)>;
		drive-strength-desc = <PINCFG_DESC(0x5cc, 4, 4)>;
		bias-disable-desc = <PINCFG_DESC(0x5cc, 0, 1)>;
		pull-up-disable-desc = <PINCFG_DESC(0x5cc, 2, 1)>;
	};
	/omit-if-no-ref/ pin_spis0ck: pin_spis0ck {
		ball = <F5>;
		sig_descs = <SIG_DESC(0x450, 24, 3)>;
		drive-strength-desc = <PINCFG_DESC(0x5cc, 4, 4)>;
		bias-disable-desc = <PINCFG_DESC(0x5cc, 0, 1)>;
		pull-up-disable-desc = <PINCFG_DESC(0x5cc, 2, 1)>;
	};
	/omit-if-no-ref/ pin_spim0dq0: pin_spim0dq0 {
		ball = <D2>;
		sig_descs = <SIG_DESC(0x450, 28, 1)>;
		drive-strength-desc = <PINCFG_DESC(0x5cc, 20, 4)>;
		bias-disable-desc = <PINCFG_DESC(0x5cc, 16, 1)>;
		pull-up-disable-desc = <PINCFG_DESC(0x5cc, 18, 1)>;
	};
	/omit-if-no-ref/ pin_spif0dq0_o: pin_spif0dq0_o {
		ball = <D2>;
		sig_descs = <SIG_DESC(0x450, 28, 2)>;
		drive-strength-desc = <PINCFG_DESC(0x5cc, 20, 4)>;
		bias-disable-desc = <PINCFG_DESC(0x5cc, 16, 1)>;
		pull-up-disable-desc = <PINCFG_DESC(0x5cc, 18, 1)>;
	};
	/omit-if-no-ref/ pin_spis0dq0: pin_spis0dq0 {
		ball = <D2>;
		sig_descs = <SIG_DESC(0x450, 28, 3)>;
		drive-strength-desc = <PINCFG_DESC(0x5cc, 20, 4)>;
		bias-disable-desc = <PINCFG_DESC(0x5cc, 16, 1)>;
		pull-up-disable-desc = <PINCFG_DESC(0x5cc, 18, 1)>;
	};
	/omit-if-no-ref/ pin_spim0dq1: pin_spim0dq1 {
		ball = <E2>;
		sig_descs = <SIG_DESC(0x454, 0, 1)>;
		drive-strength-desc = <PINCFG_DESC(0x5d0, 4, 4)>;
		bias-disable-desc = <PINCFG_DESC(0x5d0, 0, 1)>;
		pull-up-disable-desc = <PINCFG_DESC(0x5d0, 2, 1)>;
	};
	/omit-if-no-ref/ pin_spif0dq1_o: pin_spif0dq1_o {
		ball = <E2>;
		sig_descs = <SIG_DESC(0x454, 0, 2)>;
		drive-strength-desc = <PINCFG_DESC(0x5d0, 4, 4)>;
		bias-disable-desc = <PINCFG_DESC(0x5d0, 0, 1)>;
		pull-up-disable-desc = <PINCFG_DESC(0x5d0, 2, 1)>;
	};
	/omit-if-no-ref/ pin_spis0dq1: pin_spis0dq1 {
		ball = <E2>;
		sig_descs = <SIG_DESC(0x454, 0, 3)>;
		drive-strength-desc = <PINCFG_DESC(0x5d0, 4, 4)>;
		bias-disable-desc = <PINCFG_DESC(0x5d0, 0, 1)>;
		pull-up-disable-desc = <PINCFG_DESC(0x5d0, 2, 1)>;
	};
	/omit-if-no-ref/ pin_spim0dq2: pin_spim0dq2 {
		ball = <E4>;
		sig_descs = <SIG_DESC(0x454, 4, 1)>;
		drive-strength-desc = <PINCFG_DESC(0x5d0, 20, 4)>;
		bias-disable-desc = <PINCFG_DESC(0x5d0, 16, 1)>;
		pull-up-disable-desc = <PINCFG_DESC(0x5d0, 18, 1)>;
	};
	/omit-if-no-ref/ pin_spif0dq2_o: pin_spif0dq2_o {
		ball = <E4>;
		sig_descs = <SIG_DESC(0x454, 4, 2)>;
		drive-strength-desc = <PINCFG_DESC(0x5d0, 20, 4)>;
		bias-disable-desc = <PINCFG_DESC(0x5d0, 16, 1)>;
		pull-up-disable-desc = <PINCFG_DESC(0x5d0, 18, 1)>;
	};
	/omit-if-no-ref/ pin_spis0dq2: pin_spis0dq2 {
		ball = <E4>;
		sig_descs = <SIG_DESC(0x454, 4, 3)>;
		drive-strength-desc = <PINCFG_DESC(0x5d0, 20, 4)>;
		bias-disable-desc = <PINCFG_DESC(0x5d0, 16, 1)>;
		pull-up-disable-desc = <PINCFG_DESC(0x5d0, 18, 1)>;
	};
	/omit-if-no-ref/ pin_spim0dq3: pin_spim0dq3 {
		ball = <F2>;
		sig_descs = <SIG_DESC(0x454, 8, 1)>;
		drive-strength-desc = <PINCFG_DESC(0x5d4, 4, 4)>;
		bias-disable-desc = <PINCFG_DESC(0x5d4, 0, 1)>;
		pull-up-disable-desc = <PINCFG_DESC(0x5d4, 2, 1)>;
	};
	/omit-if-no-ref/ pin_spif0dq3_o: pin_spif0dq3_o {
		ball = <F2>;
		sig_descs = <SIG_DESC(0x454, 8, 2)>;
		drive-strength-desc = <PINCFG_DESC(0x5d4, 4, 4)>;
		bias-disable-desc = <PINCFG_DESC(0x5d4, 0, 1)>;
		pull-up-disable-desc = <PINCFG_DESC(0x5d4, 2, 1)>;
	};
	/omit-if-no-ref/ pin_spis0dq3: pin_spis0dq3 {
		ball = <F2>;
		sig_descs = <SIG_DESC(0x454, 8, 3)>;
		drive-strength-desc = <PINCFG_DESC(0x5d4, 4, 4)>;
		bias-disable-desc = <PINCFG_DESC(0x5d4, 0, 1)>;
		pull-up-disable-desc = <PINCFG_DESC(0x5d4, 2, 1)>;
	};
	/omit-if-no-ref/ pin_adc00: pin_adc00 {
		ball = <F12>;
		sig_descs = <SIG_DESC(0x454, 12, 1)>;
		drive-strength-desc = <PINCFG_DESC(0x5d4, 20, 4)>;
		bias-disable-desc = <PINCFG_DESC(0x5d4, 16, 1)>;
		pull-up-disable-desc = <PINCFG_DESC(0x5d4, 18, 1)>;
	};
	/omit-if-no-ref/ pin_adc01: pin_adc01 {
		ball = <A13>;
		sig_descs = <SIG_DESC(0x454, 16, 1)>;
		drive-strength-desc = <PINCFG_DESC(0x5d8, 4, 4)>;
		bias-disable-desc = <PINCFG_DESC(0x5d8, 0, 1)>;
		pull-up-disable-desc = <PINCFG_DESC(0x5d8, 2, 1)>;
	};
	/omit-if-no-ref/ pin_adc02: pin_adc02 {
		ball = <E12>;
		sig_descs = <SIG_DESC(0x454, 20, 1)>;
		drive-strength-desc = <PINCFG_DESC(0x5d8, 20, 4)>;
		bias-disable-desc = <PINCFG_DESC(0x5d8, 16, 1)>;
		pull-up-disable-desc = <PINCFG_DESC(0x5d8, 18, 1)>;
	};
	/omit-if-no-ref/ pin_adc03: pin_adc03 {
		ball = <B12>;
		sig_descs = <SIG_DESC(0x454, 24, 1)>;
		drive-strength-desc = <PINCFG_DESC(0x5dc, 4, 4)>;
		bias-disable-desc = <PINCFG_DESC(0x5dc, 0, 1)>;
		pull-up-disable-desc = <PINCFG_DESC(0x5dc, 2, 1)>;
	};
	/omit-if-no-ref/ pin_adc04: pin_adc04 {
		ball = <G12>;
		sig_descs = <SIG_DESC(0x454, 28, 1)>;
		drive-strength-desc = <PINCFG_DESC(0x5dc, 20, 4)>;
		bias-disable-desc = <PINCFG_DESC(0x5dc, 16, 1)>;
		pull-up-disable-desc = <PINCFG_DESC(0x5dc, 18, 1)>;
	};
	/omit-if-no-ref/ pin_adc05: pin_adc05 {
		ball = <C12>;
		sig_descs = <SIG_DESC(0x458, 0, 1)>;
		drive-strength-desc = <PINCFG_DESC(0x5e0, 4, 4)>;
		bias-disable-desc = <PINCFG_DESC(0x5e0, 0, 1)>;
		pull-up-disable-desc = <PINCFG_DESC(0x5e0, 2, 1)>;
	};
	/omit-if-no-ref/ pin_adc06: pin_adc06 {
		ball = <D12>;
		sig_descs = <SIG_DESC(0x458, 4, 1)>;
		drive-strength-desc = <PINCFG_DESC(0x5e0, 20, 4)>;
		bias-disable-desc = <PINCFG_DESC(0x5e0, 16, 1)>;
		pull-up-disable-desc = <PINCFG_DESC(0x5e0, 18, 1)>;
	};
	/omit-if-no-ref/ pin_auxpwrgood: pin_auxpwrgood {
		ball = <D12>;
		sig_descs = <SIG_DESC(0x458, 4, 3)>;
		drive-strength-desc = <PINCFG_DESC(0x5e0, 20, 4)>;
		bias-disable-desc = <PINCFG_DESC(0x5e0, 16, 1)>;
		pull-up-disable-desc = <PINCFG_DESC(0x5e0, 18, 1)>;
	};
	/omit-if-no-ref/ pin_adc07: pin_adc07 {
		ball = <C13>;
		sig_descs = <SIG_DESC(0x458, 8, 1)>;
		drive-strength-desc = <PINCFG_DESC(0x5e4, 4, 4)>;
		bias-disable-desc = <PINCFG_DESC(0x5e4, 0, 1)>;
		pull-up-disable-desc = <PINCFG_DESC(0x5e4, 2, 1)>;
	};
	/omit-if-no-ref/ pin_adc08: pin_adc08 {
		ball = <A12>;
		sig_descs = <SIG_DESC(0x458, 12, 1)>;
		drive-strength-desc = <PINCFG_DESC(0x5e4, 20, 4)>;
		bias-disable-desc = <PINCFG_DESC(0x5e4, 16, 1)>;
		pull-up-disable-desc = <PINCFG_DESC(0x5e4, 18, 1)>;
	};
	/omit-if-no-ref/ pin_adc09: pin_adc09 {
		ball = <D11>;
		sig_descs = <SIG_DESC(0x458, 16, 1)>;
		drive-strength-desc = <PINCFG_DESC(0x5e8, 4, 4)>;
		bias-disable-desc = <PINCFG_DESC(0x5e8, 0, 1)>;
		pull-up-disable-desc = <PINCFG_DESC(0x5e8, 2, 1)>;
	};
	/omit-if-no-ref/ pin_adc10: pin_adc10 {
		ball = <B11>;
		sig_descs = <SIG_DESC(0x458, 20, 1)>;
		drive-strength-desc = <PINCFG_DESC(0x5e8, 20, 4)>;
		bias-disable-desc = <PINCFG_DESC(0x5e8, 16, 1)>;
		pull-up-disable-desc = <PINCFG_DESC(0x5e8, 18, 1)>;
	};
	/omit-if-no-ref/ pin_adc11: pin_adc11 {
		ball = <C11>;
		sig_descs = <SIG_DESC(0x458, 24, 1)>;
		drive-strength-desc = <PINCFG_DESC(0x5ec, 4, 4)>;
		bias-disable-desc = <PINCFG_DESC(0x5ec, 0, 1)>;
		pull-up-disable-desc = <PINCFG_DESC(0x5ec, 2, 1)>;
	};
	/omit-if-no-ref/ pin_adc12: pin_adc12 {
		ball = <A11>;
		sig_descs = <SIG_DESC(0x458, 28, 1)>;
		drive-strength-desc = <PINCFG_DESC(0x5ec, 20, 4)>;
		bias-disable-desc = <PINCFG_DESC(0x5ec, 16, 1)>;
		pull-up-disable-desc = <PINCFG_DESC(0x5ec, 18, 1)>;
	};
	/omit-if-no-ref/ pin_adc13: pin_adc13 {
		ball = <E10>;
		sig_descs = <SIG_DESC(0x45c, 0, 1)>;
		drive-strength-desc = <PINCFG_DESC(0x5f0, 4, 4)>;
		bias-disable-desc = <PINCFG_DESC(0x5f0, 0, 1)>;
		pull-up-disable-desc = <PINCFG_DESC(0x5f0, 2, 1)>;
	};
	/omit-if-no-ref/ pin_adc14: pin_adc14 {
		ball = <A10>;
		sig_descs = <SIG_DESC(0x45c, 4, 1)>;
		drive-strength-desc = <PINCFG_DESC(0x5f0, 20, 4)>;
		bias-disable-desc = <PINCFG_DESC(0x5f0, 16, 1)>;
		pull-up-disable-desc = <PINCFG_DESC(0x5f0, 18, 1)>;
	};
	/omit-if-no-ref/ pin_adc15: pin_adc15 {
		ball = <B10>;
		sig_descs = <SIG_DESC(0x45c, 8, 1)>;
		drive-strength-desc = <PINCFG_DESC(0x5f4, 4, 4)>;
		bias-disable-desc = <PINCFG_DESC(0x5f4, 0, 1)>;
		pull-up-disable-desc = <PINCFG_DESC(0x5f4, 2, 1)>;
	};
	/omit-if-no-ref/ pin_bmctxd: pin_bmctxd {
		ball = <R9>;
		sig_descs = <SIG_DESC(0x45c, 12, 1)>;
		drive-strength-desc = <PINCFG_DESC(0x5f4, 20, 4)>;
		bias-disable-desc = <PINCFG_DESC(0x5f4, 16, 1)>;
		pull-up-disable-desc = <PINCFG_DESC(0x5f4, 18, 1)>;
	};
	/omit-if-no-ref/ pin_bmcrxd: pin_bmcrxd {
		ball = <P10>;
		sig_descs = <SIG_DESC(0x45c, 16, 1)>;
		drive-strength-desc = <PINCFG_DESC(0x5f8, 4, 4)>;
		bias-disable-desc = <PINCFG_DESC(0x5f8, 0, 1)>;
		pull-up-disable-desc = <PINCFG_DESC(0x5f8, 2, 1)>;
	};
	/omit-if-no-ref/ pin_spim1cs0: pin_spim1cs0 {
		ball = <J5>;
		sig_descs = <SIG_DESC(0x45c, 20, 1)>;
		drive-strength-desc = <PINCFG_DESC(0x5f8, 20, 4)>;
		bias-disable-desc = <PINCFG_DESC(0x5f8, 16, 1)>;
		pull-up-disable-desc = <PINCFG_DESC(0x5f8, 18, 1)>;
	};
	/omit-if-no-ref/ pin_spif2cs0_o: pin_spif2cs0_o {
		ball = <J5>;
		sig_descs = <SIG_DESC(0x45c, 20, 2)>;
		drive-strength-desc = <PINCFG_DESC(0x5f8, 20, 4)>;
		bias-disable-desc = <PINCFG_DESC(0x5f8, 16, 1)>;
		pull-up-disable-desc = <PINCFG_DESC(0x5f8, 18, 1)>;
	};
	/omit-if-no-ref/ pin_spis1cs0: pin_spis1cs0 {
		ball = <J5>;
		sig_descs = <SIG_DESC(0x45c, 20, 3)>;
		drive-strength-desc = <PINCFG_DESC(0x5f8, 20, 4)>;
		bias-disable-desc = <PINCFG_DESC(0x5f8, 16, 1)>;
		pull-up-disable-desc = <PINCFG_DESC(0x5f8, 18, 1)>;
	};
	/omit-if-no-ref/ pin_spim1cs1: pin_spim1cs1 {
		ball = <J4>;
		sig_descs = <SIG_DESC(0x45c, 24, 1)>;
		drive-strength-desc = <PINCFG_DESC(0x5fc, 4, 4)>;
		bias-disable-desc = <PINCFG_DESC(0x5fc, 0, 1)>;
		pull-up-disable-desc = <PINCFG_DESC(0x5fc, 2, 1)>;
	};
	/omit-if-no-ref/ pin_spif2cs1_o: pin_spif2cs1_o {
		ball = <J4>;
		sig_descs = <SIG_DESC(0x45c, 24, 2)>;
		drive-strength-desc = <PINCFG_DESC(0x5fc, 4, 4)>;
		bias-disable-desc = <PINCFG_DESC(0x5fc, 0, 1)>;
		pull-up-disable-desc = <PINCFG_DESC(0x5fc, 2, 1)>;
	};
	/omit-if-no-ref/ pin_spim0cs0: pin_spim0cs0 {
		ball = <E5>;
		sig_descs = <SIG_DESC(0x45c, 28, 1)>;
		drive-strength-desc = <PINCFG_DESC(0x5fc, 20, 4)>;
		bias-disable-desc = <PINCFG_DESC(0x5fc, 16, 1)>;
		pull-up-disable-desc = <PINCFG_DESC(0x5fc, 18, 1)>;
	};
	/omit-if-no-ref/ pin_spif0cs0_o: pin_spif0cs0_o {
		ball = <E5>;
		sig_descs = <SIG_DESC(0x45c, 28, 2)>;
		drive-strength-desc = <PINCFG_DESC(0x5fc, 20, 4)>;
		bias-disable-desc = <PINCFG_DESC(0x5fc, 16, 1)>;
		pull-up-disable-desc = <PINCFG_DESC(0x5fc, 18, 1)>;
	};
	/omit-if-no-ref/ pin_spis0cs0: pin_spis0cs0 {
		ball = <E5>;
		sig_descs = <SIG_DESC(0x45c, 28, 3)>;
		drive-strength-desc = <PINCFG_DESC(0x5fc, 20, 4)>;
		bias-disable-desc = <PINCFG_DESC(0x5fc, 16, 1)>;
		pull-up-disable-desc = <PINCFG_DESC(0x5fc, 18, 1)>;
	};
	/omit-if-no-ref/ pin_spim0cs1: pin_spim0cs1 {
		ball = <F6>;
		sig_descs = <SIG_DESC(0x460, 0, 1)>;
		drive-strength-desc = <PINCFG_DESC(0x600, 4, 4)>;
		bias-disable-desc = <PINCFG_DESC(0x600, 0, 1)>;
		pull-up-disable-desc = <PINCFG_DESC(0x600, 2, 1)>;
	};
	/omit-if-no-ref/ pin_spif0cs1_o: pin_spif0cs1_o {
		ball = <F6>;
		sig_descs = <SIG_DESC(0x460, 0, 2)>;
		drive-strength-desc = <PINCFG_DESC(0x600, 4, 4)>;
		bias-disable-desc = <PINCFG_DESC(0x600, 0, 1)>;
		pull-up-disable-desc = <PINCFG_DESC(0x600, 2, 1)>;
	};
	/omit-if-no-ref/ pin_spis0cs1: pin_spis0cs1 {
		ball = <F6>;
		sig_descs = <SIG_DESC(0x460, 0, 3)>;
		drive-strength-desc = <PINCFG_DESC(0x600, 4, 4)>;
		bias-disable-desc = <PINCFG_DESC(0x600, 0, 1)>;
		pull-up-disable-desc = <PINCFG_DESC(0x600, 2, 1)>;
	};
	/omit-if-no-ref/ pin_rstind: pin_rstind {
		ball = <J14>;
		sig_descs = <SIG_DESC(0x460, 4, 1)>;
		drive-strength-desc = <PINCFG_DESC(0x600, 20, 4)>;
		bias-disable-desc = <PINCFG_DESC(0x600, 16, 1)>;
		pull-up-disable-desc = <PINCFG_DESC(0x600, 18, 1)>;
	};

	/* SCU3B0[1:0] SCU_USBA_SEL */
	/omit-if-no-ref/ pin_usba_usbuart_vhub: pin_usba_usbuart_vhub {
		ball = <PORTA_MODE>;
		sig_descs = <SIG_DESC(0x3B0, 0, 0)>;
	};
	/omit-if-no-ref/ pin_usba_vhub: pin_usba_vhub {
		ball = <PORTA_MODE>;
		sig_descs = <SIG_DESC(0x3B0, 0, 1)>;
	};
	/omit-if-no-ref/ pin_usba_ehci: pin_usba_ehci {
		ball = <PORTA_MODE>;
		sig_descs = <SIG_DESC(0x3B0, 0, 2)>;
	};
	/omit-if-no-ref/ pin_usba_usbuart: pin_usba_usbuart {
		ball = <PORTA_MODE>;
		sig_descs = <SIG_DESC(0x3B0, 0, 3)>;
	};

	/* SCU3B0[3:2] SCU_USBB_SEL */
	/omit-if-no-ref/ pin_usbb_vhub: pin_usbb_vhub {
		ball = <PORTB_MODE>;
		sig_descs = <SIG_DESC(0x3B0, 2, 1)>;
	};
	/omit-if-no-ref/ pin_usbb_ehci: pin_usbb_ehci {
		ball = <PORTB_MODE>;
		sig_descs = <SIG_DESC(0x3B0, 2, 2)>;
	};

	/*
	 * Pure-GPIO balls with no alternate-function pinctrl node of
	 * their own in this file; added purely to carry real pincfg
	 * (drive-strength / bias-disable) values for every ball in the
	 * SCU480-SCU600 IO Control family.
	 */
	/omit-if-no-ref/ pin_gpio116: pin_gpio116 {
		ball = <A6>;
		drive-strength-desc = <PINCFG_DESC(0x568, 4, 4)>;
		bias-disable-desc = <PINCFG_DESC(0x568, 0, 1)>;
		pull-up-disable-desc = <PINCFG_DESC(0x568, 2, 1)>;
	};
	/omit-if-no-ref/ pin_gpio114: pin_gpio114 {
		ball = <A7>;
		drive-strength-desc = <PINCFG_DESC(0x564, 4, 4)>;
		bias-disable-desc = <PINCFG_DESC(0x564, 0, 1)>;
		pull-up-disable-desc = <PINCFG_DESC(0x564, 2, 1)>;
	};
	/omit-if-no-ref/ pin_gpio112: pin_gpio112 {
		ball = <A8>;
		drive-strength-desc = <PINCFG_DESC(0x560, 4, 4)>;
		bias-disable-desc = <PINCFG_DESC(0x560, 0, 1)>;
		pull-up-disable-desc = <PINCFG_DESC(0x560, 2, 1)>;
	};
	/omit-if-no-ref/ pin_gpio108: pin_gpio108 {
		ball = <A9>;
		drive-strength-desc = <PINCFG_DESC(0x558, 4, 4)>;
		bias-disable-desc = <PINCFG_DESC(0x558, 0, 1)>;
		pull-up-disable-desc = <PINCFG_DESC(0x558, 2, 1)>;
	};
	/omit-if-no-ref/ pin_gpio117: pin_gpio117 {
		ball = <B7>;
		drive-strength-desc = <PINCFG_DESC(0x568, 20, 4)>;
		bias-disable-desc = <PINCFG_DESC(0x568, 16, 1)>;
		pull-up-disable-desc = <PINCFG_DESC(0x568, 18, 1)>;
	};
	/omit-if-no-ref/ pin_gpio113: pin_gpio113 {
		ball = <B8>;
		drive-strength-desc = <PINCFG_DESC(0x560, 20, 4)>;
		bias-disable-desc = <PINCFG_DESC(0x560, 16, 1)>;
		pull-up-disable-desc = <PINCFG_DESC(0x560, 18, 1)>;
	};
	/omit-if-no-ref/ pin_gpio109: pin_gpio109 {
		ball = <B9>;
		drive-strength-desc = <PINCFG_DESC(0x558, 20, 4)>;
		bias-disable-desc = <PINCFG_DESC(0x558, 16, 1)>;
		pull-up-disable-desc = <PINCFG_DESC(0x558, 18, 1)>;
	};
	/omit-if-no-ref/ pin_gpio111: pin_gpio111 {
		ball = <C9>;
		drive-strength-desc = <PINCFG_DESC(0x55c, 20, 4)>;
		bias-disable-desc = <PINCFG_DESC(0x55c, 16, 1)>;
		pull-up-disable-desc = <PINCFG_DESC(0x55c, 18, 1)>;
	};
	/omit-if-no-ref/ pin_gpio110: pin_gpio110 {
		ball = <D9>;
		drive-strength-desc = <PINCFG_DESC(0x55c, 4, 4)>;
		bias-disable-desc = <PINCFG_DESC(0x55c, 0, 1)>;
		pull-up-disable-desc = <PINCFG_DESC(0x55c, 2, 1)>;
	};
	/omit-if-no-ref/ pin_gpio115: pin_gpio115 {
		ball = <E8>;
		drive-strength-desc = <PINCFG_DESC(0x564, 20, 4)>;
		bias-disable-desc = <PINCFG_DESC(0x564, 16, 1)>;
		pull-up-disable-desc = <PINCFG_DESC(0x564, 18, 1)>;
	};
};
