## dts/bindings/spi/aspeed,ast2600-spi-controller.yaml
```yaml
# Copyright (c) 2026 ASPEED Technology Inc.
# SPDX-License-Identifier: Apache-2.0

description: ASPEED AST2600 FMC_SPI controller node

compatible: "aspeed,ast2600-spi-controller"

include: aspeed,spi-common.yaml
```

## dts/bindings/spi/aspeed,ast2700-spi-controller.yaml
```yaml
# Copyright (c) 2026 ASPEED Technology Inc.
# SPDX-License-Identifier: Apache-2.0

description: ASPEED AST2700 FMC_SPI controller node

compatible: "aspeed,ast2700-spi-controller"

include: aspeed,spi-common.yaml
```

## dts/bindings/spi/aspeed,ast2700-spi-lite-controller.yaml
```yaml
# Copyright (c) 2026 ASPEED Technology Inc.
# SPDX-License-Identifier: Apache-2.0

description: ASPEED AST2700 SPI Lite controller node

compatible: "aspeed,ast2700-spi-lite-controller"

include: aspeed,spi-common.yaml
```

## dts/bindings/spi/aspeed,spi-controller.yaml
```yaml
# Copyright (c) 2021 - 2023 Chin-Ting Kuo <chin-ting_kuo@aspeedtech.com>
# SPDX-License-Identifier: Apache-2.0

description: ASPEED FMC_SPI controller legacy common binding

compatible: "aspeed,spi-controller"

include: aspeed,spi-common.yaml
```

## dts/bindings/timer/aspeed,ast2700-bootmcu-timer.yaml
```yaml
# Copyright (c) 2024, Aspeed Technology Inc.
# SPDX-License-Identifier: Apache-2.0

description: Aspeed, AST2700 BootMCU timer
  The AST2700 BootMCU machine timer provides RISC-V privileged mie and mip
  registers.

compatible: "aspeed,ast2700-bootmcu-timer"

include: base.yaml

properties:
  reg:
    required: true

  interrupts:
    required: true
```

## dts/bindings/timer/aspeed,ast2700-ibex-timer.yaml
```yaml
# Copyright (c) 2024, Aspeed Technology Inc.
# SPDX-License-Identifier: Apache-2.0

description: Aspeed, AST2700 Ibex timer
  The AST2700 Ibex machine timer provides RISC-V privileged mie and mip
  registers.

compatible: "aspeed,ast2700-ibex-timer"

include: base.yaml

properties:
  reg:
    required: true

  interrupts:
    required: true
```

## dts/bindings/usb/aspeed,ast27xx-usb.yaml
```yaml
description: Binding for ASPEED AST27xx USB

compatible: "aspeed,ast27xx-usb"

include: [base.yaml]

properties:
  usb-function:
    type: string
    enum:
      - "NOT_USED"
      - "EHCI_VHUB_AND_XHCI_PHY"
      - "XHCI_PHY"
      - "XHCI_VHUB"
      - "EHCI_VHUB"
      - "VHUB_PHY"
      - "EHCI_PHY"
    description: |
      Configure SoC0 USB function mode:

      - NOT_USED: USB port is not used.
      - EHCI_VHUB_AND_XHCI_PHY: PCIe-EHCI-vHUB + (PCIe or BMC)-XHCI-PHY.
      - XHCI_PHY: (PCIe or BMC)-XHCI-PHY.
      - XHCI_VHUB: (PCIe or BMC)-XHCI-vHUB.
      - EHCI_VHUB: PCIe-EHCI-vHUB.
      - VHUB_PHY: vHUB-PHY.
      - EHCI_PHY: (PCIe or BMC)-EHCI-PHY.

      For PCIe-EHCI-* or PCIe-XHCI-* enablement, refer to aspeed,ast27xx-pcie.yaml.

  enable-large-burst:
    type: boolean
    description:
      Enable larger bus burst size for PCIe-XHCI when the PCIe max payload size is 256/512 bytes.
```

## dts/bindings/watchdog/aspeed,ast-watchdog-g7.yaml
```yaml
# Copyright (c) 2023, ASPEED Corporation
# SPDX-License-Identifier: Apache-2.0

description: ASPEED watchdog timer controller

compatible: "aspeed,ast-watchdog-g7"

include: [base.yaml]

properties:
  reg:
    required: true

  interrupts:
    required: false

  reset-mask:
    type: array
    required: true
    description: Record default reset masks.
```

## dts/bindings/watchdog/aspeed,ast10x0-g2-watchdog.yaml
```yaml
# Copyright (c) 2026, ASPEED Corporation
# SPDX-License-Identifier: Apache-2.0

description: ASPEED AST10x0-G2 watchdog timer controller

compatible: "aspeed,ast10x0-g2-watchdog"

include: [base.yaml]

properties:
  reg:
    required: true

  aspeed,scu:
    type: phandle
    required: true
    description: phandle to SCU device tree node.

  reset-mask:
    type: array
    required: true
    description: Three 32-bit reset mask values for WDT SoC reset registers (offsets 0x24-0x2C).

  interrupts:
    required: false
    description: |
      IRQ line for this WDT controller.
      Omit for CPUs that do not require a WDT interrupt.
```

## dts/bindings/watchdog/aspeed,ast2700-watchdog.yaml
```yaml
# Copyright (c) 2023, ASPEED Corporation
# SPDX-License-Identifier: Apache-2.0

description: ASPEED AST2700 watchdog timer controller

compatible: "aspeed,ast2700-watchdog"

include: [base.yaml]

properties:
  reg:
    required: true

  aspeed,scu1:
    type: phandle
    required: true
    description: phandle to SCU1 device tree node.

  aspeed,scu0:
    type: phandle
    required: true
    description: phandle to SCU0 device tree node.

  reset-mask:
    type: array
    required: true
    description: Five 32-bit reset mask values for WDT SoC reset registers (offsets 0x1C-0x2C).

  interrupts:
    required: false
    description: |
      IRQ line for this WDT controller.
      Omit for CPUs that do not require a WDT interrupt,
      where hardware reset on timeout is sufficient.
```

## samples/drivers/espi_aspeed/safs/sample.yaml
```yaml
sample:
  name: Aspeed eSPI SAFS test
tests:
  sample.board.ast2700_evb_ast2700_ssp:
    platform_allow: ast2700_evb_ast2700_ssp
```

## samples/drivers/misc/aspeed/pcc/boards/ast1040_evb_ast1040_cm4.conf
```kconfig
CONFIG_ESPI=y
CONFIG_ESPI_ASPEED_V2=y
CONFIG_PCC_ASPEED=y
CONFIG_LOG_MODE_IMMEDIATE=y
CONFIG_LOG=y
```

## samples/drivers/misc/aspeed/uart_routing/sample.yaml
```yaml
sample:
  name: Aspeed UART routing shell demo sample
tests:
  sample.board.ast1040_evb_ast1040_cm4:
    platform_allow: ast1040_evb/ast1040/cm4
```

## samples/ram_access/boards/ast1030_evb.conf
```kconfig
CONFIG_CRYPTO=n
CONFIG_CRYPTO_ASPEED=n
CONFIG_GPIO=n
CONFIG_GPIO_SHELL=n
CONFIG_GPIO_ASPEED=n
CONFIG_RSA_ASPEED=n
CONFIG_ECDSA_ASPEED=n
CONFIG_MBEDTLS=n
CONFIG_MBEDTLS_KEY_EXCHANGE_DHE_RSA_ENABLED=n
CONFIG_MBEDTLS_KEY_EXCHANGE_ECDH_ECDSA_ENABLED=n
CONFIG_MBEDTLS_ECDH_C=n
CONFIG_MBEDTLS_ECDSA_C=n
CONFIG_MBEDTLS_ECP_C=n
CONFIG_MBEDTLS_ECP_DP_SECP384R1_ENABLED=n
CONFIG_MBEDTLS=n
```

## samples/ram_access/sample.yaml
```yaml
sample:
  description: RAM access sample
  name: ram access
common:
  tags: introduction
  integration_platforms:
    - native_sim
  harness: console
  harness_config:
    type: one_line
```

## samples/subsys/usb/cdc_acm/boards/ast1040_evb_ast1040_cm4.conf
```kconfig
CONFIG_PECI=n
CONFIG_SENSOR=n
CONFIG_ADC=n
CONFIG_PWM=n
CONFIG_TACH_ASPEED=n
CONFIG_FLASH_SHELL=n
CONFIG_KERNEL_SHELL=n
CONFIG_GPIO_SHELL=n
CONFIG_I2C=n
CONFIG_SPI=n
CONFIG_FLASH=n
CONFIG_WATCHDOG=n
CONFIG_GPIO=n
#CONFIG_USB_DRIVER_LOG_LEVEL_DBG=y
#CONFIG_USB_DRIVER_LOG_LEVEL_INF=y
```

## soc/aspeed/ast1040/Kconfig
```kconfig
# SPDX-License-Identifier: Apache-2.0
#
# Copyright (c) 2023 ASPEED Technology Inc.

config SOC_SERIES_AST1040
	select ARM
	select CPU_CORTEX_M4
	select CPU_HAS_FPU
	select CPU_HAS_ARM_MPU
	select SYSCON
	select CACHE
	select CPU_HAS_DCACHE
	select CPU_HAS_ICACHE
	select CACHE_MANAGEMENT
	select CACHE_ASPEED
```

## soc/aspeed/ast1040/Kconfig.defconfig
```kconfig
# SPDX-License-Identifier: Apache-2.0
#
# Copyright (c) 2023 ASPEED Technology Inc.

if SOC_SERIES_AST1040

rsource "Kconfig.defconfig.cm4"
rsource "Kconfig.defconfig.bootmcu"

endif # SOC_SERIES_AST1040
```

## soc/aspeed/ast1040/Kconfig.defconfig.cm4
```kconfig
# SPDX-License-Identifier: Apache-2.0
#
# Copyright (c) 2023 ASPEED Technology Inc.

if SOC_SERIES_AST1040_CM4

config NUM_IRQS
	default 240

config ICACHE_LINE_SIZE
	default 32

config DCACHE_LINE_SIZE
	default 32

choice CACHE_TYPE
	default EXTERNAL_CACHE
endchoice

config LINKER_LAST_SECTION_ID
	default n

config CLOCK_CONTROL_INIT_PRIORITY
	default SYSCON_INIT_PRIORITY

config RESET_INIT_PRIORITY
	default SYSCON_INIT_PRIORITY

endif # SOC_SERIES_AST1040_CM4
```

## soc/aspeed/ast1040/Kconfig.soc
```kconfig
# SPDX-License-Identifier: Apache-2.0
#
# Copyright (c) 2023 ASPEED Technology Inc.

config SOC_SERIES_AST1040
	bool
	select SOC_FAMILY_ASPEED
	help
	  Enable support for ASPEED AST1040 series

config SOC_SERIES_AST1040_CM4
	bool
	select SOC_SERIES_AST1040

config SOC_SERIES_AST1040_BOOTMCU
	bool
	select SOC_SERIES_AST1040

config SOC_AST1040_CM4
	bool
	select SOC_SERIES_AST1040_CM4
	help
	  AST1040 CM4 SOC

config SOC_AST1040_BOOTMCU
	bool
	select SOC_SERIES_AST1040_BOOTMCU
	help
	  AST1040 BOOTMCU SOC

config SOC_SERIES
	default "ast1040" if SOC_SERIES_AST1040

config SOC
	default "ast1040" if SOC_AST1040
```

## soc/aspeed/ast10x0/Kconfig
```kconfig
# SPDX-License-Identifier: Apache-2.0
#
# Copyright (c) 2021 ASPEED Technology Inc.

config SOC_SERIES_AST10X0
	select ARM
	select CPU_CORTEX_M4
	select CPU_HAS_FPU
	select CPU_HAS_ARM_MPU
	select SYSCON
	select CACHE
	select CPU_HAS_DCACHE
	select CPU_HAS_ICACHE
	select CACHE_MANAGEMENT
	select CACHE_ASPEED
```

## soc/aspeed/ast10x0_g2/Kconfig
```kconfig
# SPDX-License-Identifier: Apache-2.0
#
# Copyright (c) 2023 ASPEED Technology Inc.

config SOC_SERIES_AST10x0_G2_CM4
	select ARM
	select CPU_CORTEX_M4
	select CPU_CORTEX_M_HAS_DWT
	select CPU_HAS_FPU
	select CPU_HAS_ARM_MPU
	select SYSCON
	select CACHE
	select CPU_HAS_DCACHE
	select CPU_HAS_ICACHE
	select CACHE_MANAGEMENT
	select CACHE_ASPEED

config SOC_SERIES_AST10x0_G2_BOOTMCU
	select RISCV
	select RISCV_PRIVILEGED
	select RISCV_VECTORED_MODE
	select GEN_IRQ_VECTOR_TABLE
	select ATOMIC_OPERATIONS_C
	select INCLUDE_RESET_VECTOR
	select SYSCON
	select RISCV_ISA_RV32I
	select RISCV_ISA_EXT_M
	select RISCV_ISA_EXT_C
	select RISCV_ISA_EXT_ZICSR
	select RISCV_ISA_EXT_ZIFENCEI
```
