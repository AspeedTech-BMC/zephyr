## dts/bindings/ipm/aspeed,ast2700-ipc.yaml
```yaml
# Copyright (c) 2023 ASPEED Technology Inc.
# SPDX-License-Identifier: Apache-2.0

description: ASPEED IPC (Interprocessor Communication) in AST2700 SOC

compatible: "aspeed,ast2700-ipc"

include: base.yaml

properties:
    reg:
      required: true

    interrupts:
      required: true

    reg-tx-offset:
      type: int
      required: true

    reg-rx-offset:
      type: int
      required: true

    shmem_ch0:
      description: Arrary to the shared memory region used for data exchange on channel 0
      required: false
      type: array

    shmem_ch1:
      description: Arrary to the shared memory region used for data exchange on channel 1
      required: false
      type: array

    shmem_ch2:
      description: Arrary to the shared memory region used for data exchange on channel 2
      required: false
      type: array

    shmem_ch3:
      description: Arrary to the shared memory region used for data exchange on channel 3
      required: false
      type: array
```

## dts/bindings/ipm/aspeed,bootmcu-ipc.yaml
```yaml
# Copyright (c) 2024 ASPEED Technology Inc.
# SPDX-License-Identifier: Apache-2.0

description: ASPEED BOOTMCU IPC (Interprocessor Communication) in AST2700 SOC

compatible: "aspeed,bootmcu-ipc"

include: base.yaml

properties:
    reg:
      required: true

    reg-tx-offset:
      type: int
      required: true

    reg-rx-offset:
      type: int
      required: true

    shmem_ch0:
      description: Arrary to the shared memory region used for data exchange on channel 0
      required: false
      type: array

    shmem_ch1:
      description: Arrary to the shared memory region used for data exchange on channel 1
      required: false
      type: array

    shmem_ch2:
      description: Arrary to the shared memory region used for data exchange on channel 2
      required: false
      type: array

    shmem_ch3:
      description: Arrary to the shared memory region used for data exchange on channel 3
      required: false
      type: array
```

## dts/bindings/ltpi/aspeed,ast10x0-g2-ltpi.yaml
```yaml
# Copyright (c) 2026, Aspeed Technology Inc.
# SPDX-License-Identifier: Apache-2.0

description: Aspeed AST10X0-G2 LTPI controller operating in the HPM role

compatible: "aspeed,ast10x0-g2-ltpi"

include: [base.yaml, reset-device.yaml]

properties:
    aspeed,scu:
      type: phandle
      required: true
      description: phandle to SCU device tree node
```

## dts/bindings/ltpi/aspeed,ast27xx-ltpi.yaml
```yaml
# Copyright (c) 2025, Aspeed Technology Inc.
# SPDX-License-Identifier: Apache-2.0

description: Aspeed, AST27xx LTPI controller

compatible: "aspeed,ast27xx-ltpi"

include: [base.yaml, reset-device.yaml]

properties:
    aspeed,scu:
      type: phandle
      required: true
      description: phandle to SCU device tree node

    index:
      type: int
      required: true
      description: specify the HW index
```

## dts/bindings/misc/aspeed,ast10x0-g2-atc.yaml
```yaml
# Copyright (c) 2026, ASPEED Corporation
# SPDX-License-Identifier: Apache-2.0

description: ASPEED AST10x0-G2 Anti-Tamper Controller (ATC)

compatible: "aspeed,ast10x0-g2-atc"

include: [base.yaml]

properties:
  reg:
    required: true

  interrupts:
    required: true
    description: |
      TSENSE (temperature sensor) anti-tamper interrupt line.
      Clock attack monitor, glitch detection and IR drop interrupts
      are not wired up yet.
```

## dts/bindings/misc/aspeed,ast2700-ssp-psp-reset-notify.yaml
```yaml
# Copyright (c) 2026, ASPEED Technology Inc.
# SPDX-License-Identifier: Apache-2.0

description: ASPEED AST27xx SSP PSP reset interrupt notification (intc_sw bit 7)

compatible: "aspeed,ast2700-ssp-psp-reset-notify"

include: base.yaml

properties:
  interrupts:
    required: true
```
