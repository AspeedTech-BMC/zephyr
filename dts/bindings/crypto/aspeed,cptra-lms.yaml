## dts/bindings/crypto/aspeed,cptra-lms.yaml
```yaml
# SPDX-License-Identifier: Apache-2.0

title: Aspeed CPTRA LMS

description: |
  This binding gives a representation of the Aspeed CPTRA LMS hardware.

properties:
  compatible:
    enum:
      - aspeed,cptra-lms

  reg:
    description: Base address and size of the LMS registers.
    items:
      - description: Base address
      - description: Size

  status:
    type: string
    description: Indicates the operational status of the device.
    enum:
      - okay
      - disabled

required:
  - compatible
  - reg
  - status

additionalProperties: false
```

## dts/bindings/crypto/aspeed,cptra-mci-ecdsa.yaml
```yaml
# Copyright (c) 2025 ASPEED Technology Inc.
# SPDX-License-Identifier: Apache-2.0

description: ASPEED Caliptra-SS MCI mailbox raw-pubkey ECDSA-384 verify (MC_ECDSA384_SIG_VERIFY)

compatible: "aspeed,cptra-mci-ecdsa"

include: base.yaml
```

## dts/bindings/crypto/aspeed,cptra-mci-lms.yaml
```yaml
# Copyright (c) 2025 ASPEED Technology Inc.
# SPDX-License-Identifier: Apache-2.0

description: ASPEED Caliptra-SS MCI mailbox LMS signature verify (MC_LMS_SIG_VERIFY)

compatible: "aspeed,cptra-mci-lms"

include: base.yaml
```

## dts/bindings/crypto/aspeed,cptra-mci-mldsa.yaml
```yaml
# Copyright (c) 2025 ASPEED Technology Inc.
# SPDX-License-Identifier: Apache-2.0

description: ASPEED Caliptra-SS MCI mailbox raw-pubkey ML-DSA-87 signature verify (MC_MLDSA87_SIG_VERIFY)

compatible: "aspeed,cptra-mci-mldsa"

include: base.yaml
```

## dts/bindings/crypto/aspeed,cptra-mci-sha-acc.yaml
```yaml
# Copyright (c) 2026 ASPEED Technology Inc.
# SPDX-License-Identifier: Apache-2.0

description: ASPEED Caliptra-SS MCI mailbox SHA_ACC DMA-path engine (MC_SHA_ACC_INIT/UPDATE/FINAL)

compatible: "aspeed,cptra-mci-sha-acc"

include: base.yaml
```

## dts/bindings/crypto/aspeed,cptra-mci-sha.yaml
```yaml
# Copyright (c) 2025 ASPEED Technology Inc.
# SPDX-License-Identifier: Apache-2.0

description: ASPEED Caliptra-SS MCI mailbox SHA engine (MC_SHA_INIT/UPDATE/FINAL)

compatible: "aspeed,cptra-mci-sha"

include: base.yaml
```

## dts/bindings/crypto/aspeed,cptra-sha.yaml
```yaml
# Copyright (c) 2024 ASPEED Technology Inc.
# SPDX-License-Identifier: Apache-2.0

description: ASPEED CPTRA SHA Engine

compatible: "aspeed,cptra-sha"

include: base.yaml

properties:
    reg:
      required: true

    aspeed,scu:
      type: phandle
      required: true
      description: phandle to SCU device tree node
```

## dts/bindings/espi/aspeed,espi-ast1040.yaml
```yaml
# Copyright (c) 2021, ASPEED
# SPDX-License-Identifier: Apache-2.0

description: ASPEED eSPI for AST1040

compatible: "aspeed,espi-ast1040"

include: aspeed,espi-v2.yaml

properties:
    aspeed,scu:
      type: phandle
      required: false
      description: phandle to SCU device tree node
```

## dts/bindings/espi/aspeed,espi-v2.yaml
```yaml
# Copyright (c) 2021, ASPEED
# SPDX-License-Identifier: Apache-2.0

description: ASPEED eSPI for AST2700

compatible: "aspeed,espi-v2"

include: espi-controller.yaml

properties:
    reg:
      description: mmio register space
      required: true

    perif-dma-mode:
      type: boolean
      required: false
      description: enable DMA for peripheral channel

    perif-mcyc-enable:
      type: boolean
      required: false
      description: enable memory cycle for peripheral channel

    perif-mcyc-dma-mode:
      type: boolean
      required: false
      description: enable DMA for peripheral channel memory cycle

    perif-mcyc-src-addr:
      type: array
      required: false
      description: host side decoding address of memory cycle, as a 64-bit value in <high low> order

    perif-mcyc-size:
      type: array
      required: false
      description: region size for memory cycle, as a 64-bit value in <high low> order

    vw-gpio-hw-mode:
      type: boolean
      required: false
      description: select vGPIO SW/HW mode

    vw-gpio-group:
      type: int
      required: false
      description: select vGPIO HW group

    vw-gpio-direction:
      type: array
      required: false
      description: select vGPIO direction

    oob-dma-mode:
      type: boolean
      required: false
      description: enable DMA for OOB channel

    flash-dma-mode:
      type: boolean
      required: false
      description: enable DMA for flash channel

    flash-edaf-mode:
      type: int
      required: false
      description: select the eDAF mode (0->mix, 1->hw, 2->sw)

    flash-edaf-tgt-addr:
      type: array
      required: false
      description: eDAF target mapping address
```

## dts/bindings/gpio/aspeed,g7-gpio.yaml
```yaml
# Copyright (c) 2026 ASPEED
# SPDX-License-Identifier: Apache-2.0

description: ASPEED G7 GPIO node

compatible: "aspeed,g7-gpio"

include: [base.yaml, pinctrl-device.yaml]

properties:
  reg:
    required: true

  interrupts:
    required: true

  clocks:
    required: true

  ngpios:
    type: int
    default: 216
    description: |
      Number of GPIOs implemented by this controller. The AST2700/AST10x0-G2
      master GPIO controller defaults to 216 slots, with a 4-GPIO hole in bank
      E/F/G/H. Boards may override this for smaller controller instances.

  aspeed,deb-interval-us:
    type: int
    default: 5
    description:
      Debounce interval when a pin is configured with ASPEED_GPIO_DEBOUNCE.

child-binding:
  description: ASPEED G7 GPIO bank node
  include: gpio-controller.yaml
  properties:
    ngpios:
      type: int
      default: 32
      description: Number of GPIOs exposed by this 32-slot bank.

    gpio-reserved:
      type: int
      required: false
      description: |
          Bit mask of GPIOs reserved from this bank.
          If GPIOs 3, 4, and 10 are reserved the value is 0x418.

    pin-offset:
      type: int
      required: true
      description: First global GPIO number covered by this bank.

    "#gpio-cells":
      const: 2

  gpio-cells:
  - pin
  - flags
```

## dts/bindings/gpio/aspeed,g7-sgpiom.yaml
```yaml
# Copyright (c) 2026 ASPEED
# SPDX-License-Identifier: Apache-2.0

description: ASPEED G7 SGPIOM node

compatible: "aspeed,g7-sgpiom"

include: [base.yaml, pinctrl-device.yaml]

properties:
  reg:
    required: true

  interrupts:
    required: true

  clocks:
    required: true

  aspeed,bus-freq:
    type: int
    default: 1000000
    description:
      SGPIO master clock frequency.

  ngpios:
    type: int
    required: true
    description:
      Number of SGPIO signals. Must be a multiple of 8.

child-binding:
  description: ASPEED G7 SGPIOM GPIO bank node
  include: gpio-controller.yaml
  properties:
    ngpios:
      type: int
      default: 32
      description: Number of GPIOs exposed by this 32-slot SGPIO bank.

    gpio-reserved:
      type: int
      required: false
      description: |
          Bit mask of GPIOs reserved from this bank.
          If GPIOs 3, 4, and 10 are reserved the value is 0x418.

    pin-offset:
      type: int
      required: true
      description: First global SGPIO number covered by this bank.

    "#gpio-cells":
      const: 2

  gpio-cells:
  - pin
  - flags
```

## dts/bindings/i2c/aspeed,switch.yaml
```yaml
#
# Copyright (c) ASPEED
#
# SPDX-License-Identifier: Apache-2.0
#

description: ASPEED I2C switch device

compatible: "aspeed,switch"

include:
  - name: i2c-device.yaml
  - name: pinctrl-device.yaml

properties:
  reg:
    required: true

  enable-gpios:
    type: phandle-array

  switch-gpios:
    type: phandle-array
```

## dts/bindings/i3c/aspeed,g7-i3c-hci.yaml
```yaml
# Copyright (c) 2026 ASPEED Technology Inc.
# SPDX-License-Identifier: Apache-2.0

description: |
  ASPEED G7 MIPI I3C HCI controller.

  This binding inherits the generic mipi,i3c-hci binding and adds the
  Aspeed-specific tunables (SCL push-pull / open-drain timing, SDA
  hold, target-mode PEC). The driver iterates both this compatible and
  the generic one through DT_FOREACH_STATUS_OKAY in core.c, so any
  devicetree node bound to this YAML is still picked up.

  Devicetree nodes should list this compatible FIRST so Zephyr binds
  this YAML to the node and validates the extra Aspeed-only properties
  defined below. Example:

      compatible = "aspeed,g7-i3c-hci";

compatible: "aspeed,g7-i3c-hci"

include: mipi,i3c-hci.yaml

properties:
  i3c-pp-scl-hi-period-ns:
    type: int
    description: I3C push-pull mode SCL high period in nanoseconds.

  i3c-pp-scl-lo-period-ns:
    type: int
    description: I3C push-pull mode SCL low period in nanoseconds.

  i3c-od-scl-hi-period-ns:
    type: int
    description: I3C open-drain mode SCL high period in nanoseconds.

  i3c-od-scl-lo-period-ns:
    type: int
    description: I3C open-drain mode SCL low period in nanoseconds.

  sda-tx-hold-ns:
    type: int
    description: SDA hold time with respect to the SCL edge, in nanoseconds.

  ibi-append-pec:
    type: boolean
    description: Append a PEC byte to IBI data in target mode.

  priv-xfer-pec:
    type: boolean
    description: Enable PEC handling for private transfers in target mode.
```

## dts/bindings/i3c/i3c-dummy-device.yaml
```yaml
# Copyright (c) 2023 Aspeed Technology
#
# SPDX-License-Identifier: Apache-2.0

description: I3C dummy device driver

compatible: "i3c-dummy-device"

include:
  - name: i3c-device.yaml
    property-blocklist:
      - label

properties:
  label:
    type: string

  max-ibi-payload:
    type: int
    default: 4
    description: |
      Maximum IBI payload size, in bytes, the controller-side descriptor
      should advertise for this device when the driver calls
      i3c_ibi_enable(). The MIPI I3C HCI controller uses this value to
      decide whether to set the DAT entry's IBI_PAYLOAD bit and how big
      the per-device IBI accounting buffer should be; leaving it at 0
      makes the controller reject any IBI byte (including the MDB), so
      this defaults to 4 which covers the single MDB byte that
      pending-read-notify drivers (e.g. i3c-target-mqueue) emit.
```

## dts/bindings/i3c/i3c-target-mqueue.yaml
```yaml
# Copyright (c) 2023 Aspeed Technology
#
# SPDX-License-Identifier: Apache-2.0

description: I3C message queue driver for target mode

compatible: "i3c-target-mqueue"

include:
  - name: i3c-device.yaml
    property-blocklist:
      - label

properties:
  label:
    type: string

  msg-size:
    type: int
    required: true
    description: the size of the single message in byte

  num-of-msgs:
    type: int
    required: true
    description: number of the messages

  mandatory-data-byte:
    type: int
    required: true
    description: mandatory data byte (MDB) when sending IBI.
                 See https://www.mipi.org/MIPI_I3C_mandatory_data_byte_values_public for detail.
  ibi-append-pec:
    required: false
    type: int
    description: Append PEC byte to the IBI data.  Enable this option if the master device is AST2600 or AST1030A0.
```

## dts/bindings/i3c/mipi,i3c-hci.yaml
```yaml
# Copyright (c) 2026 ASPEED Technology Inc.
# SPDX-License-Identifier: Apache-2.0

description: |
  Generic MIPI I3C Host Controller Interface binding.

  This binding covers the silicon-agnostic surface of the MIPI I3C HCI
  driver. Vendor extensions (Aspeed G7, etc.) live in dedicated bindings
  that include this one and may add their own properties.

  The driver registers under both this generic compatible and any
  vendor-specific compatibles it understands. Each devicetree node is
  bound to whichever binding YAML matches the first entry in its
  `compatible` list — vendor-specific compatibles should come first so
  the node picks up the vendor binding's extra properties.

compatible: "mipi,i3c-hci"

include: [i3c-controller.yaml, reset-device.yaml, pinctrl-device.yaml]

properties:
  reg:
    required: true
    description: |
      Single register range covering the MIPI I3C HCI instance. Vendor
      sub-block offsets (PHY, in-house, autocmd, ...) are discovered at
      runtime from the HCI extended-capability descriptor.

  clocks:
    required: true

  resets:
    required: true

  interrupts:
    required: true

  secondary:
    type: boolean
    description: Initialize as a secondary controller or target-capable device.

  assigned-address:
    type: int
    description: |
      Dynamic address when acting as main controller, or static address when
      acting as target.

  dcr:
    type: int
    description: Device Characteristics Register value for target mode.

  pid-extra-info:
    type: int
    description: Extra information for PID bits [11:0].

  io-mode:
    type: string
    default: "pio"
    enum:
      - "pio"
      - "dma"
    description: Select the HCI transfer engine.
```

## dts/bindings/interrupt-controller/aspeed,ast2700-intc-global.yaml
```yaml
# Copyright (c) 2023 ASPEED Technology Inc.
# SPDX-License-Identifier: Apache-2.0

description: ASPEED CPU interrupt controller in AST2700 SOC

compatible: "aspeed,ast2700-intc-global"

include: base.yaml

properties:
  reg:
    required: true

  irq-route-select:
    required: true
    type: string
    enum:
      - "psp"
      - "psp-legacy"
      - "ssp"
      - "tsp"
      - "psp-s0"
      - "psp-s1"
      - "bootmcu"

  tx-region:
    description: phandle to the shared memory region used for data transmission
    required: false
    type: phandle

  rx-region:
    description: phandle to the shared memory region used for data reception
    required: false
    type: phandle
```

## dts/bindings/interrupt-controller/aspeed,ast2700-intc.yaml
```yaml
# Copyright (c) 2023 ASPEED Technology Inc.
# SPDX-License-Identifier: Apache-2.0

description: ASPEED CPU interrupt controller in AST2700 SOC

compatible: "aspeed,ast2700-intc-ic"

include: [interrupt-controller.yaml, base.yaml]

properties:
  reg:
    required: true

  interrupts:
    required: true

  "#interrupt-cells":
    const: 2

  aspeed,l1-aggregator-index:
    type: int
    default: 0
    description: |
      Zero-based index of this node among sibling level-1 (NVIC-attached)
      INTC aggregators that share this compatible. Used to give each
      level-1 aggregator instance a unique, non-overlapping base offset
      into the software ISR table so their child interrupts' sw_isr_table
      slots cannot collide. Leave at the default (0) when there is only
      one level-1 aggregator in the build; give each additional sibling
      level-1 aggregator the next integer (1, 2, ...).

interrupt-cells:
  - irq
  - priority
```

## dts/bindings/interrupt-controller/aspeed,ast2700a0-intc-global.yaml
```yaml
# Copyright (c) 2023 ASPEED Technology Inc.
# SPDX-License-Identifier: Apache-2.0

description: ASPEED CPU interrupt controller in AST2700 SOC

compatible: "aspeed,ast2700a0-intc-global"

include: base.yaml

properties:
  reg:
    required: true

  irq-route-select:
    required: true
    type: string
    enum:
      - "psp"
      - "ssp"
      - "tsp"

  tx-region:
    description: phandle to the shared memory region used for data transmission
    required: false
    type: phandle

  rx-region:
    description: phandle to the shared memory region used for data reception
    required: false
    type: phandle
```
