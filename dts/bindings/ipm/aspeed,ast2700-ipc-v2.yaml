## dts/bindings/ipm/aspeed,ast2700-ipc-v2.yaml
```yaml
# Copyright (c) 2023 ASPEED Technology Inc.
# SPDX-License-Identifier: Apache-2.0

description: ASPEED IPC V2 (Interprocessor Communication) in AST2700 SOC

compatible: "aspeed,ast2700-ipc-v2"

include: base.yaml

properties:
    reg:
      required: true

    interrupts:
      required: true

    reg-tx-offset:
      type: int
      required: true

    reg-rx-offset:
      type: int
      required: true

    tx-region:
      description: phandle to the shared memory region used for data transmission
      required: false
      type: phandle

    rx-region:
      description: phandle to the shared memory region used for data reception
      required: false
      type: phandle
```

## dts/bindings/jtag/aspeed,jtag.yaml
```yaml
description: ASPEED family JTAG

compatible: "aspeed,jtag"

include: [base.yaml, pinctrl-device.yaml, reset-device.yaml]

properties:
    reg:
      required: true

    interrupts:
      required: true
```

## dts/bindings/misc/aspeed,mbox.yaml
```yaml
# Copyright (c) 2021, ASPEED
# SPDX-License-Identifier: Apache-2.0

description: ASPEED LPC Mailbox

compatible: "aspeed,mbox"

include: base.yaml

properties:
    port:
      type: int
      required: true
      description: Mailbox I/O port address
```

## dts/bindings/misc/aspeed,otp.yaml
```yaml
# Copyright (c) 2022 ASPEED Technology Inc.
# SPDX-License-Identifier: Apache-2.0

description: ASPEED OTP (One-Time-Programmable) Memory Controller

compatible: "aspeed,otp"

include: base.yaml

properties:
  otpcfg:
    type: array
    required: false
    description: |
      Program OTP Configure by driver initialization.

  otpstrap:
    type: array
    required: false
    description: |
      Program OTP Strap by driver initialization.
```

## dts/bindings/pinctrl/aspeed,pinctrl.yaml
```yaml
# Copyright (c) 2023 Aspeed Technology Inc.
# SPDX-License-Identifier: Apache-2.0

description: Aspeed pin control

compatible: "aspeed,pinctrl"

include: base.yaml

child-binding:
  description: Aspeed pin configuration nodes
  include:
    - name: pincfg-node.yaml

  properties:
    sig_descs:
      required: true
      type: array
    ball:
      required: true
      type: int
```

## dts/bindings/pinctrl/aspeed,pinmux.yaml
```yaml
# Copyright (c) 2023 Aspeed Technology Inc.
# SPDX-License-Identifier: Apache-2.0

description: ASPEED Pinmux control

compatible: "aspeed,pinmux"

include: base.yaml

child-binding:
  properties:
      sig_descs:
        required: true
        type: array
      ball:
        required: true
        type: int
```

## dts/bindings/rng/aspeed,hwrng.yaml
```yaml
# Copyright (c) 2022 ASPEED Technology Inc.
# SPDX-License-Identifier: Apache-2.0

description: |
    Aspeed HWRNG (Hardware Random Number Generator).

    The HWRNG module is a non-deterministic random number generator based on a full hardware solution.

compatible: "aspeed,hwrng"

include: base.yaml

properties:
    reg:
      required: true
```

## dts/bindings/spi/aspeed,spi-monitor-controller.yaml
```yaml
# Copyright (c) 2021 - 2023 Chin-Ting Kuo <chin-ting_kuo@aspeedtech.com>
# SPDX-License-Identifier: Apache-2.0

description: ASPEED SPI Monitor common controller node

compatible: "aspeed,spi-monitor-controller"

include:
  - base.yaml
  - pinctrl-device.yaml

properties:
  reg:
    required: true

  aspeed,scu:
    type: phandle
    required: true
    description: phandle to SCU device tree node

child-binding:
  description: SPI monitor physical controller node
  properties:
    reg:
      type: int
      required: true
      description: Record the index(number) of SPI monitor controller.

    pinctrl-0:
      type: phandles
      description: |
        Pin configuration/s for the first state. Content is specific to the
        selected pin controller driver implementation.

    pinctrl-names:
      type: string-array
      description: |
        Names for the provided states. The number of names needs to match the
        number of states.

    interrupts:
      type: array
      required: false
      description: interrupts for device

    allow-cmds:
      type: uint8-array
      required: true
      description: |
        Assign the commands which should be filled
        in allow command list table.

        [cmd1 cmd2 ... cmdN];

    write-forbidden-regions:
      type: array
      required: false
      description: |
        Assign the start address and the length of regions
        which cannot be written.
        The regions cannot be overlapped.

        <start_address_1 length_1
        start_address_2 length_2
        ...
        start_address_N length_N>;

    read-forbidden-regions:
      type: array
      required: false
      description: |
        Assign the start address and the length of regions
        which cannot be read.
        The regions cannot be overlapped.

        <start_address_1 length_1
        start_address_2 length_2
        ...
        start_address_N length_N>;

    log-ram-size:
      type: int
      required: false
      description: |
        The ram size for recording log if there is an invalid
        SPI flash access and the related interrupt occurs.

    extra-clk:
      type: boolean
      required: false
      description: Block a invalid access by an extra clock.

    ext-mux-sel:
      type: int
      required: false
      description: |
        External MUX selection default value which is configured
        during probe stage.

    ext-mux-sel-gpios:
      type: phandle-array
      required: false
      description: |
        The external mux select pin is controlled by gpio or sgpio.

    ext-mux-sel-delay-us:
      type: int
      required: false
      default: 0
      description: |
        Delay in microseconds from the external mux select assert.
    force-release-flash-reset:
      type: boolean
      required: false
      description: |
        Release flash reset at the beginning
        driver probe stage.
```

## dts/bindings/tach/aspeed,tach.yaml
```yaml
# Copyright (c) 2021, ASPEED 
# SPDX-License-Identifier: Apache-2.0

description: ASPEED tachometer controller

compatible: "aspeed,tach"

include: tach.yaml


child-binding:
    description: Tachometer child node
    properties:
      reg:
        type: int
        required: true
        description: |
          The Fan tach input channel.
          Integer value in the range 0 through 15.

      pulse-pr:
          type: int
          required: true
          description: |
            Define the tachometer pulses per fan revolution as an integer. 
            The value must be greater than zero.

      min-rpm:
          type: int
          required: true
          description: |
            Define the minimal revolutions per minute of the measure fan
            used to calculate the sample period of tach.

      tach-div:
          type: int
          required: true
          description: |
            Define the tachometer clock divider.
            Formula of tach clock = Clock source / (2^tach-div)^2
      label:
        type: string
        required: true
```

## dts/bindings/timer/aspeed,ast27xx-timer.yaml
```yaml
# Copyright (c) 2021, Aspeed Technology Inc.
# SPDX-License-Identifier: Apache-2.0

description: Aspeed, AST27xx General purpose timer

compatible: "aspeed,ast27xx-timer"

include: base.yaml

properties:
    interrupts:
        required: true

    clocks:
        type: phandle-array
        required: true
```

## dts/bindings/usb/aspeed,udc.yaml
```yaml
# Copyright (c) 2021 Aspeed Technology Inc.
# SPDX-License-Identifier: Apache-2.0

description: |
    Aspeed USB Device Controller (UDC)

compatible: "aspeed,udc"

include: [base.yaml, reset-device.yaml, usb-ep.yaml]

properties:
    reg:
      required: true

    interrupts:
      required: true
```

## dts/bindings/watchdog/aspeed,ast-watchdog.yaml
```yaml
# Copyright (c) 2021, ASPEED Corporation
# SPDX-License-Identifier: Apache-2.0

description: ASPEED watchdog timer controller

compatible: "aspeed,ast-watchdog"

include: [base.yaml]

properties:
  reg:
    required: true

  label:
    required: true

  interrupts:
    required: true

  aspeed,scu:
    type: phandle
    required: true
    description: phandle to SCU device tree node

  reset-mask:
    type: array
    required: true
    description: Record default reset mask1 and mask2
```

## soc/arm/aspeed/Kconfig
```kconfig
# SPDX-License-Identifier: Apache-2.0
#
# Copyright (c) 2021 ASPEED Technology Inc.

config SOC_FAMILY_ASPEED
	select PLATFORM_SPECIFIC_INIT
	bool

if SOC_FAMILY_ASPEED

config SOC_FAMILY
	string
	default "aspeed"

if SOC_SERIES_AST10X0
source "soc/arm/aspeed/ast10x0/Kconfig.soc"
endif

if SOC_SERIES_AST27X0
source "soc/arm/aspeed/ast27x0/Kconfig.soc"
endif
endif # SOC_FAMILY_ASPEED
```

## soc/arm/aspeed/ast10x0/Kconfig.defconfig.ast1030
```kconfig
# SPDX-License-Identifier: Apache-2.0
#
# Copyright (c) 2021 ASPEED Technology Inc.

if SOC_AST1030

config NUM_IRQS
	default 240
endif # SOC_AST1030
```

## soc/arm/aspeed/ast10x0/Kconfig.soc
```kconfig
# SPDX-License-Identifier: Apache-2.0
#
# Copyright (c) 2021 ASPEED Technology Inc.

choice SOC_AST10X0_SELECTION
	prompt "ASPEED AST10X0 Selection"
	depends on SOC_SERIES_AST10X0
	default SOC_AST1030

config SOC_AST1030
	bool "AST1030"

config SOC_AST1060
	bool "AST1060"

endchoice
```

## soc/arm/aspeed/ast26xx/Kconfig.defconfig.ast2600
```kconfig
# SPDX-License-Identifier: Apache-2.0
#
# Copyright (c) 2023 ASPEED Technology Inc.

if SOC_AST2600

config NUM_IRQS
	default 240

DT_NODE_SRAM := /memory@0

config SRAM_RO_SIZE
	default 128

endif # SOC_AST2600
```

## soc/arm/aspeed/ast26xx/Kconfig.defconfig.series
```kconfig
# SPDX-License-Identifier: Apache-2.0
#
# Copyright (c) 2023 ASPEED Technology Inc.

if SOC_SERIES_AST26XX

source "soc/arm/aspeed/ast26xx/Kconfig.defconfig.ast26*"

config SOC_SERIES
	default "ast26xx"

config ICACHE_LINE_SIZE
	default 32

config DCACHE_LINE_SIZE
	default 32

choice CACHE_TYPE
	default EXTERNAL_CACHE
endchoice

config XIP
	default y

config SYS_CLOCK_HW_CYCLES_PER_SEC
	default 200000000

config LINKER_LAST_SECTION_ID
	default n

endif # SOC_SERIES_AST26XX
```

## soc/arm/aspeed/ast26xx/Kconfig.series
```kconfig
# SPDX-License-Identifier: Apache-2.0
#
# Copyright (c) 2023 ASPEED Technology Inc.

config SOC_SERIES_AST26XX
	bool "Aspeed AST26XX Series"
	select ARM
	select CPU_CORTEX_M3
	select SOC_FAMILY_ASPEED
	select SYSCON
	select CACHE
	select CPU_HAS_DCACHE
	select CPU_HAS_ICACHE
	select CACHE_MANAGEMENT
	select CACHE_ASPEED
	help
	  Enable support for ASPEED AST26XX series
```

## soc/arm/aspeed/ast26xx/Kconfig.soc
```kconfig
# SPDX-License-Identifier: Apache-2.0
#
# Copyright (c) 2023 ASPEED Technology Inc.

choice
	prompt "ASPEED AST26XX Selection"
	depends on SOC_SERIES_AST26XX

config SOC_AST2600
	bool "AST2600"

endchoice

config SRAM_RO_SIZE
	int "Read-only SRAM Size in kB"
	help
	 The cached SRAM has two memory regions: read-only and read-write. This
	 option allows you to configure the size of the read-only region, while
	 the size of the read-write region is determined by subtracting
	 SRAM_RO_SIZE from the total SRAM_SIZE.

config SRAM_NC_SIZE
	int "noncached SRAM Size in kB"
	help
	  The non-cached SRAM size in kB. The default value comes from reg[1]
	  of /chosen/zephyr,sram in devicetree. The user should generally avoid
	  changing it via menuconfig or in configuration files.

config SRAM_NC_BASE_ADDRESS
	hex "noncached SRAM Base Address"
	help
	  The non-cached SRAM base address. The default value comes from from
	  reg[1] of /chosen/zephyr,sram in devicetree. The user should
	  generally avoid changing it via menuconfig or in configuration files.
```

## soc/arm/aspeed/ast27x0/Kconfig.defconfig.ast2700
```kconfig
# SPDX-License-Identifier: Apache-2.0
#
# Copyright (c) 2023 ASPEED Technology Inc.

if SOC_AST2700

config NUM_IRQS
	default 240

config SRAM_RO_SIZE
	default 128
endif # SOC_AST2700
```

## soc/arm/aspeed/ast27x0/Kconfig.defconfig.series
```kconfig
# SPDX-License-Identifier: Apache-2.0
#
# Copyright (c) 2023 ASPEED Technology Inc.

if SOC_SERIES_AST27X0

source "soc/arm/aspeed/ast27x0/Kconfig.defconfig.ast27*0"

config SOC_SERIES
	default "ast27x0"

config ICACHE_LINE_SIZE
	default 32

config DCACHE_LINE_SIZE
	default 32

choice CACHE_TYPE
	default EXTERNAL_CACHE
endchoice

config XIP
	default y

config LINKER_LAST_SECTION_ID
	default n

endif # SOC_SERIES_AST27X0
```

## soc/arm/aspeed/ast27x0/Kconfig.series
```kconfig
# SPDX-License-Identifier: Apache-2.0
#
# Copyright (c) 2023 ASPEED Technology Inc.

config SOC_SERIES_AST27X0
	bool "Aspeed AST27X0 Series"
	select ARM
	select CPU_CORTEX_M4
	select CPU_HAS_FPU
	select CPU_HAS_ARM_MPU
	select SOC_FAMILY_ASPEED
	select SYSCON
	select CACHE
	select CPU_HAS_DCACHE
	select CPU_HAS_ICACHE
	select CACHE_MANAGEMENT
	select CACHE_AST27X0
	help
	  Enable support for ASPEED AST27X0 series
```
