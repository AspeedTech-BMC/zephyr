## dts/bindings/misc/aspeed,ast27xx-otp.yaml
```yaml
# Copyright (c) 2025 ASPEED Technology Inc.
# SPDX-License-Identifier: Apache-2.0

description: ASPEED OTP (One-Time-Programmable) Memory Controller

compatible: "aspeed,ast27xx-otp"

include: base.yaml

properties:
    aspeed,scu:
      type: phandle
      required: true
      description: phandle to SCU device tree node

    aspeed,otp-gran-bits:
      type: int
      default: 16
      description: |
        OTP macro cell width in bits. AST2700 is 16 (the default); AST1040
        uses a 32-bit-granularity OTP macro, same design as AST2705.
```

## dts/bindings/misc/aspeed,cptra-dice.yaml
```yaml
# Copyright (c) 2025 ASPEED Technology Inc.
# SPDX-License-Identifier: Apache-2.0

description: ASPEED CPTRA DICE mailbox service

compatible: "aspeed,cptra-dice"

include: base.yaml
```

## dts/bindings/misc/aspeed,cptra-mbox.yaml
```yaml
# Copyright (c) 2024 ASPEED Technology Inc.
# SPDX-License-Identifier: Apache-2.0

description: |
  CPTRA Mailbox node for ASPEED platform.
compatible: "aspeed,cptra-mbox"

properties:
  reg:
    description: Register range for the Caliptra mailbox.
    type: array
    required: true

  aspeed,scu:
    description: Handle to the ASPEED system control unit (SCU).
    type: phandle

  aspeed,cptra-ifc:
    description: Handle to the ASPEED Caliptra SoC IFC.
    type: phandle
```

## dts/bindings/misc/aspeed,cptra-mci-mbox.yaml
```yaml
# Copyright (c) 2025 ASPEED Technology Inc.
# SPDX-License-Identifier: Apache-2.0

description: |
  Caliptra-SS MCI (Manageability Controller Interface) mailbox node for
  ASPEED platforms. The mailbox CSR block and its data SRAM are only
  reachable through a shared 64KB paged window; aspeed,scu points at the
  SCU1 node that owns the page-select register used to switch that window
  between the two targets.

compatible: "aspeed,cptra-mci-mbox"

include: base.yaml

properties:
  reg:
    required: true

  aspeed,scu:
    type: phandle
    required: true
    description: phandle to the SCU1 device tree node that owns the page-select register
```

## dts/bindings/misc/aspeed,cptra-misc.yaml
```yaml
# Copyright (c) 2025 ASPEED Technology Inc.
# SPDX-License-Identifier: Apache-2.0

description: ASPEED CPTRA MISC mailbox service

compatible: "aspeed,cptra-misc"

include: base.yaml
```

## dts/bindings/misc/aspeed,cptra-update.yaml
```yaml
# Copyright (c) 2024 ASPEED Technology Inc.
# SPDX-License-Identifier: Apache-2.0

description: ASPEED CPTRA Update mailbox service

compatible: "aspeed,cptra-update"

include: base.yaml
```

## dts/bindings/misc/aspeed,edaf-bridge.yaml
```yaml
# Copyright (c) 2021, ASPEED
# SPDX-License-Identifier: Apache-2.0

description: ASPEED EDAF Bridge Controller

compatible: "aspeed,edaf-bridge"

include: base.yaml

properties:
  reg:
    required: true

  aspeed,scu:
    type: phandle
    required: true
    description: Phandle to SCU syscon node used to control EDAF enable bits.

  aspeed,edaf_bridge_cfg:
    type: phandle
    required: false
    description: Phandle to global EDAF bridge config block.

  mem-base:
    type: array
    required: false

  ctl-base:
    type: int
    required: false

  espi-base:
    type: int
    required: false

  edaf-ddr-mode:
    type: boolean
    required: false

  edaf-erase-with-1:
    type: boolean
    required: false

  cmd-read:
    type: int
    required: false

  cmd-write-enable:
    type: int
    required: false

  cmd-write:
    type: int
    required: false

  cmd-read-status:
    type: int
    required: false

  cmd-erase-4k:
    type: int
    required: false

  cmd-erase-32k:
    type: int
    required: false

  cmd-erase-64k:
    type: int
    required: false
```

## dts/bindings/misc/aspeed,prictrl-prot.yaml
```yaml
# Copyright (c) 2026, ASPEED
# SPDX-License-Identifier: Apache-2.0

description: ASPEED Privilege Control Driver Protection Device Tree

compatible: "aspeed,prictrl-prot"

include: base.yaml

properties:
  protect-dev:
    type: array
    required: true
    description: |
      Protection device list for privilege control.
```

## dts/bindings/misc/aspeed,prictrl.yaml
```yaml
# Copyright (c) 2021, ASPEED
# SPDX-License-Identifier: Apache-2.0

description: ASPEED Privilege Control Driver

compatible: "aspeed,prictrl"

include: base.yaml

properties:
  mlist0:
    type: array
    required: false
    description: |
      Program group 0 master list, the default master is boot mcu.

  mlist1:
    type: array
    required: false
    description: |
      Program group 1 master list, the default master is ssp.

  mlist2:
    type: array
    required: false
    description: |
      Program group 2 master list, the default master is tsp.

  mlist3:
    type: array
    required: false
    description: |
      Program group 3 master list, the default master is secure ca35.

  mlist4:
    type: array
    required: false
    description: |
      Program group 4 master list, the default master is non-secure ca35.

  mlist5:
    type: array
    required: false
    description: |
      Program group 5 master list, the default master is dp mcu.
```

## dts/bindings/misc/aspeed,uart-routing.yaml
```yaml
# Copyright (c) 2026, ASPEED
# SPDX-License-Identifier: Apache-2.0

description: |
  ASPEED UART routing (HICR9/HICRA I/O-pin <-> UART-controller mux).

  Each mux field on HICR9/HICRA picks, for one UART controller or one
  I/O pin, which peer it is wired to. This binding configures those
  fields with two parallel-array pairs, matched up by index:

    - ch-name[i] (a UART controller, e.g. "uart0") is routed to
      sel-io[i] (an I/O pin, e.g. "io0").
    - io-name[i] (an I/O pin, e.g. "io1") is routed to sel-ch[i]
      (a UART controller, e.g. "uart1").

  i.e. "ch"-prefixed properties name UART controllers and "io"-prefixed
  properties name I/O pins; "sel-io" gives the I/O target for each
  "ch-name" entry, and "sel-ch" gives the UART target for each
  "io-name" entry. All four arrays must be the same shape: ch-name and
  sel-io must be the same length as each other, and io-name and sel-ch
  must be the same length as each other (the two pairs may differ in
  length from one another).

  Valid names/settings are chip-specific (different ASPEED SoCs wire
  HICR9/HICRA differently), so a node must list a chip-specific
  compatible (e.g. "aspeed,ast1040-uart-routing") in addition to the
  generic "aspeed,uart-routing" -- the driver uses that chip-specific
  string to look up the matching routing table (see
  uart_routing_chip_table[] and the per-selector "options[]" tables in
  uart_routing_aspeed.c, e.g. "uart0".."uart3", "uart9", "uart12",
  "io0".."io3", "io9", "reserved"). Every entry is applied once at
  boot, in the order listed; any mux field left out of both pairs
  keeps its hardware reset routing.

  Example: route UART0 out to I/O pin 0, UART1 out to I/O pin 1, and
  loop I/O pin 9 back in to UART9:

    uart_routing: uart-routing {
            compatible = "aspeed,ast1040-uart-routing", "aspeed,uart-routing";
            status = "okay";

            ch-name = "uart0", "uart1";
            sel-io  = "io0",   "io1";

            io-name = "io9";
            sel-ch  = "uart9";
    };

compatible: "aspeed,uart-routing"

include: base.yaml

properties:
  ch-name:
    type: string-array
    required: true
    description: UART controllers to route, e.g. "uart0". Paired with sel-io by index.

  sel-io:
    type: string-array
    required: true
    description: I/O pin each corresponding ch-name entry is routed to.

  io-name:
    type: string-array
    required: true
    description: I/O pins to route, e.g. "io0". Paired with sel-ch by index.

  sel-ch:
    type: string-array
    required: true
    description: UART controller each corresponding io-name entry is routed to.
```

## dts/bindings/pcie/endpoint/aspeed,ast27xx-pcie.yaml
```yaml
description: Binding for ASPEED AST27xx PCIE

compatible: "aspeed,ast27xx-pcie"

include: [base.yaml]

properties:
  vga:
    type: string
    enum:
      - "MSI"
      - "INTx"
    description: |
      Specifies which interrupt mode this device supports.
      If absent, then VGA will be disabled.
  bmc-device:
    type: string
    enum:
      - "MSI"
      - "INTx"
    description: |
      Specifies which interrupt mode this device supports.
      If absent, then BMC Device will be disabled.
  ehci:
    type: string
    enum:
      - "MSI"
      - "INTx"
    description: |
      Specifies which interrupt mode this device supports.
      If absent, then EHCI will be disabled.
  xhci:
    type: string
    enum:
      - "MSI"
      - "INTx"
    description: |
      Specifies which interrupt mode this device supports.
      If absent, then XHCI will be disabled.

  alt-pcie-node:
    type: boolean
    description: |
      Indicates that the EHCI/XHCI nodes should be relocated to the alternative PCIe controller.
      In this configuration, the VGA and BMC Device functions on PCIe1 are disabled.
      This property is valid only for the PCIe1 controller.
```

## dts/bindings/pinctrl/aspeed,g7-soc1-pinctrl.yaml
```yaml
# Copyright (c) Aspeed Technology Inc.
# SPDX-License-Identifier: Apache-2.0

description: Aspeed pin control

compatible: "aspeed,g7-soc1-pinctrl"

include: base.yaml

child-binding:
  description: Aspeed pin configuration nodes
  include:
    - name: pincfg-node.yaml

  properties:
    sig_descs:
      required: true
      type: int
    ball:
      required: true
      type: int
    bias-disable-desc:
      type: int
      description: |
        PINCFG_DESC() location of the bias/pull-disable control bit for
        this ball. Combined with the generic "bias-disable" property
        (from pincfg-node.yaml) to decide whether to write it.
    drive-strength-desc:
      type: int
      description: |
        PINCFG_DESC() location of the drive-strength field for this
        ball. Combined with the generic "drive-strength" property (from
        pincfg-node.yaml) for the value to write.
```

## dts/bindings/reset/aspeed,ast27xx-reset.yaml
```yaml
# Copyright (c) 2023 Aspeed Technology Inc.
# SPDX-License-Identifier: Apache-2.0

description: Aspeed AST27XX Reset Controller

compatible: "aspeed,ast27xx-reset"

include: [base.yaml, reset-controller.yaml]

properties:
  "#reset-cells":
    const: 1
  psp:
    type: array
    required: false
    description: |
      Program clock access permission for PSP
  sec-psp:
    type: array
    required: false
    description: |
      Program clock access permission for secure PSP
  ssp:
    type: array
    required: false
    description: |
      Program clock access permission for SSP
  tsp:
    type: array
    required: false
    description: |
      Program clock access permission for TSP
  psp-ssp:
    type: array
    required: false
    description: |
      Program clock access permission for PSP and SSP
  ssp-tsp:
    type: array
    required: false
    description: |
      Program clock access permission for PSP and TSP
  bmcu:
    type: array
    required: false
    description: |
      Program clock access permission for bootmcu

reset-cells:
  - id
```

## dts/bindings/riscv/aspeed,ast27xx-mpu.yaml
```yaml
# ast27xx-mpu.yaml

description: Binding for SDRAMMC with MPU region configuration

compatible: "aspeed,ast27xx-mpu"

include: base.yaml

description: MPU region definition node

properties:
  "#mpu-cells":
    type: int
    const: 0
    required: true

  protect-name:
    type: string
    required: true
    description: Human-readable name for the protected region

  protect-start:
    type: int
    required: true
    description: Start address of the protected memory region

  protect-end:
    type: int
    required: true
    description: End address of the protected memory region

  allow:
    type: array
    required: true
    description: Flattened list of <MPU_ID, permission> pairs

child-binding:
  description: Protection level definition
  properties:
    allow:
      type: array
      required: false
      description: List of allowed MPU IDs for this protection level
```

## dts/bindings/riscv/aspeed,ast27xx-sdrammc.yaml
```yaml
# sdrammc.yaml

description: Binding for SDRAMMC with MPU region configuration

compatible: "aspeed,ast27xx-sdrammc"

include: base.yaml

properties:
  mpus:
    type: phandle-array
    required: false
    description: Reference to MPU region
  ecc-enable:
    type: boolean
    required: false
    description: Enable ECC for SDRAM
  ecc-size:
    type: int
    required: false
    description: Size of ECC memory in bytes
  aes-enable:
    type: boolean
    required: false
    description: Enable AES encryption for SDRAM
  aes-size:
    type: int
    required: false
    description: Size of AES encryption in bytes
  hard-lock:
    type: boolean
    required: false
    description: >
      Hard-lock the DRAMC configuration registers (DRAMC_HARD_LOCK_KEY) once
      DRAM init completes, permanently blocking further register writes
      until the next power cycle. Left to the customer to enable.
```

## dts/bindings/rng/aspeed,ast2700-nisttrng.yaml
```yaml
# Copyright (c) 2026 ASPEED Technology Inc.
# SPDX-License-Identifier: Apache-2.0

description: |
  Aspeed AST2700 NIST TRNG (SP 800-90A CTR_DRBG with AES-256).

  The NIST TRNG implements a hardware DRBG compliant with NIST SP 800-90A.
  Initialization sequences: zeroize → generate noise → create state.
  Each GEN_RANDOM command produces 128 bits of output (RAND0-RAND3).

compatible: "aspeed,ast2700-nisttrng"

include: base.yaml

properties:
  reg:
    required: true
```

## dts/bindings/sdhc/aspeed,sdhci.yaml
```yaml
# Copyright (c) 2023 Intel Corporation
# SPDX-License-Identifier: Apache-2.0

description: ASPEED SDHC Controller node

compatible: "aspeed,sdhci"

include: [sdhc.yaml, base.yaml, reset-device.yaml]
```

## dts/bindings/serial/aspeed,uart.yaml
```yaml
# Copyright (c) 2021, ASPEED
# SPDX-License-Identifier: Apache-2.0

description: ASPEED UART

compatible: "aspeed,uart"

include: [uart-controller.yaml, pinctrl-device.yaml]

properties:
    reg:
      required: true
      description: mmio register space

    virtual:
      type: int
      required: false
      description: Virtual UART device

    virtual,port:
      type: int
      required: false
      description: Virtual UART LPC I/O port address

    virtual,sirq:
      type: int
      required: false
      description: Virtual UART LPC SerIRQ number

    virtual,sirq-polarity:
      type: int
      required: false
      description: Virtual UART LPC SerIRQ polarity

    dma:
      type: int
      required: false
      description: Enable UART DMA support

    dma,channel:
      type: int
      required: false
      description: UART DMA channel to use

    aspeed,lsc:
      type: phandle
      required: false
      description: phandle to the LSC (LPC controller) device tree node

    aspeed,reset-source:
      type: array
      required: false
      description: |
        HICR9 reset source bit and value to program before the UART is
        initialized, as <bit value>. "bit" is the bit position within the
        LSC HICR9 register (base + 0x98) and "value" is 0 or 1, the value
        to write into that bit. Requires aspeed,lsc to be set.
```

## dts/bindings/spi/aspeed,ast1030-spi-controller.yaml
```yaml
# Copyright (c) 2026 ASPEED Technology Inc.
# SPDX-License-Identifier: Apache-2.0

description: ASPEED AST1030 FMC_SPI controller node

compatible: "aspeed,ast1030-spi-controller"

include: aspeed,spi-common.yaml
```

## dts/bindings/spi/aspeed,ast1040-spi-lite-controller.yaml
```yaml
# Copyright (c) 2026 ASPEED Technology Inc.
# SPDX-License-Identifier: Apache-2.0

description: ASPEED AST1040 SPI Lite controller node

compatible: "aspeed,ast1040-spi-lite-controller"

include: aspeed,spi-common.yaml
```
