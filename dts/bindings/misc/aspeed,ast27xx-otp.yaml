## dts/bindings/spi/aspeed,ast1060-spi-controller.yaml
```yaml
# Copyright (c) 2026 ASPEED Technology Inc.
# SPDX-License-Identifier: Apache-2.0

description: ASPEED AST1060 FMC_SPI controller node

compatible: "aspeed,ast1060-spi-controller"

include: aspeed,spi-common.yaml
```

## dts/bindings/spi/aspeed,ast1080-spi-monitor-controller.yaml
```yaml
# Copyright (c) 2026 ASPEED Technology Inc.
# SPDX-License-Identifier: Apache-2.0

description: ASPEED AST1080 SPI Monitor controller node

compatible: "aspeed,ast1080-spi-monitor-controller"

include: aspeed,spi-monitor-controller.yaml
```

## dts/bindings/spi/aspeed,ast10x0-g2-spi-controller.yaml
```yaml
# Copyright (c) 2026 ASPEED Technology Inc.
# SPDX-License-Identifier: Apache-2.0

description: ASPEED AST10X0_G2 CM4 FMC/SPI controller node

compatible: "aspeed,ast10x0-g2-spi-controller"

include: aspeed,spi-common.yaml
```

## dts/bindings/spi/aspeed,ast10x0-g2-spi-filter-controller.yaml
```yaml
# Copyright (c) 2026 ASPEED Technology Inc.
# SPDX-License-Identifier: Apache-2.0

description: ASPEED AST10X0-G2 SPI filter controller node

compatible: "aspeed,ast10x0-g2-spi-filter-controller"

include: aspeed,spi-monitor-controller.yaml
```

## dts/bindings/spi/aspeed,ast10x0-g2-spi-lite-controller.yaml
```yaml
# Copyright (c) 2026 ASPEED Technology Inc.
# SPDX-License-Identifier: Apache-2.0

description: ASPEED AST10X0_G2 SPI Lite controller node

compatible: "aspeed,ast10x0-g2-spi-lite-controller"

include: aspeed,spi-common.yaml
```
