## boards/aspeed/ast1042_evb/Kconfig.ast1042_evb
```kconfig
# SPDX-License-Identifier: Apache-2.0
#
# Aspeed AST1042 evaluation board configuration
#
# Copyright (c) 2026 ASPEED Technology Inc.

config BOARD_AST1042_EVB
	select SOC_AST1042_CM4 if BOARD_AST1042_EVB_AST1042_CM4
	select SOC_AST1042_BOOTMCU if BOARD_AST1042_EVB_AST1042_BOOTMCU

config ASPEED_FPGA
	bool "ASPEED FPGA support"
	default n
	help
	  Enable support for ASPEED FPGA devices.

config ASPEED_HAPS
	bool "ASPEED HAPS support"
	default n
	help
	  Enable support for ASPEED HAPS devices.
```

## boards/aspeed/ast1042_evb/board.yml
```yaml
board:
  name: ast1042_evb
  vendor: aspeed
  socs:
  - name: ast1042
    variants:
    - name: cm4
      cpucluster: cm4
    - name: bootmcu
      cpucluster: bootmcu
```

## dts/bindings/pinctrl/aspeed,g7-soc1-pinctrl.yaml
```yaml
# Copyright (c) Aspeed Technology Inc.
# SPDX-License-Identifier: Apache-2.0

description: Aspeed pin control

compatible: "aspeed,g7-soc1-pinctrl"

include: base.yaml

child-binding:
  description: Aspeed pin configuration nodes
  include:
    - name: pincfg-node.yaml

  properties:
    sig_descs:
      type: int
      description: |
        Omit for a pin that only carries pincfg (drive-strength /
        bias-disable) and has no pinmux to select.
    ball:
      required: true
      type: int
    bias-disable-desc:
      type: int
      description: |
        PINCFG_DESC() location of the bias/pull-disable control bit for
        this ball. Combined with the generic "bias-disable" property
        (from pincfg-node.yaml) to decide whether to write it.
    pull-up-disable-desc:
      type: int
      description: |
        PINCFG_DESC() location of a second, independent pull-up disable
        bit, for balls whose pull-up and pull-down each have their own
        disable control (e.g. AST10x0-G2's DIS_PU/DIS_PD). Written
        alongside bias-disable-desc whenever "bias-disable" is set; omit
        on balls with a single combined disable bit.
    drive-strength-desc:
      type: int
      description: |
        PINCFG_DESC() location of the drive-strength field for this
        ball. Combined with the generic "drive-strength" property (from
        pincfg-node.yaml) for the value to write.
```
