## boards/aspeed/ast1040_evb/Kconfig.ast1040_evb
```kconfig
# SPDX-License-Identifier: Apache-2.0
#
# Aspeed AST1040 evaluation board configuration
#
# Copyright (c) 2023 Aspeed Technology Inc.

config BOARD_AST1040_EVB
	select SOC_AST1040_CM4 if BOARD_AST1040_EVB_AST1040_CM4
	select SOC_AST1040_BOOTMCU if BOARD_AST1040_EVB_AST1040_BOOTMCU

config ASPEED_FPGA
	bool "ASPEED FPGA support"
	default n
	help
	  Enable support for ASPEED FPGA devices.

config ASPEED_HAPS
	bool "ASPEED HAPS support"
	default n
	help
	  Enable support for ASPEED HAPS devices.
```

## boards/aspeed/ast1040_evb/ast1040_evb_bootmcu_defconfig
```kconfig
# SPDX-License-Identifier: Apache-2.0
#
# Copyright (c) 2023 Aspeed Technology Inc.
#

# CONFIG_XIP is not set
CONFIG_CONSOLE=y
CONFIG_SERIAL=y
CONFIG_REBOOT=y
# CONFIG_CRYPTO=y
# CONFIG_CPTRA_ECDSA=y
# CONFIG_CPTRA_SHA=y
# CONFIG_CPTRA_UPDATE=y
# CONFIG_CPTRA_IFC=y
# CONFIG_CPTRA_MBOX=y
# CONFIG_CPTRA_LMS=y
# CONFIG_CPTRA_DICE=y
# CONFIG_CPTRA_MISC=y
# CONFIG_CPTRA_IPC=y
# CONFIG_ENTROPY_GENERATOR=y
# CONFIG_ENTROPY_ASPEED_TRNG=y
# CONFIG_IPM=y
```

## boards/aspeed/ast1040_evb/ast1040_evb_cm4_defconfig
```kconfig
# SPDX-License-Identifier: Apache-2.0
#
# Copyright (c) 2023 Aspeed Technology Inc.
#

CONFIG_REBOOT=y
CONFIG_SHELL=y
CONFIG_KERNEL_SHELL=y
CONFIG_WATCHDOG=y
CONFIG_ADC=y
CONFIG_ADC_ASPEED=y
CONFIG_ADC_SHELL=y
CONFIG_CLOCK_CONTROL=y
CONFIG_CONSOLE=y
CONFIG_HEAP_MEM_POOL_SIZE=16384
CONFIG_HWINFO=y
CONFIG_JTAG=y
CONFIG_JTAG_ASPEED=y
CONFIG_JTAG_SHELL=y
CONFIG_JTAG_ASPEED_HW_MODE2=y
CONFIG_GPIO=y
CONFIG_GPIO_SHELL=y
CONFIG_I2C=y
CONFIG_I2C_ASPEED=y
CONFIG_MAIN_STACK_SIZE=4096
CONFIG_PECI=y
CONFIG_PECI_ASPEED=y
CONFIG_PECI_SHELL=y
CONFIG_PINCTRL=y
CONFIG_PWM=y
CONFIG_PWM_ASPEED=y
CONFIG_PWM_SHELL=y
CONFIG_RESET=y
CONFIG_SENSOR=y
CONFIG_SENSOR_SHELL=y
CONFIG_SERIAL=y
CONFIG_SYS_CLOCK_HW_CYCLES_PER_SEC=400000000
CONFIG_TACH_ASPEED=y
CONFIG_TIMING_FUNCTIONS=y
CONFIG_UART_CONSOLE=y
CONFIG_FLASH=y
CONFIG_SPI=y
CONFIG_SPI_ASPEED=y
CONFIG_SPI_NOR_MULTI_DEV=y
# CONFIG_SPI_NOR is not set
CONFIG_FLASH_PAGE_LAYOUT=y
CONFIG_FLASH_MAP=y
CONFIG_FLASH_SHELL=y
CONFIG_SPI_DMA_SUPPORT_ASPEED=y
CONFIG_SPI_MONITOR_ASPEED=y
CONFIG_SPI_MONITOR_SHELL_ASPEED=y
CONFIG_CPTRA_MCI_MBOX=y
CONFIG_CPTRA_MCI_MISC=y
CONFIG_CPTRA_MCI_SHELL=y
CONFIG_CRYPTO=y
CONFIG_CPTRA_MCI_SHA=y
CONFIG_CPTRA_MCI_SHA_ACC=y
CONFIG_CPTRA_MCI_ECDSA=y
CONFIG_CPTRA_MCI_LMS=y
CONFIG_CPTRA_MCI_MLDSA=y
CONFIG_CPTRA_MCI_CRYPTOGRAPHIC_MBOX=y
CONFIG_ATC_ASPEED=y
CONFIG_OTP_AST27XX=y
CONFIG_OTP_AST1040_SHELL=y
# I3C loopback pairs (i3c1/3/5/7 controllers + i3c0/2/4/6 secondary targets on the EVB)
CONFIG_I3C=y
CONFIG_I3C_USE_IBI=y
CONFIG_I3C_IBI_WORKQUEUE=y
CONFIG_I3C_MIPI_HCI=y
CONFIG_I3C_MIPI_HCI_PIO=y
CONFIG_I3C_MIPI_HCI_DMA=y
CONFIG_I3C_MIPI_HCI_TARGET=y
CONFIG_I3C_MIPI_HCI_ASPEED_VENDOR=y
CONFIG_I3C_DUMMY_DEVICE=y
CONFIG_I3C_TARGET=y
CONFIG_I3C_TARGET_MQUEUE=y
CONFIG_I3C_SHELL=y
CONFIG_CRC=y
# For CMSIS
CONFIG_POLL=y
CONFIG_THREAD_NAME=y
CONFIG_THREAD_STACK_INFO=y
CONFIG_THREAD_MONITOR=y
CONFIG_INIT_STACKS=y
CONFIG_NUM_PREEMPT_PRIORITIES=56
CONFIG_CMSIS_RTOS_V2=y
CONFIG_CMSIS_V2_EVT_FLAGS_MAX_COUNT=64
```

## boards/aspeed/ast1040_evb/board.yml
```yaml
board:
  name: ast1040_evb
  vendor: aspeed
  socs:
  - name: ast1040
    variants:
    - name: cm4
      cpucluster: cm4
    - name: bootmcu
      cpucluster: bootmcu
```

## boards/aspeed/ast1040_haps/board.yml
```yaml
board:
  name: ast1040_haps
  vendor: aspeed
  socs:
  - name: ast1040
    variants:
    - name: cm4
      cpucluster: cm4
    - name: bootmcu
      cpucluster: bootmcu
```

## boards/aspeed/ast1060_evb/Kconfig.ast1060_evb
```kconfig
# SPDX-License-Identifier: Apache-2.0
#
# Aspeed AST1060 evaluation board configuration
#
# Copyright (c) 2021 ASPEED Technology Inc.

config BOARD_AST1060_EVB
	select SOC_AST1060
```

## boards/aspeed/ast1080_evb/board.yml
```yaml
board:
  name: ast1080_evb
  vendor: aspeed
  socs:
  - name: ast1080
    variants:
    - name: cm4
      cpucluster: cm4
    - name: bootmcu
      cpucluster: bootmcu
```

## boards/aspeed/ast1080_haps/Kconfig.ast1080_haps
```kconfig
# SPDX-License-Identifier: Apache-2.0
#
# Aspeed AST1080 evaluation board configuration
#
# Copyright (c) 2023 Aspeed Technology Inc.

config BOARD_AST1080_HAPS
	select SOC_AST1080_CM4 if BOARD_AST1080_HAPS_AST1080_CM4
	select SOC_AST1080_BOOTMCU if BOARD_AST1080_HAPS_AST1080_BOOTMCU

config ASPEED_FPGA
	bool "ASPEED FPGA support"
	default n
	help
	  Enable support for ASPEED FPGA devices.

config ASPEED_HAPS
	bool "ASPEED HAPS support"
	default n
	help
	  Enable support for ASPEED HAPS devices.
```

## boards/aspeed/ast1080_haps/board.yml
```yaml
board:
  name: ast1080_haps
  vendor: aspeed
  socs:
  - name: ast1080
    variants:
    - name: cm4
      cpucluster: cm4
    - name: bootmcu
      cpucluster: bootmcu
```

## boards/aspeed/ast2600_evb/ast2600_evb_ast2600_ssp_defconfig
```kconfig
CONFIG_HWINFO=y
CONFIG_CLOCK_CONTROL=y
CONFIG_MAIN_STACK_SIZE=4096
CONFIG_NUM_PREEMPT_PRIORITIES=56
CONFIG_SERIAL=y
CONFIG_CONSOLE=y
CONFIG_UART_CONSOLE=y
CONFIG_CLOCK_CONTROL_AST26XX=y
CONFIG_STACK_SENTINEL=y
CONFIG_EARLY_CONSOLE=y
CONFIG_REBOOT=y
CONFIG_ASSERT=y
# For CMSIS
CONFIG_POLL=y
CONFIG_THREAD_NAME=y
CONFIG_THREAD_STACK_INFO=y
CONFIG_THREAD_MONITOR=y
CONFIG_INIT_STACKS=y
CONFIG_NUM_PREEMPT_PRIORITIES=56
CONFIG_CMSIS_RTOS_V2=y
CONFIG_PINCTRL=y
CONFIG_RESET=y
CONFIG_UART_ASPEED=y
```

## boards/aspeed/ast2600_evb/board.yml
```yaml
board:
  name: ast2600_evb
  vendor: aspeed
  socs:
  - name: ast2600
    variants:
    - name: ddr
      cpucluster: ssp
```

## boards/aspeed/ast2700_evb/Kconfig.ast2700_evb
```kconfig
# SPDX-License-Identifier: Apache-2.0
#
# Aspeed AST2700 Evaluation board configuration
#
# Copyright (c) 2023 Aspeed Technology Inc.

config BOARD_AST2700_EVB
	select SOC_AST2700_SSP if BOARD_AST2700_EVB_AST2700_SSP
	select SOC_AST2700_SSP if BOARD_AST2700_EVB_AST2700_SSP_TSP
	select SOC_AST2700_TSP if BOARD_AST2700_EVB_AST2700_TSP
	select SOC_AST2700_BOOTMCU if BOARD_AST2700_EVB_AST2700_BOOTMCU
	select SOC_AST2700_A0_SSP if BOARD_AST2700_EVB_AST2700_A0_SSP
	select SOC_AST2700_A0_TSP if BOARD_AST2700_EVB_AST2700_A0_TSP

config SOC_FMC_LOAD_MANIFEST_ADDRESS
	hex "FMC load manifest address"
	default 0x20100000
	help
	  Set the address to load the manifest file for FMC

if SHELL
config SHELL_PROMPT_UART
	default "ssp:~$ " if BOARD_AST2700_EVB_AST2700_SSP || BOARD_AST2700_EVB_AST2700_A0_SSP
	default "tsp:~$ " if BOARD_AST2700_EVB_AST2700_TSP || BOARD_AST2700_EVB_AST2700_A0_TSP
	default "ssp_tsp:~$ " if BOARD_AST2700_EVB_AST2700_SSP_TSP
	default "bootmcu:~$ " if BOARD_AST2700_EVB_AST2700_BOOTMCU
endif
```

## boards/aspeed/ast2700_evb/Kconfig.defconfig
```kconfig
# SPDX-License-Identifier: Apache-2.0
#
# Aspeed AST2700 Evaluation board configuration
#
# Copyright (c) 2023 Aspeed Technology Inc.

if BOARD_AST2700_EVB_AST2700_SSP
config BOARD
	default "ast2700_evb_ssp"
endif # BOARD_AST2700_EVB_AST2700_SSP

if BOARD_AST2700_EVB_AST2700_TSP
config BOARD
	default "ast2700_evb_tsp"
endif # BOARD_AST2700_EVB_AST2700_TSP
```

## boards/aspeed/ast2700_evb/ast2700_evb_ast2700-a0_tsp_defconfig
```kconfig
# SPDX-License-Identifier: Apache-2.0
#
# Copyright (c) 2023 Aspeed Technology Inc.
#
CONFIG_MAIN_STACK_SIZE=4096
CONFIG_CONSOLE=y
CONFIG_UART_CONSOLE=y
CONFIG_SERIAL=y
CONFIG_RESET=y
CONFIG_CLOCK_CONTROL=y
CONFIG_HEAP_MEM_POOL_SIZE=50000
CONFIG_IPM=y
```

## boards/aspeed/ast2700_evb/ast2700_evb_ast2700_bootmcu_defconfig
```kconfig
# CONFIG_XIP is not set
CONFIG_CONSOLE=y
CONFIG_UART_CONSOLE=y
CONFIG_SERIAL=y
CONFIG_UART_NS16550_ACCESS_WORD_ONLY=y
CONFIG_LOG_FUNC_NAME_PREFIX_INF=y
CONFIG_REBOOT=y
CONFIG_CRYPTO=y
CONFIG_CPTRA_ECDSA=y
CONFIG_CPTRA_SHA=y
CONFIG_CPTRA_UPDATE=y
CONFIG_CPTRA_IFC=y
CONFIG_CPTRA_MBOX=y
CONFIG_CPTRA_LMS=y
CONFIG_ENTROPY_GENERATOR=y
CONFIG_ENTROPY_ASPEED_TRNG=y
```

## boards/aspeed/ast2700_evb/ast2700_evb_ast2700_ibex_defconfig
```kconfig
CONFIG_SYS_CLOCK_HW_CYCLES_PER_SEC=1000000
# CONFIG_XIP is not set
CONFIG_SYS_CLOCK_EXISTS=y
CONFIG_CONSOLE=y
CONFIG_UART_CONSOLE=y
CONFIG_SERIAL=y
CONFIG_UART_NS16550_ACCESS_WORD_ONLY=y
CONFIG_SHELL_PROMPT_UART="ibex:~$ "
CONFIG_LOG_FUNC_NAME_PREFIX_INF=y
CONFIG_REBOOT=y
CONFIG_CRYPTO=y
CONFIG_CPTRA_ECDSA=y
CONFIG_CPTRA_SHA=y
CONFIG_FLASH=y
CONFIG_SPI=y
CONFIG_SPI_NOR_MULTI_DEV=y
CONFIG_SPI_ASPEED_AST2700=y
CONFIG_FLASH_PAGE_LAYOUT=y
# CONFIG_SPI_NOR is not set
CONFIG_FLASH_MAP=y
CONFIG_WATCHDOG=y
CONFIG_WDT_ASPEED_G7=y
```

## boards/aspeed/ast2700_evb/ast2700_evb_ast2700_ssp-tsp_defconfig
```kconfig
# SPDX-License-Identifier: Apache-2.0
#
# Copyright (c) 2025 Aspeed Technology Inc.
#
CONFIG_MAIN_STACK_SIZE=8192
CONFIG_CONSOLE=y
CONFIG_UART_CONSOLE=y
CONFIG_SERIAL=y
CONFIG_RESET=y
CONFIG_CLOCK_CONTROL=y
CONFIG_HEAP_MEM_POOL_SIZE=16384
CONFIG_IPM=y
CONFIG_CPTRA_IPC_SSP=y
CONFIG_ENTROPY_GENERATOR=y
CONFIG_ENTROPY_ASPEED_TRNG=y
```

## boards/aspeed/ast2700_evb/board.yml
```yaml
board:
  name: ast2700_evb
  vendor: aspeed
  socs:
  - name: ast2700
    variants:
    - name: ddr
      cpucluster: ssp
    - name: ddr
      cpucluster: ssp_tsp
    - name: ddr
      cpucluster: tsp
    - name: sram
      cpucluster: bootmcu
  - name: ast2700_a1
    variants:
    - name: ddr
      cpucluster: ssp
    - name: ddr
      cpucluster: ssp_tsp
    - name: ddr
      cpucluster: tsp
    - name: sram
      cpucluster: bootmcu
```

## boards/aspeed/ast2700_fpga/Kconfig.ast2700_fpga
```kconfig
# SPDX-License-Identifier: Apache-2.0
#
# Aspeed AST2700 Evaluation board configuration
#
# Copyright (c) 2023 Aspeed Technology Inc.

config BOARD_AST2700_FPGA
	select SOC_AST2700_SSP if BOARD_AST2700_FPGA_AST2700_SSP
	select SOC_AST2700_SSP if BOARD_AST2700_FPGA_AST2700_SSP_TSP
	select SOC_AST2700_TSP if BOARD_AST2700_FPGA_AST2700_TSP
	select SOC_AST2700_BOOTMCU if BOARD_AST2700_FPGA_AST2700_BOOTMCU

config ASPEED_FPGA
	bool "ASPEED FPGA support"
	default n
	help
	  Enable support for ASPEED FPGA devices.

if SHELL
config SHELL_PROMPT_UART
	default "ssp:~$ " if BOARD_AST2700_EVB_AST2700_SSP || BOARD_AST2700_EVB_AST2700_A0_SSP
	default "tsp:~$ " if BOARD_AST2700_EVB_AST2700_TSP || BOARD_AST2700_EVB_AST2700_A0_TSP
	default "ssp_tsp:~$ " if BOARD_AST2700_EVB_AST2700_SSP_TSP
	default "bootmcu:~$ " if BOARD_AST2700_EVB_AST2700_BOOTMCU
endif
```

## boards/aspeed/ast2700_fpga/Kconfig.defconfig
```kconfig
# SPDX-License-Identifier: Apache-2.0
#
# Aspeed AST2700 FPGA board configuration
#
# Copyright (c) 2023 Aspeed Technology Inc.

if BOARD_AST2700_FPGA_AST2700_SSP
config BOARD
	default "ast2700_fpga_ssp"
endif # BOARD_AST2700_FPGA_AST2700_SSP

if BOARD_AST2700_FPGA_AST2700_TSP
config BOARD
	default "ast2700_fpga_tsp"
endif # BOARD_AST2700_FPGA_AST2700_TSP

if BOARD_AST2700_FPGA_AST2700_IBEX
config BOARD
	default "ast2700_fpga_ibex"
endif # BOARD_AST2700_FPGA_AST2700_IBEX

config ASPEED_FPGA
	bool "ASPEED FPGA Board"
```

## boards/aspeed/ast2700_fpga/ast2700_fpga_ast2700_ibex_defconfig
```kconfig
CONFIG_SYS_CLOCK_HW_CYCLES_PER_SEC=1000000
# CONFIG_XIP is not set
CONFIG_SYS_CLOCK_EXISTS=y
CONFIG_CONSOLE=y
CONFIG_UART_CONSOLE=y
CONFIG_SERIAL=y
CONFIG_UART_NS16550_ACCESS_WORD_ONLY=y
CONFIG_SHELL_PROMPT_UART="ibex:~$ "
CONFIG_ASPEED_FPGA=y
CONFIG_REBOOT=y
```

## boards/aspeed/ast2700_fpga/ast2700_fpga_ast2700_ssp_defconfig
```kconfig
# SPDX-License-Identifier: Apache-2.0
#
# Copyright (c) 2023 Aspeed Technology Inc.
#
CONFIG_SYS_CLOCK_HW_CYCLES_PER_SEC=400000000
CONFIG_MAIN_STACK_SIZE=4096
CONFIG_CONSOLE=y
CONFIG_UART_CONSOLE=y
CONFIG_SERIAL=y
CONFIG_RESET=y
CONFIG_CLOCK_CONTROL=y
CONFIG_HEAP_MEM_POOL_SIZE=50000
CONFIG_IPM=y
CONFIG_SHELL_PROMPT_UART="ssp:~$ "
CONFIG_ASPEED_FPGA=y
```

## boards/aspeed/ast2700_fpga/board.yml
```yaml
board:
  name: ast2700_fpga
  vendor: aspeed
  socs:
  - name: ast2700
    variants:
    - name: ddr
      cpucluster: ssp
    - name: ddr
      cpucluster: ssp_tsp
    - name: ddr
      cpucluster: tsp
    - name: sram
      cpucluster: bootmcu
  - name: ast2700_a1
    variants:
    - name: ddr
      cpucluster: ssp
    - name: ddr
      cpucluster: tsp
```

## boards/aspeed/ast2700_haps/Kconfig.defconfig
```kconfig
# SPDX-License-Identifier: Apache-2.0
#
# Aspeed AST2700 Evaluation board configuration
#
# Copyright (c) 2023 Aspeed Technology Inc.

if BOARD_AST2700_EVB_AST2700_SSP
config BOARD
	default "ast2700_evb_ast2700_ssp"
endif # BOARD_AST2700_EVB_AST2700_SSP

if BOARD_AST2700_EVB_AST2700_TSP
config BOARD
	default "ast2700_evb_ast2700_tsp"
endif # BOARD_AST2700_EVB_AST2700_TSP

if BOARD_AST2700_HAPS_AST2700_BOOTMCU
config BOARD
	default "ast2700_fpga_ast2700_bootmcu"
endif # BOARD_AST2700_EVB_AST2700_BOOTMCU
```
