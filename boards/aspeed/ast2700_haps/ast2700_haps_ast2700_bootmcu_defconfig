## boards/aspeed/ast2700_haps/ast2700_haps_ast2700_bootmcu_defconfig
```kconfig
# CONFIG_XIP is not set
CONFIG_CONSOLE=y
CONFIG_SERIAL=y
CONFIG_REBOOT=y
#CONFIG_CRYPTO=y
#CONFIG_CPTRA_ECDSA=y
#CONFIG_CPTRA_SHA=y
#CONFIG_CPTRA_UPDATE=y
#CONFIG_CPTRA_IFC=y
#CONFIG_CPTRA_MBOX=y
#CONFIG_CPTRA_LMS=y
#CONFIG_CPTRA_DICE=y
#CONFIG_CPTRA_MISC=y
#CONFIG_CPTRA_IPC=y
CONFIG_ENTROPY_GENERATOR=y
CONFIG_ENTROPY_ASPEED_TRNG=y
CONFIG_IPM=y
CONFIG_SYS_CLOCK_HW_CYCLES_PER_SEC=24000000
CONFIG_SYS_CLOCK_TICKS_PER_SEC=1000
# CONFIG_LOG_PRINTK is not set
CONFIG_ASPEED_FPGA=y
CONFIG_ASPEED_HAPS=y
```

## boards/aspeed/ast2700_haps/board.yml
```yaml
board:
  name: ast2700_haps
  vendor: aspeed
  socs:
  - name: ast2700
    variants:
    - name: ddr
      cpucluster: ssp
    - name: ddr
      cpucluster: ssp_tsp
    - name: ddr
      cpucluster: tsp
    - name: sram
      cpucluster: bootmcu
  - name: ast2700-a0
    variants:
    - name: ddr
      cpucluster: ssp
    - name: ddr
      cpucluster: tsp
```

## boards/aspeed/ast2705_evb/Kconfig.ast2705_evb
```kconfig
# SPDX-License-Identifier: Apache-2.0
#
# Aspeed AST2705 Evaluation board configuration
#
# Copyright (c) 2023 Aspeed Technology Inc.

config BOARD_AST2705_EVB
	select SOC_AST2705_SSP if BOARD_AST2705_EVB_AST2705_SSP
	select SOC_AST2705_SSP if BOARD_AST2705_EVB_AST2705_SSP_TSP
	select SOC_AST2705_TSP if BOARD_AST2705_EVB_AST2705_TSP
	select SOC_AST2705_BOOTMCU if BOARD_AST2705_EVB_AST2705_BOOTMCU

config ASPEED_FPGA
	bool "ASPEED FPGA support"
	default n
	help
	  Enable support for ASPEED FPGA devices.

config ASPEED_HAPS
	bool "ASPEED HAPS support"
	default n
	help
	  Enable support for ASPEED HAPS devices.

if SHELL
config SHELL_PROMPT_UART
	default "ssp:~$ " if BOARD_AST2705_EVB_AST2705_SSP
	default "tsp:~$ " if BOARD_AST2705_EVB_AST2705_TSP
	default "ssp_tsp:~$ " if BOARD_AST2705_EVB_AST2705_SSP_TSP
	default "bootmcu:~$ " if BOARD_AST2705_EVB_AST2705_BOOTMCU
endif
```

## boards/aspeed/ast2705_evb/Kconfig.defconfig
```kconfig
# SPDX-License-Identifier: Apache-2.0
#
# Aspeed AST2705 Evaluation board configuration
#
# Copyright (c) 2026 Aspeed Technology Inc.

if BOARD_AST2705_EVB_AST2705_SSP
config BOARD
	default "ast2705_evb_ast2705_ssp"
endif # BOARD_AST2705_EVB_AST2705_SSP

if BOARD_AST2705_EVB_AST2705_SSP_TSP
config BOARD
	default "ast2705_evb_ast2705_ssp_tsp"
endif # BOARD_AST2705_EVB_AST2705_SSP_TSP

if BOARD_AST2705_EVB_AST2705_TSP
config BOARD
	default "ast2705_evb_ast2705_tsp"
endif # BOARD_AST2705_EVB_AST2705_TSP

if BOARD_AST2705_EVB_AST2705_BOOTMCU
config BOARD
	default "ast2705_evb_ast2705_bootmcu"
endif # BOARD_AST2705_EVB_AST2705_BOOTMCU
```

## boards/aspeed/ast2705_evb/board.yml
```yaml
board:
  name: ast2705_evb
  vendor: aspeed
  socs:
  - name: ast2705
    variants:
    - name: ddr
      cpucluster: ssp
    - name: ddr
      cpucluster: ssp_tsp
    - name: ddr
      cpucluster: tsp
    - name: sram
      cpucluster: bootmcu
```

## boards/aspeed/ast2755_evb/board.yml
```yaml
board:
  name: ast2755_evb
  vendor: aspeed
  socs:
  - name: ast2700
    variants:
    - name: ddr
      cpucluster: ssp
    - name: ddr
      cpucluster: ssp_tsp
    - name: ddr
      cpucluster: tsp
    - name: sram
      cpucluster: bootmcu
```

## drivers/cache/Kconfig.aspeed
```kconfig
# SPDX-License-Identifier: Apache-2.0
#
# Copyright (c) 2022 ASPEED Technology Inc.

config CACHE_ASPEED
bool "ASPEED external cache driver"
	depends on SOC_SERIES_AST10X0 || SOC_SERIES_AST26XX || SOC_SERIES_AST1040
	depends on SYSCON
	select CACHE_HAS_DRIVER
	help
	  This option enables the CACHE driver for ASPEED AST10X0 & AST26XX series SOC.

config CACHE_AST27XX
bool "ASPEED AST27XX external cache driver"
	depends on SOC_AST2700_SSP || SOC_AST2700_TSP || SOC_AST2700_A1_SSP || SOC_AST2700_A1_TSP
	select CACHE_HAS_DRIVER
	help
	  This option enables the CACHE driver for ASPEED AST27XX series SOC.
```

## drivers/clock_control/Kconfig.aspeed
```kconfig
# Copyright (c) 2022 ASPEED Technology Inc.
# SPDX-License-Identifier: Apache-2.0

config CLOCK_CONTROL_AST10X0
	bool "ASPEED clock control driver"
	default y
	depends on DT_HAS_ASPEED_AST10X0_CLOCK_ENABLED
	help
	  This option enables the clock driver for ASPEED AST10X0 series SOC.

config CLOCK_CONTROL_AST26XX
	bool "ASPEED clock control driver"
	default y
	depends on DT_HAS_ASPEED_AST26XX_CLOCK_ENABLED
	help
	  This option enables the clock driver for ASPEED AST26XX series SOC.

config CLOCK_CONTROL_AST27XX
	bool "AST2700 clock control driver"
	default n
	depends on DT_HAS_ASPEED_AST27XX_SCU0_CLOCK_ENABLED || DT_HAS_ASPEED_AST27XX_SCU1_CLOCK_ENABLED
	help
	  This option enables the clock driver for ASPEED AST27XX series SOC.

config CLOCK_CONTROL_AST1040
	bool "AST1040 clock control driver"
	default y
	depends on DT_HAS_ASPEED_AST27XX_SCU1_CLOCK_ENABLED
	help
	  This option enables the clock driver for ASPEED AST1040 series SOC.
```

## drivers/crypto/Kconfig.aspeed
```kconfig
# ASPEED HACE driver configuration options

# Copyright (c) 2021 ASPEED Technology Inc.
# SPDX-License-Identifier: Apache-2.0

config CRYPTO_ASPEED
	bool "ASPEED Hash and Crypto engine driver"
	depends on SOC_FAMILY_ASPEED
	help
	  This option enables the HACE driver for ASPEED SoCs.

config RSA_ASPEED
	bool "ASPEED RSA engine driver"
	depends on SOC_FAMILY_ASPEED
	help
	  This option enables the RSA driver for ASPEED SoCs.

config ECDSA_ASPEED
	bool "ASPEED ECDSA engine driver"
	depends on SOC_FAMILY_ASPEED
	select RSA_ASPEED
	help
	  This option enables the ECDSA driver for ASPEED SoCs.

config CPTRA_ECDSA
	bool "ASPEED CPTRA ECDSA engine driver"
	depends on SOC_AST2700_BOOTMCU || SOC_AST2705_BOOTMCU
	help
	  This option enables the Caliptra ECDSA driver for ASPEED SoCs.

config CPTRA_SHA
	bool "ASPEED CPTRA SHA engine driver"
	depends on SOC_AST2700_BOOTMCU || SOC_AST2705_BOOTMCU
	help
	  This option enables the Caliptra SHA driver for ASPEED SoCs.

config CPTRA_LMS
	bool "ASPEED CPTRA LMS engine driver"
	depends on SOC_AST2700_BOOTMCU || SOC_AST2705_BOOTMCU
	help
	  This option enables the Caliptra LMS driver for ASPEED SoCs.

config CPTRA_MCI_SHA
	bool "ASPEED CPTRA MCI mailbox SHA engine driver"
	depends on CPTRA_MCI_MBOX
	help
	  This option enables the Caliptra-SS MCI mailbox SHA
	  (MC_SHA_INIT/MC_SHA_UPDATE/MC_SHA_FINAL) driver for ASPEED SoCs.

config CPTRA_MCI_ECDSA
	bool "ASPEED CPTRA MCI mailbox raw-pubkey ECDSA-384 verify driver"
	depends on CPTRA_MCI_MBOX
	help
	  This option enables the Caliptra-SS MCI mailbox raw-pubkey
	  ECDSA-384 signature verify (MC_ECDSA384_SIG_VERIFY) driver, exposed
	  through Zephyr's generic crypto/ecdsa.h API, for ASPEED SoCs.

config CPTRA_MCI_LMS
	bool "ASPEED CPTRA MCI mailbox LMS verify driver"
	depends on CPTRA_MCI_MBOX
	help
	  This option enables the Caliptra-SS MCI mailbox LMS signature
	  verify (MC_LMS_SIG_VERIFY) driver, exposed through Zephyr's
	  generic crypto/lms.h API, for ASPEED SoCs.

config CPTRA_MCI_MLDSA
	bool "ASPEED CPTRA MCI mailbox raw-pubkey ML-DSA-87 verify driver"
	depends on CPTRA_MCI_MBOX
	help
	  This option enables the Caliptra-SS MCI mailbox raw-pubkey
	  ML-DSA-87 signature verify (MC_MLDSA87_SIG_VERIFY) driver, exposed
	  through Zephyr's generic crypto/mldsa.h API, for ASPEED SoCs.

config HASH_SHELL
	bool "Enable Hash Shell"
	depends on CRYPTO_ASPEED || CPTRA_SHA
	depends on SHELL
	help
	  Enable Hash Shell for testing.

config CRYPTO_SHELL
	bool "Enable CRYPTO Shell"
	depends on CRYPTO_ASPEED
	depends on SHELL
	help
	  Enable RSA Shell for testing.

config RSA_SHELL
	bool "Enable RSA Shell"
	depends on RSA_ASPEED
	depends on SHELL
	help
	  Enable RSA Shell for testing.

config ECDSA_SHELL
	bool "Enable ECDSA Shell"
	depends on ECDSA_ASPEED || CPTRA_ECDSA
	depends on MBEDTLS
	depends on SHELL
	help
	  Enable ECDSA Shell for testing.
```

## drivers/entropy/Kconfig.aspeed
```kconfig
# Aspeed entropy generator driver configuration

# Copyright (c) 2023 ASPEED Technology Inc.
# SPDX-License-Identifier: Apache-2.0

config ENTROPY_ASPEED_TRNG
	bool "Aspeed TRNG driver"
	depends on SOC_FAMILY_ASPEED
	select ENTROPY_HAS_DRIVER
	help
	  This option enables the true random number generator
	  driver based on the SCU HWRNG.

config ENTROPY_ASPEED_NISTTRNG
	bool "Aspeed AST2700 NIST TRNG driver"
	depends on SOC_SERIES_AST27XX
	select ENTROPY_HAS_DRIVER
	help
	  Enable the NIST SP 800-90A compliant CTR_DRBG (AES-256) TRNG
	  driver for the AST2700 SoC. This driver uses the dedicated NIST
	  TRNG hardware block, which is distinct from the legacy SCU HWRNG
	  used by ENTROPY_ASPEED_TRNG.

config RANDOM_SHELL
	bool "Enable random shell"
	default y
	depends on ENTROPY_ASPEED_TRNG || ENTROPY_ASPEED_NISTTRNG
	depends on SHELL
	help
	  Enable random shell for testing.
```

## drivers/gpio/Kconfig.aspeed
```kconfig
# Copyright (c) 2023 ASPEED
# SPDX-License-Identifier: Apache-2.0

config GPIO_ASPEED
	bool "ASPEED GPIO Controllers"
	depends on SOC_FAMILY_ASPEED
	help
	  Enable config options to support the ASPEED GPIO controllers.

config GPIO_ASPEED_INIT_PRIORITY
	int "Init priority"
	depends on GPIO_ASPEED
	default 60
	help
	  Device driver initialization priority.

config GPIO_ASPEED_PERMIT_LOCK
	bool "Lock the GPIO access permission"
	depends on GPIO_ASPEED
	depends on SOC_AST2600 || SOC_AST2605
	default n
	help
	  Use command source new mode to lock the gpio access permission.

config GPIO_ASPEED_G7
	bool "ASPEED G7 GPIO Controllers"
	default y
	depends on DT_HAS_ASPEED_G7_GPIO_ENABLED
	help
	  Enable config options to support the ASPEED G7 GPIO controllers.

config GPIO_ASPEED_G7_INIT_PRIORITY
	int "Init priority"
	depends on GPIO_ASPEED_G7
	default 60
	help
	  Device driver initialization priority.

config GPIO_ASPEED_G7_SGPIOM
	bool "ASPEED G7 SGPIOM Controllers"
	default y
	depends on SOC_FAMILY_ASPEED
	depends on DT_HAS_ASPEED_G7_SGPIOM_ENABLED
	select DYNAMIC_INTERRUPTS
	help
	  Enable config options to support the ASPEED G7 SGPIOM controllers.

config GPIO_ASPEED_G7_SGPIOM_INIT_PRIORITY
	int "Init priority"
	depends on GPIO_ASPEED_G7_SGPIOM
	default 60
	help
	  Device driver initialization priority.

config GPIO_ASPEED_SGPIOM
	bool "ASPEED SGPIOM Controllers"
	depends on SOC_FAMILY_ASPEED
	select DYNAMIC_INTERRUPTS
	help
	  Enable config options to support the ASPEED SGPIOM controllers.

config GPIO_ASPEED_SGPIOM_INIT_PRIORITY
	int "Init priority"
	depends on GPIO_ASPEED_SGPIOM
	default 60
	help
	  Device driver initialization priority.
```

## drivers/i3c/mipi_hci/Kconfig
```kconfig
# Copyright (c) 2026 ASPEED Technology Inc.
# SPDX-License-Identifier: Apache-2.0

menuconfig I3C_MIPI_HCI
	bool "MIPI I3C HCI driver"
	depends on DT_HAS_MIPI_I3C_HCI_ENABLED
	default y
	select I3C_IBI_WORKQUEUE if I3C_USE_IBI
	help
	  Enable the MIPI I3C Host Controller Interface driver skeleton.
	  This option currently builds only Zephyr device-model stubs.

if I3C_MIPI_HCI

config I3C_MIPI_HCI_PIO
	bool "MIPI I3C HCI PIO transfer mode"
	default y
	help
	  Build the PIO transfer-mode stub.

config I3C_MIPI_HCI_DMA
	bool "MIPI I3C HCI DMA transfer mode"
	default n
	help
	  Build the DMA transfer-mode stub. G7 commonly uses DMA, but
	  this skeleton keeps PIO as the default until transfer logic exists.

config I3C_MIPI_HCI_TARGET
	bool "MIPI I3C HCI target and secondary-controller mode"
	default y
	help
	  Build target-mode and secondary-controller support for the MIPI I3C
	  HCI driver. The transfer engine still depends on the selected PIO or
	  DMA implementation.

module = I3C_MIPI_HCI
module-str = i3c-mipi-hci
source "subsys/logging/Kconfig.template.log_config"

endif # I3C_MIPI_HCI
```

## drivers/interrupt_controller/Kconfig.aspeed
```kconfig
# ASPEED driver configuration options

# Copyright (c) 2020 ASPEED Technology Corporation.
# SPDX-License-Identifier: Apache-2.0

config AST27XX_INTC
	bool "Aspeed AST27XX interrupt controller driver"
	depends on MULTI_LEVEL_INTERRUPTS
	depends on SOC_AST2700_SSP || SOC_AST2700_TSP || SOC_AST2700_A1_SSP || \
		   SOC_AST2700_A1_TSP || SOC_AST2705_SSP || SOC_AST2705_TSP
	default DT_HAS_ASPEED_AST2700_INTC_IC_ENABLED
	help
	  This option enables the AST27XX interrupt controller

if AST27XX_INTC
config SYSCON_INIT_PRIORITY
	default INTC_INIT_PRIORITY
endif
```

## drivers/ipm/Kconfig.aspeed
```kconfig
# Copyright (c) 2023 ASPEED Technology Inc.
# SPDX-License-Identifier: Apache-2.0

config IPM_AST2600
	bool "ASPEED AST2600 IPM driver"
	default y
	depends on DT_HAS_ASPEED_AST2600_IPC_ENABLED
	help
	  This option enables the IPM driver for ASPEED AST2600 series SOC.

config IPM_AST2700
	bool "ASPEED AST2700 IPM driver"
	default y
	depends on DT_HAS_ASPEED_AST2700_IPC_ENABLED || DT_HAS_ASPEED_AST2700_IPC_V2_ENABLED
	help
	  This option enables the IPM driver for ASPEED AST2700 series SOC.

config IPM_BOOTMCU
	bool "ASPEED IPC driver"
	default y
	depends on SOC_AST2700_BOOTMCU
	help
	  This option enables the IPC driver for ASPEED SoCs.

config IPM_ASPEED_SHELL
	bool "ASPEED AST2700 IPM Shell"
	default y
	depends on SHELL && (DT_HAS_ASPEED_AST2700_IPC_ENABLED || DT_HAS_ASPEED_AST2700_IPC_V2_ENABLED)
	help
	  Enable IPM Shell for ASPEED MCU IPM Usage.
```

## drivers/ltpi/Kconfig
```kconfig
# LTPI configuration options
#
# Copyright (c) 2025 Aspeed Technology
#
# SPDX-License-Identifier: Apache-2.0

menuconfig LTPI
	bool "LVDS Tunneling Protocol & Interface (LTPI) drivers"
	help
	  Enable LTPI Driver Configuration

if LTPI

module = LTPI
module-str = ltpi
source "subsys/logging/Kconfig.template.log_config"

rsource "Kconfig.aspeed"

endif # LTPI
```

## drivers/ltpi/Kconfig.aspeed
```kconfig
# ASPEED LTPI driver configuration options

# Copyright (c) 2025 ASPEED Technology Inc.
# SPDX-License-Identifier: Apache-2.0

config LTPI_AST27XX
	bool "ASPEED AST27XX LTPI driver"
	default y
	depends on SOC_SERIES_AST27XX && DT_HAS_ASPEED_AST27XX_LTPI_ENABLED
	select RESET
	select CLOCK_CONTROL
	help
	  This option enables the LTPI driver for ASPEED AST27xx SOCs.

config LTPI_AST10X0_G2
	bool "ASPEED AST10X0-G2 LTPI driver"
	default y
	depends on SOC_FAMILY_ASPEED && DT_HAS_ASPEED_AST10X0_G2_LTPI_ENABLED
	select RESET
	select CLOCK_CONTROL
	help
	  This option enables the LTPI driver for ASPEED AST10X0-G2 SOCs
	  (e.g. AST1040) operating in the HPM role.
```
