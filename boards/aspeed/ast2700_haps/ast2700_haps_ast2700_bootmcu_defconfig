## drivers/misc/aspeed/Kconfig
```kconfig
# ASPEED misc. driver options

# Copyright (c) 2021 ASPEED
# SPDX-License-Identifier: Apache-2.0

config SNOOP_ASPEED
	bool "ASPEED LPC SNOOP driver"
	depends on SOC_FAMILY_ASPEED
	help
	  This option enables the snoop driver for ASPEED
	  SoCs.
	  Say y if you wish to use LPC data byte snooping
	  on ASPEED MCU.

config MAILBOX_ASPEED
	bool "ASPEED LPC Mailbox driver"
	depends on SOC_FAMILY_ASPEED
	help
	  This option enables the mailbox driver for ASPEED
	  SoCs.
	  Say y if you wish to use LPC mailbox on ASPEED MCU.

config PFR_SHELL_ASPEED
	bool "Enable ASPEED PFR shell"
	help
	  Enable PFR related control shell environment.

config PFR_FLOW_CTRL_AST1060
	bool "Enable ASPEED PFR Control Flow"
	help
	  This option enables the PFR related flow control,
	  including host reset and flash reset.

config ABR_FLOW_CTRL_ASPEED
	bool "Enable ASPEED ABR Control Flow"
	help
	  This option enables the ABR related flow control,
	  including disable FMC_WDT2 and reset ABR indicator.

config PCC_ASPEED
	bool "ASPEED LPC PCC driver"
	depends on SOC_FAMILY_ASPEED
	help
	  This option enables the PCC driver for ASPEED SoCs.
	  Note that PCC is not suitable for use with snooping
	  over eSPI.
	  Say y if you wish to use LPC PCC on ASPEED MCU.

config UART_ROUTING_ASPEED
	bool "ASPEED UART routing driver"
	depends on SOC_FAMILY_ASPEED
	help
	  This option enables UART routing driver for ASPEED SoCs.

config OTP_ASPEED
	bool "ASPEED OTP Utility"
	depends on SOC_FAMILY_ASPEED
	help
	  This option enables the OTP Utility for ASPEED SoCs.

config OTP_ASPEED_DRV_NAME
	string "Device name for ASPEED OTP device"
	default "OTP_ASPEED"
	depends on OTP_ASPEED
	help
	  Device name for ASPEED OTP device.

config SHELL_CMDS_OTP
	bool "Enable OTP shell commands"
	depends on OTP_ASPEED
	help
	  This option enables the OTP shell commands.

config OTP_AST27XX
	bool "ASPEED AST27XX OTP"
	depends on SOC_FAMILY_ASPEED
	help
	  This option enables the OTP Utility for ASPEED AST27XX SoCs Series.

config CPTRA_UPDATE
	bool "ASPEED CPTRA Update driver"
	depends on SOC_AST2700_BOOTMCU || SOC_AST2705_BOOTMCU
	help
	  This option enables the Caliptra update driver for ASPEED SoCs.

config CPTRA_IFC
	bool "ASPEED CPTRA IFC driver"
	depends on SOC_AST2700_BOOTMCU || SOC_AST2705_BOOTMCU
	help
	  This option enables the Caliptra ifc driver for ASPEED SoCs.

config CPTRA_MBOX
	bool "ASPEED CPTRA MBOX driver"
	depends on SOC_AST2700_BOOTMCU || SOC_AST2705_BOOTMCU
	help
	  This option enables the Caliptra mbox driver for ASPEED SoCs.

config CPTRA_DICE
	bool "ASPEED CPTRA DICE driver"
	depends on SOC_AST2700_BOOTMCU || SOC_AST2705_BOOTMCU
	help
	  This option enables the Caliptra dice driver for ASPEED SoCs.

config CPTRA_MISC
	bool "ASPEED CPTRA MISC driver"
	depends on SOC_AST2700_BOOTMCU || SOC_AST2705_BOOTMCU
	help
	  This option enables the Caliptra misc driver for ASPEED SoCs.

config CPTRA_IPC
	bool "ASPEED CPTRA IPC driver"
	depends on SOC_AST2700_BOOTMCU || SOC_AST2705_BOOTMCU
	help
	  This option enables the Caliptra ipc driver for ASPEED SoCs.

config LTPI_IPC
	bool "ASPEED LTPI IPC driver"
	depends on SOC_AST2700_BOOTMCU || SOC_AST2705_BOOTMCU
	help
	  This option enables the ltpi read / write ipc driver for ASPEED SoCs.

config CPTRA_IPC_SSP
	bool "ASPEED CPTRA IPC driver in SSP"
	depends on SOC_AST2700_SSP || SOC_AST2700_A1_SSP || SOC_AST2705_SSP
	help
	  This option enables the Caliptra ipc driver in SSP for ASPEED SoCs.

config CPTRA_MCI_MBOX
	bool "ASPEED CPTRA MCI mailbox driver"
	depends on SOC_SERIES_AST10x0_G2_CM4
	help
	  This option enables the Caliptra-SS MCI (Manageability Controller
	  Interface) mailbox driver for ASPEED SoCs.

config CPTRA_MCI_MISC
	bool "ASPEED CPTRA MCI mailbox commands"
	depends on CPTRA_MCI_MBOX
	help
	  This option enables the Caliptra-SS MCI mailbox command helpers
	  (firmware version, ...) for ASPEED SoCs.

config CPTRA_MCI_CRYPTOGRAPHIC_MBOX
	bool "ASPEED CPTRA MCI cryptographic mailbox (CM_*) commands"
	depends on CPTRA_MCI_MBOX
	help
	  This option enables the Caliptra-SS MCI cryptographic mailbox (CM_*)
	  commands operating on opaque Cmk key handles: MC_IMPORT, MC_CM_STATUS,
	  MC_RANDOM_STIR/MC_RANDOM_GENERATE, MC_ECDH_GENERATE/MC_ECDH_FINISH,
	  CMK-based ECDSA and ML-DSA-87 (sign/verify/public key), MC_HMAC,
	  MC_HMAC_KDF_COUNTER, MC_HKDF_EXTRACT/MC_HKDF_EXPAND, and AES/AES-GCM
	  encrypt/decrypt, for ASPEED SoCs.

config CPTRA_MCI_SHELL
	bool "ASPEED CPTRA MCI mailbox shell commands"
	depends on CPTRA_MCI_MISC
	depends on CPTRA_MCI_SHA
	depends on CPTRA_MCI_ECDSA
	depends on CPTRA_MCI_LMS
	depends on CPTRA_MCI_MLDSA
	depends on CPTRA_MCI_CRYPTOGRAPHIC_MBOX
	depends on SHELL
	help
	  This option enables shell commands to exercise the Caliptra-SS MCI
	  mailbox commands (firmware version, SHA, cryptographic mailbox, ...)
	  for testing.

config PRIVILEGE_CTRL
	bool "Enable ASPEED privilege control"
	default y
	depends on SOC_SERIES_AST27XX && DT_HAS_ASPEED_PRICTRL_ENABLED
	help
	  This option enables privilege control for aspeed
	  board isolation.

config EDAF_BRIDGE_ASPEED
	bool "Enable ASPEED eDAF bridge controller"
	default y
	depends on SOC_AST2700_BOOTMCU || SOC_AST2705_BOOTMCU
	help
	  This option enables the eDAF bridge controller
	  for ASPEED SoCs.

config ATC_ASPEED
	bool "ASPEED Anti-Tamper Controller (ATC) driver"
	depends on SOC_FAMILY_ASPEED
	help
	  This option enables the Anti-Tamper Controller driver for
	  ASPEED SoCs, including clock attack monitor, glitch detection,
	  IR drop detection and temperature sensor (TSENSE) tamper events.

module = MISC_ASPEED
module-str = misc-aspeed
source "subsys/logging/Kconfig.template.log_config"
```

## drivers/pinctrl/Kconfig.aspeed
```kconfig
# Copyright (c) 2023 ASPEED Technology Inc.
# SPDX-License-Identifier: Apache-2.0

config PINCTRL_ASPEED
	bool "Pin controller driver for Aspeed SOCs"
	default y
	depends on DT_HAS_ASPEED_PINCTRL_ENABLED
	depends on SYSCON
	help
	  Enable pin controller driver for Aspeed SOCs

config PINCTRL_ASPEED_G7
	bool "Pin controller driver for Aspeed G7 SOCs"
	default y
	depends on DT_HAS_ASPEED_G7_SOC1_PINCTRL_ENABLED
	depends on SYSCON
	help
	  Enable pin controller driver for Aspeed SOCs

config PINCTRL_ASPEED_G7_CONFLICT_CHECK
	bool "Check for Aspeed G7 pin conflicts"
	depends on PINCTRL_ASPEED_G7
	default y if SOC_SERIES_AST10x0_G2
	help
	  Track the signal assigned to each ball and reject conflicting pin
	  configurations. Leave disabled to save the RAM used by the ball
	  ownership table. When disabled, later configurations can overwrite
	  an earlier pinmux selection for the same ball.

config PINCTRL_ASPEED_STRING_NAME
	bool "Store the pin name in a string"
	default y if SOC_SERIES_AST10x0_G2
	default n
	depends on PINCTRL_ASPEED || PINCTRL_ASPEED_G7
	help
	  Enable storing the pin name for debugging
```

## drivers/sdhc/Kconfig.aspeed_sdhci
```kconfig
# Copyright (c) 2023 Intel Corporation
# SPDX-License-Identifier: Apache-2.0

config ASPEED_SDHCI
	bool "ASPEED SDHCI"
	default y
	select SDHC_SUPPORTS_NATIVE_MODE
	help
		Enable Aspeed SDHCI Host Controller.
```

## drivers/spi/Kconfig.spi_monitor_aspeed
```kconfig
# ASPEED SPI Monitor

# Copyright (c) 2021 ASPEED Technology Inc. <chin-ting_kuo@aspeedtech.com>
# SPDX-License-Identifier: Apache-2.0

config SPI_MONITOR_ASPEED
	bool "ASPEED SPI Monitor Driver"
	help
	  Enable ASPEED SPI monitor controller driver.

config SPI_MONITOR_SHELL_ASPEED
	bool "ASPEED SPI Monitor SHELL"
	depends on SPI_MONITOR_ASPEED && SHELL
	help
	  Enable ASPEED SPI monitor shell commands.

config ASPEED_SPIM_LOG_SIZE
	int "ASPEED SPI Monitor RAM log buffer size"
	depends on SPI_MONITOR_ASPEED
	default 2048
	help
	  Size in bytes of the non-cached RAM buffer used to record SPIM blocked
	  transaction logs (AST1060 RAM-based log). Set to 0 for SoCs that use
	  FIFO-based logging (e.g. AST2700) to eliminate the buffer entirely.
```

## drivers/usb/udc/Kconfig.aspeed
```kconfig
# Copyright (c) 2026 Aspeed Technology Inc.
# SPDX-License-Identifier: Apache-2.0

config UDC_ASPEED
	bool "ASPEED USB device controller driver"
	default y
	depends on DT_HAS_ASPEED_UDC_ENABLED
	select CLOCK_CONTROL
	select PINCTRL
	select RESET
	help
	  ASPEED USB device controller driver for the new USB device stack.

if UDC_ASPEED

config UDC_ASPEED_EVENT_COUNT
	int "ASPEED UDC internal event count"
	range 4 64
	default 16
	help
	  Number of ISR bottom-half events queued by the ASPEED UDC driver.

endif # UDC_ASPEED
```

## drivers/watchdog/Kconfig.aspeed_g7
```kconfig
# ASPEED WDT controller driver

# Copyright (c) 2025 ASPEED Technology Inc. <chin-ting_kuo@aspeedtech.com>
# SPDX-License-Identifier: Apache-2.0

config WDT_ASPEED_G7
	bool "ASPEED WDT G7 Driver"
	default DT_HAS_ASPEED_AST_WATCHDOG_G7_ENABLED
	help
	  Enable ASPEED WDT G7 controller driver.
	  In ASPEED WDT G7, each watchdog controller
	  has its own interrupt number.
```

## dts/bindings/clock/aspeed,ast10x0-g2-clock.yaml
```yaml
# Copyright (c) 2026 Aspeed Technology Inc.
# SPDX-License-Identifier: Apache-2.0

description: Aspeed AST10x0 G2 Clock Controller

compatible: "aspeed,ast10x0-g2-clock"

include: [clock-controller.yaml, base.yaml]

properties:
  "#clock-cells":
    const: 1
  psp:
    type: array
    required: false
    description: |
      Program clock access permission for PSP
  sec-psp:
    type: array
    required: false
    description: |
      Program clock access permission for secure PSP
  ssp:
    type: array
    required: false
    description: |
      Program clock access permission for SSP
  tsp:
    type: array
    required: false
    description: |
      Program clock access permission for TSP
  psp-ssp:
    type: array
    required: false
    description: |
      Program clock access permission for PSP and SSP
  ssp-tsp:
    type: array
    required: false
    description: |
      Program clock access permission for PSP and TSP
  bmcu:
    type: array
    required: false
    description: |
      Program clock access permission for bootmcu

clock-cells:
  - clk_id
```

## dts/bindings/clock/aspeed,ast27xx-scu1-clock.yaml
```yaml
# Copyright (c) 2023 Aspeed Technology Inc.
# SPDX-License-Identifier: Apache-2.0

description: Aspeed AST27XX Clock Controller

compatible: "aspeed,ast27xx-scu1-clock"

include: [clock-controller.yaml, base.yaml]

properties:
  "#clock-cells":
    const: 1
  psp:
    type: array
    required: false
    description: |
      Program clock access permission for PSP
  sec-psp:
    type: array
    required: false
    description: |
      Program clock access permission for secure PSP
  ssp:
    type: array
    required: false
    description: |
      Program clock access permission for SSP
  tsp:
    type: array
    required: false
    description: |
      Program clock access permission for TSP
  psp-ssp:
    type: array
    required: false
    description: |
      Program clock access permission for PSP and SSP
  ssp-tsp:
    type: array
    required: false
    description: |
      Program clock access permission for PSP and TSP
  bmcu:
    type: array
    required: false
    description: |
      Program clock access permission for bootmcu

clock-cells:
  - clk_id
```

## dts/bindings/crypto/aspeed,cptra-ecdsa.yaml
```yaml
#
# Copyright (c) ASPEED
#
# SPDX-License-Identifier: Apache-2.0
#

description: ASPEED CPTRA ECDSA Engine

compatible: "aspeed,cptra-ecdsa"

include: base.yaml

properties:
    reg:
      required: true

    aspeed,scu:
      type: phandle
      required: true
      description: phandle to SCU device tree node
```
