/*
 * Copyright (c) 2023 Aspeed Technology Inc.
 *
 * SPDX-License-Identifier: Apache-2.0
 */

/dts-v1/;
#include <aspeed/ast27x0.dtsi>

/ {
	model = "Aspeed AST2700 FPGA board";
	compatible = "aspeed,ast2700-evb";

	chosen {
		zephyr,console = &uart5;
		zephyr,shell-uart = &uart5;
		zephyr,sram = &sram0;
	};
};

&sram0 {
	reg = <0 DT_SIZE_K(768)>, <0xc0000 DT_SIZE_K(256)>;
};

&uart5 {
	clock-frequency = <1846153>;
	current-speed = <115200>;
	status = "okay";
};
