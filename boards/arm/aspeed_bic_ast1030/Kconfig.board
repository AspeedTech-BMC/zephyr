## boards/arm/aspeed_bic_ast1030/Kconfig.board
```kconfig
# SPDX-License-Identifier: Apache-2.0
#
# Aspeed BIC AST1030 board configuration
#
# Copyright (c) 2021 ASPEED Technology Inc.

config BOARD_ASPEED_BIC_AST1030
	bool "ASPEED BIC AST1030 Evaluation Board"
	depends on SOC_AST1030
```

## boards/arm/aspeed_bic_ast1030/Kconfig.defconfig
```kconfig
# SPDX-License-Identifier: Apache-2.0
#
# Aspeed BIC AST1030 board configuration
#
# Copyright (c) 2021 ASPEED Technology Inc.

if BOARD_ASPEED_BIC_AST1030

config BOARD
	default "aspeed_bic_ast1030"

if USB

config USB_ASPEED
	default y

config USB_DEVICE_STACK
	default y

config USB_DEVICE_MANUFACTURER
	default "Aspeed"

endif # USB

endif # BOARD_ASPEED_BIC_AST1030
```

## boards/arm/aspeed_bic_ast1030/aspeed_bic_ast1030_defconfig
```kconfig
CONFIG_I2C=y
CONFIG_SYS_CLOCK_HW_CYCLES_PER_SEC=200000000
CONFIG_GPIO=y
CONFIG_CLOCK_CONTROL=y
CONFIG_FLASH_SIZE=0
CONFIG_FLASH_BASE_ADDRESS=0x0
CONFIG_SOC_SERIES_AST10X0=y
CONFIG_MAIN_STACK_SIZE=4096
CONFIG_NUM_PREEMPT_PRIORITIES=56
# CONFIG_BOOT_BANNER is not set
CONFIG_THREAD_RUNTIME_STATS=y
# CONFIG_XIP is not set
CONFIG_CONSOLE=y
CONFIG_UART_CONSOLE=y
CONFIG_UART_ASPEED=y
CONFIG_GPIO_SHELL=y
CONFIG_GPIO_ASPEED=y
CONFIG_I2C_SLAVE=y
CONFIG_I2C_EEPROM_SLAVE=y
CONFIG_I2C_ASPEED=y
CONFIG_PWM=y
CONFIG_PWM_ASPEED=y
CONFIG_PINMUX=y
CONFIG_PINMUX_ASPEED=y
CONFIG_ADC=y
CONFIG_ADC_ASPEED=y
CONFIG_CLOCK_CONTROL_ASPEED=y
CONFIG_RESET_CONTROL=y
CONFIG_RESET_CONTROL_ASPEED=y
CONFIG_SENSOR=y
CONFIG_TACH_ASPEED=y
CONFIG_HWINFO=y
CONFIG_ESPI=y
CONFIG_ESPI_ASPEED=y
CONFIG_PECI=y
CONFIG_PECI_ASPEED=y
CONFIG_PECI_ASPEED_INTERRUPT_DRIVEN=y
CONFIG_MINIMAL_LIBC_MALLOC_ARENA_SIZE=16384
CONFIG_CMSIS_RTOS_V2=y
CONFIG_POSIX_CLOCK=y
CONFIG_EARLY_CONSOLE=y
CONFIG_LOG=y
CONFIG_SHELL=y
CONFIG_UART_SHELL_ON_DEV_NAME="UART_4"
CONFIG_USB=y
```

## boards/arm/ast1030_evb/Kconfig.board
```kconfig
# SPDX-License-Identifier: Apache-2.0
#
# Aspeed BIC AST1030 board configuration
#
# Copyright (c) 2021 ASPEED Technology Inc.

config BOARD_AST1030_EVB
	bool "ASPEED AST1030 Evaluation Board"
	depends on SOC_AST1030
```

## boards/arm/ast1030_evb/Kconfig.defconfig
```kconfig
# SPDX-License-Identifier: Apache-2.0
#
# Aspeed BIC AST1030 board configuration
#
# Copyright (c) 2021 ASPEED Technology Inc.

if BOARD_AST1030_EVB

config BOARD
	default "ast1030_evb"

choice SOC_AST10X0_SELECTION
default SOC_AST1030
endchoice

if USB

config USB_ASPEED
	default y

config USB_DEVICE_STACK
	default y

config USB_DEVICE_MANUFACTURER
	default "Aspeed"

endif # USB

endif # BOARD_AST1030_EVB
```

## boards/arm/ast1030_evb/ast1030_evb_defconfig
```kconfig
# SPDX-License-Identifier: Apache-2.0
#
# Copyright (c) 2021 Aspeed Technology Inc.
#
CONFIG_SOC_SERIES_AST10X0=y
CONFIG_SYS_CLOCK_HW_CYCLES_PER_SEC=200000000
CONFIG_MAIN_STACK_SIZE=4096
CONFIG_BOOTLOADER_SRAM_SIZE=0
CONFIG_FLASH_SIZE=0
CONFIG_FLASH_BASE_ADDRESS=0x0
CONFIG_XIP=n
CONFIG_CONSOLE=y
CONFIG_UART_CONSOLE=y
CONFIG_SERIAL=y
CONFIG_HEAP_MEM_POOL_SIZE=50000
CONFIG_CLOCK_CONTROL=y
CONFIG_RESET=y
CONFIG_PINCTRL=y
CONFIG_CRYPTO=y
CONFIG_CRYPTO_ASPEED=y
CONFIG_CRYPTO_ASPEED_HASH_DRV_NAME="HASH_ASPEED"
CONFIG_CRYPTO_ASPEED_DRV_NAME="CRYPTO_ASPEED"
CONFIG_GPIO=y
CONFIG_GPIO_SHELL=y
CONFIG_GPIO_ASPEED=y
CONFIG_RSA_ASPEED=y
CONFIG_ECDSA_ASPEED=y
CONFIG_MBEDTLS=y
CONFIG_MBEDTLS_KEY_EXCHANGE_DHE_RSA_ENABLED=y
CONFIG_MBEDTLS_KEY_EXCHANGE_ECDH_ECDSA_ENABLED=y
CONFIG_MBEDTLS_ECDH_C=y
CONFIG_MBEDTLS_ECDSA_C=y
CONFIG_MBEDTLS_ECP_C=y
CONFIG_MBEDTLS_ECP_DP_SECP384R1_ENABLED=y
CONFIG_COMMON_LIBC_MALLOC_ARENA_SIZE=8192
CONFIG_SHELL_STACK_SIZE=4096
```

## boards/arm/ast1060_evb/ast1060_evb_defconfig
```kconfig
CONFIG_SOC_SERIES_AST10X0=y
CONFIG_SYS_CLOCK_HW_CYCLES_PER_SEC=200000000
CONFIG_SOC_AST1060=y
CONFIG_CACHE_ASPEED=y
CONFIG_MAIN_STACK_SIZE=4096
CONFIG_FLASH_SIZE=0
CONFIG_FLASH_BASE_ADDRESS=0x0
CONFIG_XIP=n
CONFIG_HWINFO=y
CONFIG_CONSOLE=y
CONFIG_UART_CONSOLE=y
CONFIG_SERIAL=y
CONFIG_UART_NS16550=y
CONFIG_HEAP_MEM_POOL_SIZE=50000
CONFIG_CLOCK_CONTROL=y
CONFIG_RESET=y
CONFIG_PINCTRL=y
# For CMSIS
CONFIG_POLL=y
CONFIG_GPIO=y
CONFIG_GPIO_SHELL=y
CONFIG_GPIO_ASPEED=y
CONFIG_THREAD_NAME=y
CONFIG_THREAD_STACK_INFO=y
CONFIG_THREAD_MONITOR=y
CONFIG_INIT_STACKS=y
CONFIG_NUM_PREEMPT_PRIORITIES=56
CONFIG_CMSIS_RTOS_V2=y
CONFIG_COMMON_LIBC_MALLOC_ARENA_SIZE=8192
CONFIG_SHELL_STACK_SIZE=4096
# For CMSIS
CONFIG_POLL=y
CONFIG_THREAD_NAME=y
CONFIG_THREAD_STACK_INFO=y
CONFIG_THREAD_MONITOR=y
CONFIG_INIT_STACKS=y
CONFIG_NUM_PREEMPT_PRIORITIES=56
CONFIG_CMSIS_RTOS_V2=y
CONFIG_CMSIS_V2_EVT_FLAGS_MAX_COUNT=64
CONFIG_CRYPTO=y
CONFIG_CRYPTO_ASPEED=y
CONFIG_CRYPTO_ASPEED_HASH_DRV_NAME="HASH_ASPEED"
CONFIG_CRYPTO_ASPEED_DRV_NAME="CRYPTO_ASPEED"
CONFIG_RSA_ASPEED=y
CONFIG_ECDSA_ASPEED=y
CONFIG_OTP_ASPEED=y
```

## boards/arm/ast2600_evb/Kconfig.board
```kconfig
# SPDX-License-Identifier: Apache-2.0
#
# Aspeed BMC AST2600 SSP board configuration
#
# Copyright (c) 2021 ASPEED Technology Inc.

config BOARD_AST2600_SSP_EVB
	bool "ASPEED AST2600 SSP Evaluation Board"
	depends on SOC_AST2600
```

## boards/arm/ast2600_evb/ast2600_evb_defconfig
```kconfig
CONFIG_SYS_CLOCK_HW_CYCLES_PER_SEC=200000000
CONFIG_CLOCK_CONTROL=y
CONFIG_FLASH_SIZE=0
CONFIG_FLASH_BASE_ADDRESS=0x0
CONFIG_SOC_SERIES_AST26XX=y
CONFIG_MAIN_STACK_SIZE=4096
CONFIG_NUM_PREEMPT_PRIORITIES=56
# CONFIG_BOOT_BANNER is not set
CONFIG_THREAD_RUNTIME_STATS=y
# CONFIG_XIP is not set
CONFIG_CONSOLE=y
CONFIG_UART_CONSOLE=y
CONFIG_UART_ASPEED=y
CONFIG_PINMUX=y
CONFIG_PINMUX_ASPEED=y
CONFIG_CLOCK_CONTROL_ASPEED=y
CONFIG_RESET_CONTROL=y
CONFIG_RESET_CONTROL_ASPEED=y
CONFIG_HWINFO=y
CONFIG_MINIMAL_LIBC_MALLOC_ARENA_SIZE=16384
CONFIG_CMSIS_RTOS_V2=y
CONFIG_POSIX_CLOCK=y
CONFIG_STACK_SENTINEL=y
CONFIG_EARLY_CONSOLE=y
CONFIG_LOG=y
CONFIG_LOG_BACKEND_UART=y
CONFIG_SHELL=y
CONFIG_UART_SHELL_ON_DEV_NAME="UART_10"
CONFIG_REBOOT=y
```

## boards/arm/ast2600_evb/ast2600_ssp_evb_defconfig
```kconfig
CONFIG_SOC_AST2600=y
CONFIG_HWINFO=y
CONFIG_CLOCK_CONTROL=y
CONFIG_FLASH_SIZE=0
CONFIG_FLASH_BASE_ADDRESS=0x0
CONFIG_SOC_SERIES_AST26XX=y
CONFIG_MAIN_STACK_SIZE=4096
CONFIG_NUM_PREEMPT_PRIORITIES=56
CONFIG_SERIAL=y
CONFIG_CONSOLE=y
CONFIG_UART_CONSOLE=y
CONFIG_CLOCK_CONTROL_AST26XX=y
CONFIG_STACK_SENTINEL=y
CONFIG_EARLY_CONSOLE=y
CONFIG_REBOOT=y
CONFIG_ASSERT=y
# For CMSIS
CONFIG_POLL=y
CONFIG_THREAD_NAME=y
CONFIG_THREAD_STACK_INFO=y
CONFIG_THREAD_MONITOR=y
CONFIG_INIT_STACKS=y
CONFIG_NUM_PREEMPT_PRIORITIES=56
CONFIG_CMSIS_RTOS_V2=y
CONFIG_PINCTRL=y
CONFIG_RESET=y
```

## boards/arm/ast2700_evb/Kconfig.board
```kconfig
# SPDX-License-Identifier: Apache-2.0
#
# Aspeed AST2700 Evaluation board configuration
#
# Copyright (c) 2023 Aspeed Technology Inc.

config BOARD_AST2700_SSP_EVB
	bool "ASPEED AST2700 SSP Evaluation Board"
	depends on SOC_AST2700

config BOARD_AST2700_TSP_EVB
	bool "ASPEED AST2700 TSP Evaluation Board"
	depends on SOC_AST2700
```

## boards/arm/ast2700_evb/Kconfig.defconfig
```kconfig
# SPDX-License-Identifier: Apache-2.0
#
# Aspeed AST2700 Evaluation board configuration
#
# Copyright (c) 2023 Aspeed Technology Inc.

if BOARD_AST2700_SSP_EVB
config BOARD
	default "ast2700_ssp_evb"
endif # BOARD_AST2700_SSP_EVB

if BOARD_AST2700_TSP_EVB
config BOARD
	default "ast2700_tsp_evb"
endif # BOARD_AST2700_TSP_EVB
```

## boards/arm/ast2700_fpga/Kconfig.board
```kconfig
# SPDX-License-Identifier: Apache-2.0
#
# Aspeed AST2700 FPGA board configuration
#
# Copyright (c) 2023 Aspeed Technology Inc.

config BOARD_AST2700_SSP_FPGA
	bool "ASPEED AST2700 SSP FPGA Board"
	depends on SOC_AST2700

config BOARD_AST2700_TSP_FPGA
	bool "ASPEED AST2700 TSP FPGA Board"
	depends on SOC_AST2700
```

## boards/arm/ast2700_fpga/Kconfig.defconfig
```kconfig
# SPDX-License-Identifier: Apache-2.0
#
# Aspeed AST2700 FPGA board configuration
#
# Copyright (c) 2023 Aspeed Technology Inc.

if BOARD_AST2700_SSP_FPGA
config BOARD
	default "ast2700_ssp_fpga"
endif # BOARD_AST2700_SSP_FPGA

if BOARD_AST2700_TSP_FPGA
config BOARD
	default "ast2700_tsp_fpga"
endif # BOARD_AST2700_TSP_FPGA
```

## boards/arm/ast2700_fpga/ast2700_ssp_fpga_defconfig
```kconfig
# SPDX-License-Identifier: Apache-2.0
#
# Copyright (c) 2023 Aspeed Technology Inc.
#
CONFIG_SOC_SERIES_AST27X0=y
CONFIG_SYS_CLOCK_HW_CYCLES_PER_SEC=24000000
CONFIG_MAIN_STACK_SIZE=4096
CONFIG_BOOTLOADER_SRAM_SIZE=0
CONFIG_FLASH_SIZE=0
CONFIG_FLASH_BASE_ADDRESS=0x0
CONFIG_CONSOLE=y
CONFIG_UART_CONSOLE=y
CONFIG_SERIAL=y
CONFIG_RESET=y
CONFIG_CLOCK_CONTROL=y
CONFIG_HEAP_MEM_POOL_SIZE=50000
# Use polling mode for ns16550 driver.  Enable interrupt mode when aspeed driver is ready
CONFIG_SHELL_BACKEND_SERIAL_INTERRUPT_DRIVEN=n
CONFIG_IPM=y
CONFIG_BOARD_AST2700_SSP_FPGA=y
CONFIG_SHELL_PROMPT_UART="ssp:~$ "
```

## drivers/espi/Kconfig.aspeed
```kconfig
# ASPEED eSPI driver configuration options

# Copyright (c) 2021 ASPEED Technology Inc.
# SPDX-License-Identifier: Apache-2.0

config ESPI_ASPEED
	bool "ASPEED eSPI slave driver"
	depends on SOC_FAMILY_ASPEED
	help
	  This option enables the eSPI slave driver for ASPEED
	  SoCs.
	  Say y if you wish to use eSPI channels on AST10x0 and AST2600.

config ESPI_ASPEED_V2
	bool "ASPEED eSPI slave driver v2"
	depends on SOC_FAMILY_ASPEED
	help
	  This option enables the eSPI slave driver for ASPEED
	  SoCs.
	  Say y if you wish to use eSPI channels on AST27xx.
```

## drivers/i2c/pfr/Kconfig.swmbx
```kconfig
# Software Mailbox configuration options

# Copyright (c) 2022 Aspeed Technology Inc.
# SPDX-License-Identifier: Apache-2.0

config PFR_SW_MAILBOX
	bool "PFR Software Mail Box driver"
	default n
	help
	  Enable PFR SW Mail Box driver
```

## drivers/i2c/slave/Kconfig.ipmb
```kconfig
# I2C IPMB Slave configuration options

# Copyright (c) 2017 BayLibre, SAS
# SPDX-License-Identifier: Apache-2.0

config I2C_IPMB_SLAVE
	bool "I2C Slave IPMB driver"
	help
	  Enable virtual I2C Slave IPMB driver
```

## drivers/i2c/slave/Kconfig.swmbx
```kconfig
# I2C SW Mailbox Slave configuration options

# Copyright (c) 2022 Aspeed Technology Inc.
# SPDX-License-Identifier: Apache-2.0

config I2C_SWMBX_SLAVE
	bool "I2C Slave SW Mailbox driver"
	default n
	help
	  Enable virtual I2C Slave SW Mailbox driver
```

## drivers/i2c/target/Kconfig.ipmb
```kconfig
# I2C IPMB Slave configuration options

# Copyright (c) 2021 Aspeed Technology Inc.
# SPDX-License-Identifier: Apache-2.0

config I2C_IPMB_TARGET
	bool "I2C Target IPMB driver"
	default n
	help
	  Enable virtual I2C Target IPMB driver
```

## drivers/i2c/target/Kconfig.swmbx
```kconfig
# I2C SW Mailbox Slave configuration options

# Copyright (c) 2022 Aspeed Technology Inc.
# SPDX-License-Identifier: Apache-2.0

config I2C_SWMBX_SLAVE
	bool "I2C Slave SW Mailbox driver"
	default y
	depends on I2C_TARGET
	depends on PFR_SW_MAILBOX
	help
	  Enable virtual I2C Slave SW Mailbox driver
```

## drivers/i3c/Kconfig
```kconfig
# I3C configuration options

# Copyright (c) 2021 ASPEED Technology Inc.
# SPDX-License-Identifier: Apache-2.0

menuconfig I3C
	bool "I3C Drivers"
	help
	  Enable I3C Driver.

if I3C
module = I3C
module-str = I3C
source "subsys/logging/Kconfig.template.log_config"

source "drivers/i3c/Kconfig.aspeed"

endif # I3C
```

## drivers/i3c/Kconfig.aspeed
```kconfig
# ASPEED I3C driver configuration options

# Copyright (c) 2021 ASPEED Technology Inc.
# SPDX-License-Identifier: Apache-2.0
module = I3C_ASPEED
module-str = i3c-aspeed
source "subsys/logging/Kconfig.template.log_config"

config I3C_ASPEED
	bool "ASPEED I3C driver"
	default y
	depends on SOC_SERIES_AST10X0 && DT_HAS_ASPEED_I3C_ENABLED
	help
	  This option enables the I3C master driver for ASPEED SoCs.
```

## drivers/i3c/target/Kconfig
```kconfig
# I3C Target configuration options

# Copyright (c) 2023 ASPEED Technology Inc.
# SPDX-License-Identifier: Apache-2.0

#
# I3C target options
#
menuconfig I3C_TARGET
	bool "I3C Target Drivers"
	help
	  Enable I3C Target Driver Configuration

if I3C_TARGET

config I3C_TARGET_INIT_PRIORITY
	int "Init priority"
	default 60
	help
	  I3C TARGET device driver initialization priority.

	source "drivers/i3c/target/Kconfig.i3c_target_mqueue"

endif # I3C_TARGET
```

## drivers/i3c/target/Kconfig.i3c_target_mqueue
```kconfig
# I3C Target mqueue configuration options

# Copyright (c) 2023 Aspeed Technology Inc.
# SPDX-License-Identifier: Apache-2.0

config I3C_TARGET_MQUEUE
	bool "I3C Target MQueue driver"
	default y
	help
	  Enable I3C target mqueue driver
```
