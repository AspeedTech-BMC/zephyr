## CMakeLists.txt
```
# Copyright (c) 2026 ASPEED Technology Inc.
# SPDX-License-Identifier: MIT

cmake_minimum_required(VERSION 3.13.1)

find_package(Zephyr REQUIRED HINTS $ENV{ZEPHYR_BASE})
project(espi_aspeed_v2_shell LANGUAGES C)

add_subdirectory(src)
```

## sample.yaml
```
sample:
  name: Aspeed eSPI v2 shell sample
tests:
  sample.board.ast1040_evb_ast1040_cm4:
    platform_allow: ast1040_evb/ast1040/cm4
```

## prj.conf
```kconfig
CONFIG_LOG=y
CONFIG_LOG_MODE_IMMEDIATE=y
CONFIG_LOG_DEFAULT_LEVEL=3
CONFIG_SERIAL=y
CONFIG_CONSOLE=y
CONFIG_UART_CONSOLE=y
CONFIG_SHELL=y
CONFIG_SHELL_LOG_BACKEND=y
CONFIG_SHELL_BACKEND_SERIAL=y
CONFIG_SHELL_STACK_SIZE=8192
CONFIG_SHELL_ARGC_MAX=70
CONFIG_SHELL_BACKEND_SERIAL_INIT_PRIORITY=99
CONFIG_HEAP_MEM_POOL_SIZE=16384
CONFIG_REBOOT=y
CONFIG_ESPI=y
CONFIG_ESPI_FLASH_CHANNEL=y
CONFIG_ESPI_VWIRE_CHANNEL=y
CONFIG_ESPI_OOB_CHANNEL=y
CONFIG_ESPI_OOB_CHANNEL_RX_ASYNC=y
CONFIG_BOOT_BANNER=y
```

## boards/ast1040_evb_ast1040_cm4.conf
```kconfig
CONFIG_ESPI_ASPEED_V2=y
CONFIG_ESPI_TAF=y
```

## boards/ast1040_evb_ast1040_cm4.overlay
```dts
&espi0 {
	status = "okay";
	perif-mcyc-enable;
	perif-mcyc-src-addr = <0x0 0x98000000>;
	perif-mcyc-size = <0x0 0x10000>;
	flash-edaf-mode = <1>;
};
```

## src/main.c
```c
/*
 * Copyright (c) 2026 ASPEED Technology Inc.
 *
 * SPDX-License-Identifier: MIT
 */

#include <zephyr/kernel.h>
#include <zephyr/device.h>
#include <zephyr/shell/shell.h>
#include <zephyr/logging/log.h>
#include <zephyr/drivers/espi.h>
#include <zephyr/drivers/espi_aspeed.h>
#include <zephyr/sys/sys_io.h>

#ifdef CONFIG_ESPI_TAF
#include "safs_handler.h"
#endif

#ifdef CONFIG_ESPI_OOB_CHANNEL_RX_ASYNC
extern void oob_async_init(void);
#endif

LOG_MODULE_REGISTER(espi_shell, CONFIG_LOG_DEFAULT_LEVEL);

#define ESPI_GEN_CAP			0x014
#define ESPI_CH0_CAP			0x018
#define ESPI_CH1_CAP			0x01c
#define ESPI_CH2_CAP			0x020
#define ESPI_CH3_CAP			0x024
#define ESPI_CH3_CAP_2			0x028

#define ESPI_DEV_STS			0x030
#define ESPI_CH0_STS			0x104
#define ESPI_CH1_STS			0x204
#define ESPI_CH2_STS			0x304
#define ESPI_CH3_STS			0x404

const struct device *espi_dev = DEVICE_DT_GET(DT_NODELABEL(espi0));

static int cmd_espi_info(const struct shell *sh, size_t argc, char **argv)
{
	ARG_UNUSED(argc);
	ARG_UNUSED(argv);

	if (!espi_dev) {
		shell_error(sh, "eSPI device not found");
		return -ENODEV;
	}

	shell_print(sh, "eSPI device: %s", espi_dev->name);
	shell_print(sh, "eSPI device ready: %d", device_is_ready(espi_dev));

	return 0;
}

static void print_espi_status(const struct shell *sh, const char *label, uint16_t sts)
{
	shell_print(sh, "%s: 0x%04x", label, sts);
	shell_print(sh, "  [0]  PC_FREE       : %u", (sts >> 0)  & 1);
	shell_print(sh, "  [1]  NP_FREE       : %u", (sts >> 1)  & 1);
	shell_print(sh, "  [2]  VWIRE_FREE    : %u", (sts >> 2)  & 1);
	shell_print(sh, "  [3]  OOB_FREE      : %u", (sts >> 3)  & 1);
	shell_print(sh, "  [4]  PC_AVAIL      : %u", (sts >> 4)  & 1);
	shell_print(sh, "  [5]  NP_AVAIL      : %u", (sts >> 5)  & 1);
	shell_print(sh, "  [6]  VWIRE_AVAIL   : %u", (sts >> 6)  & 1);
	shell_print(sh, "  [7]  OOB_AVAIL     : %u", (sts >> 7)  & 1);
	shell_print(sh, "  [8]  FLASH_C_FREE  : %u", (sts >> 8)  & 1);
	shell_print(sh, "  [10] FLASH_NP_FREE : %u", (sts >> 10) & 1);
	shell_print(sh, "  [12] FLASH_C_AVAIL : %u", (sts >> 12) & 1);
	shell_print(sh, "  [14] FLASH_NP_AVAIL: %u", (sts >> 14) & 1);
}

static int cmd_espi_status(const struct shell *sh, size_t argc, char **argv)
{
	ARG_UNUSED(argc);
	ARG_UNUSED(argv);

	uintptr_t espi_base = DT_REG_ADDR(DT_NODELABEL(espi0));
	uint32_t val = sys_read32(espi_base + ESPI_DEV_STS);

	shell_print(sh, "ESPI030(ESPI_DEV_STS): 0x%08x", val);
	shell_print(sh, "");
	print_espi_status(sh, "Previous status [15:0] ", (uint16_t)(val & 0xffff));
	shell_print(sh, "");
	print_espi_status(sh, "Current  status [31:16]", (uint16_t)(val >> 16));

	return 0;
}

static int cmd_espi_ch_status(const struct shell *sh, size_t argc, char **argv)
{
	ARG_UNUSED(argc);
	ARG_UNUSED(argv);

	uintptr_t espi_base = DT_REG_ADDR(DT_NODELABEL(espi0));
	static const struct {
		const char *name;
		uint32_t offset;
	} channels[] = {
		{ "CH0 (Peripheral)", ESPI_CH0_STS },
		{ "CH1 (VW)",         ESPI_CH1_STS },
		{ "CH2 (OOB)",        ESPI_CH2_STS },
		{ "CH3 (Flash)",      ESPI_CH3_STS },
	};

	for (int i = 0; i < ARRAY_SIZE(channels); i++) {
		uint32_t val = sys_read32(espi_base + channels[i].offset);

		shell_print(sh, "%s (0x%03x): 0x%08x", channels[i].name, channels[i].offset, val);
	}

	return 0;
}

static int cmd_espi_ch_cap(const struct shell *sh, size_t argc, char **argv)
{
	ARG_UNUSED(argc);
	ARG_UNUSED(argv);

	uintptr_t base = DT_REG_ADDR(DT_NODELABEL(espi0));
	uint32_t v;

	/* General Capabilities (0x014) */
	v = sys_read32(base + ESPI_GEN_CAP);
	shell_print(sh, "GEN_CAP (0x014): 0x%08x", v);
	shell_print(sh, "  [2:0]  OP freq supported : %u (0=20M 1=25M 2=33M 3=50M 4=66M)", v & 0x7);
	shell_print(sh, "  [4:3]  OP freq selected  : %u", (v >> 3) & 0x3);
	shell_print(sh, "  [6:5]  IO mode supported : %u (0=x1 1=x1/x2 2=x1/x4 3=x1/x2/x4)",
		    (v >> 5) & 0x3);
	shell_print(sh, "  [8:7]  IO mode selected  : %u (0=x1 1=x2 2=x4)", (v >> 7) & 0x3);
	shell_print(sh, "  [9]    Alert mode        : %u (0=IO1 1=pin)", (v >> 9) & 0x1);
	shell_print(sh, "  [10]   Alert pin mode    : %u (0=OD 1=PP)", (v >> 10) & 0x1);
	shell_print(sh, "  [12]   CRC checking      : %u", (v >> 12) & 0x1);
	shell_print(sh, "  [20]   eSPI Reset        : %u", (v >> 20) & 0x1);
	shell_print(sh, "");

	/* CH0 Peripheral Channel Capabilities (0x018) */
	v = sys_read32(base + ESPI_CH0_CAP);
	shell_print(sh, "CH0_CAP (0x018): 0x%08x  [Peripheral]", v);
	shell_print(sh, "  [0]    CH supported      : %u", v & 0x1);
	shell_print(sh, "  [1]    CH enabled        : %u", (v >> 1) & 0x1);
	shell_print(sh, "  [2]    CH ready          : %u", (v >> 2) & 0x1);
	shell_print(sh, "  [11:8] Max payload (supp): %u (0=64 1=128 2=256)", (v >> 8) & 0xf);
	shell_print(sh, "  [15:12]Max payload (sel) : %u", (v >> 12) & 0xf);
	shell_print(sh, "  [19:16]Max rd req size   : %u", (v >> 16) & 0xf);
	shell_print(sh, "");

	/* CH1 Virtual Wire Channel Capabilities (0x01c) */
	v = sys_read32(base + ESPI_CH1_CAP);
	shell_print(sh, "CH1_CAP (0x01c): 0x%08x  [Virtual Wire]", v);
	shell_print(sh, "  [0]    CH supported      : %u", v & 0x1);
	shell_print(sh, "  [1]    CH enabled        : %u", (v >> 1) & 0x1);
	shell_print(sh, "  [2]    CH ready          : %u", (v >> 2) & 0x1);
	shell_print(sh, "  [13:8] Max VW cnt (supp) : %u", (v >> 8) & 0x3f);
	shell_print(sh, "  [21:16]Max VW cnt (sel)  : %u", (v >> 16) & 0x3f);
	shell_print(sh, "");

	/* CH2 OOB Channel Capabilities (0x020) */
	v = sys_read32(base + ESPI_CH2_CAP);
	shell_print(sh, "CH2_CAP (0x020): 0x%08x  [OOB]", v);
	shell_print(sh, "  [0]    CH supported      : %u", v & 0x1);
	shell_print(sh, "  [1]    CH enabled        : %u", (v >> 1) & 0x1);
	shell_print(sh, "  [2]    CH ready          : %u", (v >> 2) & 0x1);
	shell_print(sh, "  [11:8] Max payload (supp): %u (0=64 1=128 2=256)", (v >> 8) & 0xf);
	shell_print(sh, "  [15:12]Max payload (sel) : %u", (v >> 12) & 0xf);
	shell_print(sh, "");

	/* CH3 Flash Channel Capabilities (0x024) */
	v = sys_read32(base + ESPI_CH3_CAP);
	shell_print(sh, "CH3_CAP (0x024): 0x%08x  [Flash]", v);
	shell_print(sh, "  [0]    CH enable         : %u", (v >> 0) & 0x1);
	shell_print(sh, "  [1]    CH ready          : %u", (v >> 1) & 0x1);
	shell_print(sh, "  [4:2]  Erase size        : %u (1=4K 2=64K 3=4K+64K 4=128K 5=256K)",
		    (v >> 2) & 0x7);
	shell_print(sh, "  [7:5]  Max payload (supp): %u (1=64 2=128 3=256)", (v >> 5) & 0x7);
	shell_print(sh, "  [10:8] Max payload (sel) : %u (1=64 2=128 3=256)", (v >> 8) & 0x7);
	shell_print(sh, "  [11]   Flash share mode  : %u (0=ctrl-attached 1=tgt-attached)",
		    (v >> 11) & 0x1);
	shell_print(sh, "  [14:12]Max rd req (sel)  : %u (1=64 2=128 3=256 4=512 5=1024 6=2048 "
		    "7=4096)", (v >> 12) & 0x7);
	shell_print(sh, "  [17:16]Flash share cap   : %u (0=ctrl-only 1=tgt-only 2=ctrl-only "
		    "3=both)", (v >> 16) & 0x3);
	shell_print(sh, "  [23:20]RPMC counter (1st): %u (0-based)", (v >> 20) & 0xf);
	shell_print(sh, "  [31:24]RPMC OP1 opcode   : 0x%02x", (v >> 24) & 0xff);
	shell_print(sh, "");

	return 0;
}

SHELL_STATIC_SUBCMD_SET_CREATE(espi_cmds,
	SHELL_CMD(info, NULL, "Show eSPI device info", cmd_espi_info),
	SHELL_CMD(status, NULL, "Read ESPI030 (ESPI_DEV_STS)", cmd_espi_status),
	SHELL_CMD(ch_status, NULL, "Print eSPI channels status", cmd_espi_ch_status),
	SHELL_CMD(ch_cap, NULL, "Print eSPI channel capabilities", cmd_espi_ch_cap),
	SHELL_SUBCMD_SET_END
);

SHELL_CMD_REGISTER(espi, &espi_cmds, "eSPI shell commands", NULL);

int main(void)
{
	LOG_INF("ASPEED eSPI shell application");

	if (!device_is_ready(espi_dev)) {
		LOG_ERR("eSPI device not ready");
		return -ENODEV;
	}

#ifdef CONFIG_ESPI_OOB_CHANNEL_RX_ASYNC
	oob_async_init();
#endif

#ifdef CONFIG_ESPI_TAF
	safs_init();
#endif

	return 0;
}
```

## src/mafs_cmd.c
```c
/*
 * Copyright (c) 2026 ASPEED Technology Inc.
 *
 * SPDX-License-Identifier: MIT
 */

#include <zephyr/kernel.h>
#include <zephyr/device.h>
#include <zephyr/shell/shell.h>
#include <zephyr/logging/log.h>
#include <zephyr/drivers/espi.h>
#include <zephyr/drivers/espi_aspeed.h>
#include <zephyr/sys/byteorder.h>
#include <stdlib.h>

LOG_MODULE_DECLARE(espi_shell, CONFIG_LOG_DEFAULT_LEVEL);

extern const struct device *espi_dev;

#define MAFS_TX_BUF_SIZE 256

static uint8_t mafs_tx_buf[MAFS_TX_BUF_SIZE];
static uint8_t mafs_rx_buf[sizeof(struct espi_flash_rwe) + ESPI_PLD_LEN_MAX];

/* mafs read <addr> <len> */
static int cmd_mafs_read(const struct shell *sh, size_t argc, char **argv)
{
	if (argc < 3) {
		shell_error(sh, "Usage: mafs read <addr> <len>");
		return -EINVAL;
	}

	if (!device_is_ready(espi_dev)) {
		shell_error(sh, "eSPI device not ready");
		return -ENODEV;
	}

	uint32_t addr = (uint32_t)strtoul(argv[1], NULL, 0);
	uint16_t len  = (uint16_t)strtoul(argv[2], NULL, 0);

	if (len > MAFS_TX_BUF_SIZE) {
		shell_error(sh, "len exceeds max %d", MAFS_TX_BUF_SIZE);
		return -EINVAL;
	}

	struct espi_flash_packet pckt = {
		.buf        = mafs_tx_buf,
		.flash_addr = addr,
		.len        = len,
	};

	int ret = espi_read_flash(espi_dev, &pckt);

	if (ret) {
		shell_error(sh, "mafs read failed: %d", ret);
		return ret;
	}

	shell_print(sh, "mafs read addr=0x%08x len=%u:", addr, len);
	for (uint16_t i = 0; i < len; i++) {
		shell_fprintf(sh, SHELL_NORMAL, "%02x ", mafs_tx_buf[i]);
		if ((i + 1) % 16 == 0) {
			shell_fprintf(sh, SHELL_NORMAL, "\n");
		}
	}
	shell_fprintf(sh, SHELL_NORMAL, "\n");

	return 0;
}

/* mafs write <addr> <hex_bytes...> */
static int cmd_mafs_write(const struct shell *sh, size_t argc, char **argv)
{
	if (!device_is_ready(espi_dev)) {
		shell_error(sh, "eSPI device not ready");
		return -ENODEV;
	}

	uint32_t addr = (uint32_t)strtoul(argv[1], NULL, 0);
	uint16_t len  = argc - 2;
	int ret;
	struct espi_aspeed_ioc ioc;
	struct espi_flash_rwe *rwe;
	uint32_t rx_addr;
	uint16_t rx_len;

	if (len > MAFS_TX_BUF_SIZE) {
		shell_error(sh, "too many bytes (max %d)", MAFS_TX_BUF_SIZE);
		return -EINVAL;
	}

	for (uint16_t i = 0; i < len; i++) {
		mafs_tx_buf[i] = (uint8_t)strtoul(argv[i + 2], NULL, 16);
	}

	struct espi_flash_packet pckt = {
		.buf        = mafs_tx_buf,
		.flash_addr = addr,
		.len        = len,
	};

	ret = espi_write_flash(espi_dev, &pckt);
	if (ret) {
		shell_error(sh, "mafs write failed: %d", ret);
		return ret;
	}
	shell_print(sh, "mafs write addr=0x%08x len=%u done", addr, len);

	ioc.pkt_len = sizeof(mafs_rx_buf);
	ioc.pkt     = mafs_rx_buf;

	ret = espi_aspeed_flash_get_rx(espi_dev, &ioc, true);
	if (ret) {
		shell_error(sh, "flash_get_rx failed: %d", ret);
		return ret;
	}

	rwe     = (struct espi_flash_rwe *)mafs_rx_buf;
	rx_addr = BSWAP_32(rwe->addr_be);
	rx_len  = (rwe->len_h << 8) | rwe->len_l;

	shell_print(sh, "RX: cyc=0x%02x tag=0x%02x len=0x%04x addr=0x%08x",
		    rwe->cyc, rwe->tag, rx_len, rx_addr);
	return 0;
}

/* mafs erase <addr> <len> */
static int cmd_mafs_erase(const struct shell *sh, size_t argc, char **argv)
{
	if (argc < 3) {
		shell_error(sh, "Usage: mafs erase <addr> <len>");
		return -EINVAL;
	}

	if (!device_is_ready(espi_dev)) {
		shell_error(sh, "eSPI device not ready");
		return -ENODEV;
	}

	uint32_t addr     = (uint32_t)strtoul(argv[1], NULL, 0);
	uint32_t erase_sz = (uint32_t)strtoul(argv[2], NULL, 0);
	uint16_t len;
	int ret;
	struct espi_aspeed_ioc ioc;
	struct espi_flash_rwe *rwe;
	uint32_t rx_addr;
	uint16_t rx_len;

	switch (erase_sz) {
	case 4096:
		len = 1;
		break;
	case 65536:
		len = 2;
		break;
	case 131072:
		len = 4;
		break;
	case 262144:
		len = 5;
		break;
	default:
		shell_error(sh, "invalid erase size %u (valid: 4096/65536/131072/262144)",
			    erase_sz);
		return -EINVAL;
	}

	struct espi_flash_packet pckt = {
		.buf        = NULL,
		.flash_addr = addr,
		.len        = len,
	};

	ret = espi_flash_erase(espi_dev, &pckt);
	if (ret) {
		shell_error(sh, "mafs erase failed: %d", ret);
		return ret;
	}
	shell_print(sh, "mafs erase addr=0x%08x size=%u done", addr, erase_sz);

	ioc.pkt_len = sizeof(mafs_rx_buf);
	ioc.pkt     = mafs_rx_buf;

	ret = espi_aspeed_flash_get_rx(espi_dev, &ioc, true);
	if (ret) {
		shell_error(sh, "flash_get_rx failed: %d", ret);
		return ret;
	}

	rwe     = (struct espi_flash_rwe *)mafs_rx_buf;
	rx_addr = BSWAP_32(rwe->addr_be);
	rx_len  = (rwe->len_h << 8) | rwe->len_l;

	shell_print(sh, "RX: cyc=0x%02x tag=0x%02x len=0x%04x addr=0x%08x",
		    rwe->cyc, rwe->tag, rx_len, rx_addr);
	return 0;
}

SHELL_STATIC_SUBCMD_SET_CREATE(mafs_cmds,
	SHELL_CMD_ARG(read,  NULL, "Read flash: <addr> <len>",          cmd_mafs_read,  3, 0),
	SHELL_CMD_ARG(write, NULL, "Write flash: <addr> <hex_bytes...>", cmd_mafs_write, 2,
		      CONFIG_SHELL_ARGC_MAX - 2),
	SHELL_CMD_ARG(erase, NULL, "Erase flash: <addr> <len>",          cmd_mafs_erase, 3, 0),
	SHELL_SUBCMD_SET_END
);

SHELL_CMD_REGISTER(mafs, &mafs_cmds, "eSPI MAFS flash commands", NULL);
```

## src/oob_cmd.c
```c
/*
 * Copyright (c) 2026 ASPEED Technology Inc.
 *
 * SPDX-License-Identifier: MIT
 */

#include <zephyr/kernel.h>
#include <zephyr/device.h>
#include <zephyr/shell/shell.h>
#include <zephyr/logging/log.h>
#include <zephyr/drivers/espi.h>
#include <stdlib.h>

LOG_MODULE_DECLARE(espi_shell, CONFIG_LOG_DEFAULT_LEVEL);

extern const struct device *espi_dev;

#define OOB_PKT_LEN_MAX 73  /* 3-byte header + 69-byte payload (max OOB body) */

static uint8_t oob_rx_buf[OOB_PKT_LEN_MAX];

static uint8_t oob_async_buf[OOB_PKT_LEN_MAX];
static uint16_t oob_async_len;

#ifdef CONFIG_ESPI_OOB_CHANNEL_RX_ASYNC
static struct espi_callback oob_rx_cb;

struct oob_rx_work {
	struct k_work work;
	uint8_t len;
};

static struct oob_rx_work oob_work;

static void oob_rx_work_handler(struct k_work *work)
{
	struct oob_rx_work *w = CONTAINER_OF(work, struct oob_rx_work, work);
	struct espi_oob_packet pckt = {
		.buf = oob_async_buf,
		.len = OOB_PKT_LEN_MAX,
	};

	int ret = espi_receive_oob(espi_dev, &pckt);

	if (ret) {
		LOG_ERR("OOB async RX failed: %d", ret);
		return;
	}

	oob_async_len = pckt.len;
	LOG_INF("OOB async RX %u bytes (hint=%u)", pckt.len, w->len);
	for (uint16_t i = 0; i < pckt.len; i++) {
		LOG_INF("[%02u] 0x%02x", i, oob_async_buf[i]);
	}
}

static void oob_rx_handler(const struct device *dev,
			    struct espi_callback *cb,
			    struct espi_event event)
{
	ARG_UNUSED(dev);
	ARG_UNUSED(cb);

	oob_work.len = (uint8_t)event.evt_details;
	k_work_submit(&oob_work.work);
}

void oob_async_init(void)
{
	k_work_init(&oob_work.work, oob_rx_work_handler);
	espi_init_callback(&oob_rx_cb, oob_rx_handler, ESPI_BUS_EVENT_OOB_RECEIVED);
	espi_add_callback(espi_dev, &oob_rx_cb);
	LOG_INF("OOB async RX enabled");
}
#endif /* CONFIG_ESPI_OOB_CHANNEL_RX_ASYNC */

static int cmd_oob_send(const struct shell *sh, size_t argc, char **argv)
{
	if (argc < 2) {
		shell_error(sh, "Usage: espi oob send <hex_bytes...>");
		return -EINVAL;
	}

	if (!device_is_ready(espi_dev)) {
		shell_error(sh, "eSPI device not ready");
		return -ENODEV;
	}

	static uint8_t tx_buf[OOB_PKT_LEN_MAX];
	size_t len = argc - 1;

	if (len > OOB_PKT_LEN_MAX) {
		shell_error(sh, "Packet too long (max %d bytes)", OOB_PKT_LEN_MAX);
		return -EINVAL;
	}

	for (size_t i = 0; i < len; i++) {
		tx_buf[i] = (uint8_t)strtoul(argv[i + 1], NULL, 16);
	}

	struct espi_oob_packet pckt = {
		.buf = tx_buf,
		.len = len,
	};

	int ret = espi_send_oob(espi_dev, &pckt);

	if (ret) {
		shell_error(sh, "OOB TX failed: %d", ret);
		return ret;
	}

	shell_print(sh, "OOB TX sent %zu bytes", len);
	return 0;
}

static int cmd_oob_recv(const struct shell *sh, size_t argc, char **argv)
{
	ARG_UNUSED(argc);
	ARG_UNUSED(argv);

	if (!device_is_ready(espi_dev)) {
		shell_error(sh, "eSPI device not ready");
		return -ENODEV;
	}

	struct espi_oob_packet pckt = {
		.buf = oob_rx_buf,
		.len = OOB_PKT_LEN_MAX,
	};

	int ret = espi_receive_oob(espi_dev, &pckt);

	if (ret) {
		shell_error(sh, "OOB RX failed: %d", ret);
		return ret;
	}

	shell_print(sh, "OOB RX %u bytes:", pckt.len);
	for (uint16_t i = 0; i < pckt.len; i++) {
		shell_fprintf(sh, SHELL_NORMAL, "%02x ", oob_rx_buf[i]);
		if ((i + 1) % 16 == 0) {
			shell_fprintf(sh, SHELL_NORMAL, "\n");
		}
	}
	shell_fprintf(sh, SHELL_NORMAL, "\n");

	return 0;
}

static int cmd_oob_dump(const struct shell *sh, size_t argc, char **argv)
{
	ARG_UNUSED(argc);
	ARG_UNUSED(argv);

	if (oob_async_len == 0) {
		shell_print(sh, "No async OOB packet received yet");
		return 0;
	}

	shell_print(sh, "Last async OOB RX %u bytes:", oob_async_len);
	for (uint16_t i = 0; i < oob_async_len; i++) {
		shell_fprintf(sh, SHELL_NORMAL, "%02x ", oob_async_buf[i]);
		if ((i + 1) % 16 == 0) {
			shell_fprintf(sh, SHELL_NORMAL, "\n");
		}
	}
	shell_fprintf(sh, SHELL_NORMAL, "\n");
	return 0;
}

SHELL_STATIC_SUBCMD_SET_CREATE(oob_cmds,
	SHELL_CMD_ARG(send, NULL, "Send OOB packet: <hex_bytes...>", cmd_oob_send, 2,
		      CONFIG_SHELL_ARGC_MAX - 2),
	SHELL_CMD(recv, NULL, "Receive one OOB packet (sync)", cmd_oob_recv),
	SHELL_COND_CMD(CONFIG_ESPI_OOB_CHANNEL_RX_ASYNC, dump, NULL,
		       "Dump last async received OOB packet", cmd_oob_dump),
	SHELL_SUBCMD_SET_END
);

SHELL_CMD_REGISTER(oob, &oob_cmds, "eSPI OOB shell commands", NULL);
```

## src/perif_cmd.c
```c
/*
 * Copyright (c) 2026 ASPEED Technology Inc.
 *
 * SPDX-License-Identifier: MIT
 */

#include <zephyr/kernel.h>
#include <zephyr/device.h>
#include <zephyr/shell/shell.h>
#include <zephyr/logging/log.h>
#include <zephyr/drivers/espi.h>
#include <zephyr/drivers/espi_aspeed.h>
#include <zephyr/sys/byteorder.h>
#include <stdlib.h>

LOG_MODULE_DECLARE(espi_shell, CONFIG_LOG_DEFAULT_LEVEL);

extern const struct device *espi_dev;

/*
 * espi_aspeed_perif_pc_get_rx() writes up to ESPI_PLD_LEN_MAX payload bytes
 * plus a header (MEMWR64 is the worst case: espi_comm_hdr + a 64-bit addr).
 */
static uint8_t pc_rx_pkt[ESPI_PLD_LEN_MAX + sizeof(struct espi_comm_hdr) + sizeof(uint64_t)];
static uint8_t pc_tx_pkt[ESPI_PLD_LEN_MAX];

static void print_hex(const struct shell *sh, const uint8_t *buf, uint32_t len)
{
	for (uint32_t i = 0; i < len; i++) {
		shell_fprintf(sh, SHELL_NORMAL, "%02x ", buf[i]);
		if ((i + 1) % 16 == 0) {
			shell_fprintf(sh, SHELL_NORMAL, "\n");
		}
	}
	shell_fprintf(sh, SHELL_NORMAL, "\n");
}

static int cmd_perif_pc_get(const struct shell *sh, size_t argc, char **argv)
{
	int ret;
	uint8_t *after_hdr;
	uint8_t *data_ptr;
	uint32_t addr32;
	uint64_t addr64;
	uint16_t data_len;
	struct espi_comm_hdr *hdr;
	struct espi_perif_msg *msg;
	struct espi_aspeed_ioc ioc = {
		.pkt_len = sizeof(pc_rx_pkt),
		.pkt = pc_rx_pkt,
	};

	ARG_UNUSED(argc);
	ARG_UNUSED(argv);

	if (!device_is_ready(espi_dev)) {
		shell_error(sh, "eSPI device not ready");
		return -ENODEV;
	}

	ret = espi_aspeed_perif_pc_get_rx(espi_dev, &ioc, true);
	if (ret) {
		shell_error(sh, "PC get_rx failed: %d", ret);
		return ret;
	}

	hdr = (struct espi_comm_hdr *)pc_rx_pkt;
	after_hdr = pc_rx_pkt + sizeof(struct espi_comm_hdr);
	data_len = ((uint16_t)hdr->len_h << 8) | hdr->len_l;

	shell_print(sh, "cyc=0x%02x tag=%u len=%u", hdr->cyc, hdr->tag, data_len);

	switch (hdr->cyc) {
	case ESPI_PERIF_MEMWR32:
		addr32 = sys_get_be32(after_hdr);
		data_ptr = after_hdr + sizeof(uint32_t);

		shell_print(sh, "type: mem32 write addr <0x%08x>", addr32);
		if (data_len) {
			shell_print(sh, "data (%u bytes):", data_len);
			print_hex(sh, data_ptr, data_len);
		}
		break;
	case ESPI_PERIF_MEMWR64:
		addr64 = sys_get_be64(after_hdr);
		data_ptr = after_hdr + sizeof(uint64_t);

		shell_print(sh, "type: mem64 write addr <0x%016llx>", addr64);
		if (data_len) {
			shell_print(sh, "data (%u bytes):", data_len);
			print_hex(sh, data_ptr, data_len);
		}
		break;
	case ESPI_PERIF_MSG:
	case ESPI_PERIF_MSG_D:
		msg = (struct espi_perif_msg *)pc_rx_pkt;
		shell_print(sh, "type: msg%s code=0x%02x msg_bytes=%02x %02x %02x %02x",
			    hdr->cyc == ESPI_PERIF_MSG_D ? "_d" : "",
			    msg->msg_code,
			    msg->msg_byte[0], msg->msg_byte[1],
			    msg->msg_byte[2], msg->msg_byte[3]);
		if (data_len) {
			shell_print(sh, "data (%u bytes):", data_len);
			print_hex(sh, msg->data, data_len);
		}
		break;
	default:
		shell_print(sh, "type: unknown (0x%02x), raw %u bytes:", hdr->cyc, ioc.pkt_len);
		print_hex(sh, pc_rx_pkt, ioc.pkt_len);
		break;
	}

	return 0;
}

static uint8_t np_rx_pkt[ESPI_PLD_LEN_MAX];

static int cmd_perif_np_get(const struct shell *sh, size_t argc, char **argv)
{
	int ret;
	uint16_t req_len;
	uint64_t addr64;
	struct espi_comm_hdr *hdr;
	struct espi_perif_mem32 *m32;
	struct espi_perif_io *io;
	struct espi_aspeed_ioc ioc = {
		.pkt_len = ESPI_PLD_LEN_MAX,
		.pkt = np_rx_pkt,
	};

	ARG_UNUSED(argc);
	ARG_UNUSED(argv);

	if (!device_is_ready(espi_dev)) {
		shell_error(sh, "eSPI device not ready");
		return -ENODEV;
	}

	ret = espi_aspeed_perif_np_get_rx(espi_dev, &ioc, true);
	if (ret) {
		shell_error(sh, "NP get_rx failed: %d", ret);
		return ret;
	}

	hdr = (struct espi_comm_hdr *)np_rx_pkt;
	req_len = ((uint16_t)hdr->len_h << 8) | hdr->len_l;

	shell_print(sh, "cyc=0x%02x tag=%u len=%u", hdr->cyc, hdr->tag, req_len);

	switch (hdr->cyc) {
	case ESPI_PERIF_MEMRD32:
		m32 = (struct espi_perif_mem32 *)np_rx_pkt;
		shell_print(sh, "type: memrd32 addr=0x%08x req_len=%u",
			    sys_be32_to_cpu(m32->addr_be), req_len);
		break;
	case ESPI_PERIF_MEMRD64:
		addr64 = sys_get_be64(np_rx_pkt + sizeof(struct espi_comm_hdr));
		shell_print(sh, "type: memrd64 addr=0x%016llx req_len=%u",
			    (unsigned long long)addr64, req_len);
		break;
	case ESPI_PERIF_IORD:
		io = (struct espi_perif_io *)np_rx_pkt;
		shell_print(sh, "type: io_read addr=0x%04x req_len=%u",
			    sys_be16_to_cpu(io->addr_be), req_len);
		break;
	case ESPI_PERIF_IOWR:
		io = (struct espi_perif_io *)np_rx_pkt;
		shell_print(sh, "type: io_write addr=0x%04x data_len=%u",
			    sys_be16_to_cpu(io->addr_be), req_len);
		if (req_len) {
			shell_print(sh, "data (%u bytes):", req_len);
			print_hex(sh, io->data, req_len);
		}
		break;
	default:
		shell_print(sh, "type: unknown (0x%02x), raw %u bytes:", hdr->cyc, ioc.pkt_len);
		print_hex(sh, np_rx_pkt, ioc.pkt_len);
		break;
	}

	return 0;
}

/* hdr_len: value encoded in espi_comm_hdr.len (may differ from payload_len,
 * e.g. MSG packets count only data bytes, not msg_code/msg_byte fields).
 */
static int pc_put_tx(const struct shell *sh, uint8_t cyc, uint8_t tag,
		     const uint8_t *payload, size_t payload_len, size_t hdr_len)
{
	struct espi_comm_hdr *hdr = (struct espi_comm_hdr *)pc_tx_pkt;
	struct espi_aspeed_ioc ioc;
	int ret;

	if (sizeof(struct espi_comm_hdr) + payload_len > ESPI_PLD_LEN_MAX) {
		shell_error(sh, "Packet too long (max payload %u bytes)",
			    (unsigned int)(ESPI_PLD_LEN_MAX - sizeof(struct espi_comm_hdr)));
		return -EINVAL;
	}

	hdr->cyc   = cyc;
	hdr->tag   = tag;
	hdr->len_h = (hdr_len >> 8) & 0xf;
	hdr->len_l = hdr_len & 0xff;

	if (payload_len)
		memcpy(pc_tx_pkt + sizeof(struct espi_comm_hdr), payload, payload_len);

	ioc.pkt     = pc_tx_pkt;
	ioc.pkt_len = sizeof(struct espi_comm_hdr) + payload_len;

	ret = espi_aspeed_perif_pc_put_tx(espi_dev, &ioc);
	if (ret) {
		shell_error(sh, "PC put_tx failed: %d", ret);
		return ret;
	}

	shell_print(sh, "PC TX sent cyc=0x%02x tag=%u payload=%zu bytes",
		    cyc, tag, payload_len);
	return 0;
}

/* perif pc_put raw <cyc_hex> <tag> [hex_bytes...]  — raw packet */
static int cmd_perif_pc_put_raw(const struct shell *sh, size_t argc, char **argv)
{
	size_t i;
	size_t payload_len;
	static uint8_t payload[ESPI_PLD_LEN_MAX];
	uint8_t cyc;
	uint8_t tag;

	if (argc < 3) {
		shell_error(sh, "Usage: perif pc_put raw <cyc_hex> <tag> [hex_bytes...]");
		return -EINVAL;
	}

	if (!device_is_ready(espi_dev)) {
		shell_error(sh, "eSPI device not ready");
		return -ENODEV;
	}

	cyc         = (uint8_t)strtoul(argv[1], NULL, 16);
	tag         = (uint8_t)strtoul(argv[2], NULL, 0);
	payload_len = argc - 3;

	for (i = 0; i < payload_len; i++)
		payload[i] = (uint8_t)strtoul(argv[3 + i], NULL, 16);

	return pc_put_tx(sh, cyc, tag, payload, payload_len, payload_len);
}

/* perif pc_put msg <tag> <msg_code_hex> <mb0> <mb1> <mb2> <mb3> [hex_bytes...]
 * Builds an ESPI_PERIF_MSG_D packet with a 5-byte message header followed by
 * optional data bytes.
 */
static int cmd_perif_pc_put_msg(const struct shell *sh, size_t argc, char **argv)
{
	size_t i;
	size_t data_len;
	size_t payload_len;
	static uint8_t payload[ESPI_PLD_LEN_MAX];
	uint8_t tag;

	/* argv: [0]=msg [1]=tag [2]=msg_code [3..6]=msg_bytes [7+]=data */
	if (argc < 7) {
		shell_error(sh, "Usage: perif pc_put msg <tag> <msg_code_hex>"
			    " <mb0> <mb1> <mb2> <mb3> [hex_bytes...]");
		return -EINVAL;
	}

	if (!device_is_ready(espi_dev)) {
		shell_error(sh, "eSPI device not ready");
		return -ENODEV;
	}

	tag      = (uint8_t)strtoul(argv[1], NULL, 0);
	data_len = argc - 7;

	/* payload = everything after espi_comm_hdr:
	 * [0]      msg_code
	 * [1..4]   msg_byte[0..3]
	 * [5+]     data
	 */
	payload_len = 1 + 4 + data_len;

	payload[0] = (uint8_t)strtoul(argv[2], NULL, 16); /* msg_code */
	payload[1] = (uint8_t)strtoul(argv[3], NULL, 16); /* msg_byte[0] */
	payload[2] = (uint8_t)strtoul(argv[4], NULL, 16); /* msg_byte[1] */
	payload[3] = (uint8_t)strtoul(argv[5], NULL, 16); /* msg_byte[2] */
	payload[4] = (uint8_t)strtoul(argv[6], NULL, 16); /* msg_byte[3] */

	for (i = 0; i < data_len; i++)
		payload[5 + i] = (uint8_t)strtoul(argv[7 + i], NULL, 16);

	/* len field counts only data bytes, not msg_code + msg_byte[4] */
	return pc_put_tx(sh,
			 data_len ? ESPI_PERIF_MSG_D : ESPI_PERIF_MSG,
			 tag, payload, payload_len, data_len);
}

/* perif pc_put mw32 <tag> <addr_hex_32bit> [hex_bytes...]
 * Builds a MEMWR32 packet: 4-byte BE address followed by data bytes.
 * len field = number of data bytes.
 */
static int cmd_perif_pc_put_mw32(const struct shell *sh, size_t argc, char **argv)
{
	size_t i;
	size_t data_len;
	size_t payload_len;
	static uint8_t payload[ESPI_PLD_LEN_MAX];
	uint8_t tag;
	uint32_t addr;

	/* argv: [0]=mw32 [1]=tag [2]=addr [3+]=data */
	if (argc < 3) {
		shell_error(sh, "Usage: perif pc_put mw32 <tag> <addr_hex> [hex_bytes...]");
		return -EINVAL;
	}

	if (!device_is_ready(espi_dev)) {
		shell_error(sh, "eSPI device not ready");
		return -ENODEV;
	}

	tag      = (uint8_t)strtoul(argv[1], NULL, 0);
	addr     = (uint32_t)strtoul(argv[2], NULL, 16);
	data_len = argc - 3;

	/* payload: 4-byte BE addr + data */
	payload_len = sizeof(uint32_t) + data_len;
	sys_put_be32(addr, payload);

	for (i = 0; i < data_len; i++)
		payload[sizeof(uint32_t) + i] = (uint8_t)strtoul(argv[3 + i], NULL, 16);

	return pc_put_tx(sh, ESPI_PERIF_MEMWR32, tag, payload, payload_len, data_len);
}

/* perif pc_put mw64 <tag> <addr_hex_64bit> [hex_bytes...]
 * Builds a MEMWR64 packet: 8-byte BE address followed by data bytes.
 * len field = number of data bytes.
 */
static int cmd_perif_pc_put_mw64(const struct shell *sh, size_t argc, char **argv)
{
	size_t i;
	size_t data_len;
	size_t payload_len;
	static uint8_t payload[ESPI_PLD_LEN_MAX];
	uint8_t tag;
	uint64_t addr;

	/* argv: [0]=mw64 [1]=tag [2]=addr [3+]=data */
	if (argc < 3) {
		shell_error(sh, "Usage: perif pc_put mw64 <tag> <addr_hex> [hex_bytes...]");
		return -EINVAL;
	}

	if (!device_is_ready(espi_dev)) {
		shell_error(sh, "eSPI device not ready");
		return -ENODEV;
	}

	tag      = (uint8_t)strtoul(argv[1], NULL, 0);
	addr     = (uint64_t)strtoull(argv[2], NULL, 16);
	data_len = argc - 3;

	/* payload: 8-byte BE addr + data */
	payload_len = sizeof(uint64_t) + data_len;
	sys_put_be64(addr, payload);

	for (i = 0; i < data_len; i++)
		payload[sizeof(uint64_t) + i] = (uint8_t)strtoul(argv[3 + i], NULL, 16);

	return pc_put_tx(sh, ESPI_PERIF_MEMWR64, tag, payload, payload_len, data_len);
}

/* perif pc_put suc_cmplt <tag>
 * Successful Completion Without Data (cyc=0x06), no payload.
 */
static int cmd_perif_pc_put_suc_cmplt(const struct shell *sh, size_t argc, char **argv)
{
	uint8_t tag;

	if (argc < 2) {
		shell_error(sh, "Usage: perif pc_put suc_cmplt <tag>");
		return -EINVAL;
	}

	if (!device_is_ready(espi_dev)) {
		shell_error(sh, "eSPI device not ready");
		return -ENODEV;
	}

	tag = (uint8_t)strtoul(argv[1], NULL, 0);

	return pc_put_tx(sh, ESPI_PERIF_SUC_CMPLT, tag, NULL, 0, 0);
}

/* perif pc_put suc_cmplt_d <tag> [hex_bytes...]
 * Successful Completion With Data (cyc=0x0f, D_ONLY), data bytes as payload.
 * len = number of data bytes.
 */
static int cmd_perif_pc_put_suc_cmplt_d(const struct shell *sh, size_t argc, char **argv)
{
	size_t i;
	size_t data_len;
	static uint8_t payload[ESPI_PLD_LEN_MAX];
	uint8_t tag;

	if (argc < 2) {
		shell_error(sh, "Usage: perif pc_put suc_cmplt_d <tag> [hex_bytes...]");
		return -EINVAL;
	}

	if (!device_is_ready(espi_dev)) {
		shell_error(sh, "eSPI device not ready");
		return -ENODEV;
	}

	tag      = (uint8_t)strtoul(argv[1], NULL, 0);
	data_len = argc - 2;

	for (i = 0; i < data_len; i++)
		payload[i] = (uint8_t)strtoul(argv[2 + i], NULL, 16);

	return pc_put_tx(sh, ESPI_PERIF_SUC_CMPLT_D_ONLY, tag, payload, data_len, data_len);
}

/* perif pc_put unsuc_cmplt <tag>
 * Unsuccessful Completion Without Data (cyc=0x0c), no payload.
 */
static int cmd_perif_pc_put_unsuc_cmplt(const struct shell *sh, size_t argc, char **argv)
{
	uint8_t tag;

	if (argc < 2) {
		shell_error(sh, "Usage: perif pc_put unsuc_cmplt <tag>");
		return -EINVAL;
	}

	if (!device_is_ready(espi_dev)) {
		shell_error(sh, "eSPI device not ready");
		return -ENODEV;
	}

	tag = (uint8_t)strtoul(argv[1], NULL, 0);

	return pc_put_tx(sh, ESPI_PERIF_UNSUC_CMPLT, tag, NULL, 0, 0);
}

SHELL_STATIC_SUBCMD_SET_CREATE(pc_put_cmds,
	SHELL_CMD_ARG(raw, NULL,
		      "Send raw PC packet: <cyc_hex> <tag> [hex_bytes...]",
		      cmd_perif_pc_put_raw, 3, CONFIG_SHELL_ARGC_MAX - 3),
	SHELL_CMD_ARG(msg, NULL,
		      "Send MSG/MSG_D packet: <tag> <msg_code_hex> <mb0> <mb1> <mb2> <mb3> "
		      "[data...]",
		      cmd_perif_pc_put_msg, 7, CONFIG_SHELL_ARGC_MAX - 7),
	SHELL_CMD_ARG(mw32, NULL,
		      "Send MEMWR32 packet: <tag> <addr_hex> [hex_bytes...]",
		      cmd_perif_pc_put_mw32, 3, CONFIG_SHELL_ARGC_MAX - 3),
	SHELL_CMD_ARG(mw64, NULL,
		      "Send MEMWR64 packet: <tag> <addr_hex> [hex_bytes...]",
		      cmd_perif_pc_put_mw64, 3, CONFIG_SHELL_ARGC_MAX - 3),
	SHELL_CMD_ARG(suc_cmplt, NULL,
		      "Successful Completion Without Data (cyc=0x06): <tag>",
		      cmd_perif_pc_put_suc_cmplt, 2, 0),
	SHELL_CMD_ARG(suc_cmplt_d, NULL,
		      "Successful Completion With Data (cyc=0x0f): <tag> [hex_bytes...]",
		      cmd_perif_pc_put_suc_cmplt_d, 2, CONFIG_SHELL_ARGC_MAX - 2),
	SHELL_CMD_ARG(unsuc_cmplt, NULL,
		      "Unsuccessful Completion Without Data (cyc=0x0c): <tag>",
		      cmd_perif_pc_put_unsuc_cmplt, 2, 0),
	SHELL_SUBCMD_SET_END
);

static int np_put_tx(const struct shell *sh, uint8_t cyc, uint8_t tag,
		     const uint8_t *payload, size_t payload_len, size_t hdr_len)
{
	struct espi_comm_hdr *hdr = (struct espi_comm_hdr *)pc_tx_pkt;
	struct espi_aspeed_ioc ioc;
	int ret;

	if (sizeof(struct espi_comm_hdr) + payload_len > ESPI_PLD_LEN_MAX) {
		shell_error(sh, "Packet too long (max payload %u bytes)",
			    (unsigned int)(ESPI_PLD_LEN_MAX - sizeof(struct espi_comm_hdr)));
		return -EINVAL;
	}

	hdr->cyc   = cyc;
	hdr->tag   = tag;
	hdr->len_h = (hdr_len >> 8) & 0xf;
	hdr->len_l = hdr_len & 0xff;

	if (payload_len)
		memcpy(pc_tx_pkt + sizeof(struct espi_comm_hdr), payload, payload_len);

	ioc.pkt     = pc_tx_pkt;
	ioc.pkt_len = sizeof(struct espi_comm_hdr) + payload_len;

	ret = espi_aspeed_perif_np_put_tx(espi_dev, &ioc);
	if (ret) {
		shell_error(sh, "NP put_tx failed: %d", ret);
		return ret;
	}

	shell_print(sh, "NP TX sent cyc=0x%02x tag=%u len=%zu payload=%zu bytes",
		    cyc, tag, hdr_len, payload_len);
	return 0;
}

/* perif np_put md32 <tag> <len_hex> <addr_hex_32bit>
 * Builds a MEMRD32 (non-posted read request): len = bytes to read, payload = BE addr.
 */
static int cmd_perif_np_put_md32(const struct shell *sh, size_t argc, char **argv)
{
	uint8_t payload[sizeof(uint32_t)];
	uint8_t tag;
	size_t  req_len;
	uint32_t addr;

	if (argc < 4) {
		shell_error(sh, "Usage: perif np_put md32 <tag> <len_hex> <addr_hex>");
		return -EINVAL;
	}

	if (!device_is_ready(espi_dev)) {
		shell_error(sh, "eSPI device not ready");
		return -ENODEV;
	}

	tag     = (uint8_t)strtoul(argv[1], NULL, 0);
	req_len = (size_t)strtoul(argv[2], NULL, 16);
	addr    = (uint32_t)strtoul(argv[3], NULL, 16);

	sys_put_be32(addr, payload);

	return np_put_tx(sh, ESPI_PERIF_MEMRD32, tag, payload, sizeof(payload), req_len);
}

/* perif np_put md64 <tag> <len_hex> <addr_hex_64bit>
 * Builds a MEMRD64 (non-posted read request): len = bytes to read, payload = BE addr.
 */
static int cmd_perif_np_put_md64(const struct shell *sh, size_t argc, char **argv)
{
	uint8_t payload[sizeof(uint64_t)];
	uint8_t tag;
	size_t  req_len;
	uint64_t addr;

	if (argc < 4) {
		shell_error(sh, "Usage: perif np_put md64 <tag> <len_hex> <addr_hex>");
		return -EINVAL;
	}

	if (!device_is_ready(espi_dev)) {
		shell_error(sh, "eSPI device not ready");
		return -ENODEV;
	}

	tag     = (uint8_t)strtoul(argv[1], NULL, 0);
	req_len = (size_t)strtoul(argv[2], NULL, 16);
	addr    = (uint64_t)strtoull(argv[3], NULL, 16);

	sys_put_be64(addr, payload);

	return np_put_tx(sh, ESPI_PERIF_MEMRD64, tag, payload, sizeof(payload), req_len);
}

/* perif wr_req mem32 <tag> <addr_hex> [hex_bytes...] */
static int cmd_perif_wr_req_mem32(const struct shell *sh, size_t argc, char **argv)
{
	struct espi_request_packet req;
	static uint8_t data[ESPI_PLD_LEN_MAX];
	int ret;
	int i;

	req.cycle_type = ESPI_CYCLE_MEMORY_WRITE32;
	req.tag        = (uint8_t)strtoul(argv[1], NULL, 0);
	req.address    = (uint32_t)strtoul(argv[2], NULL, 16);
	req.len        = argc - 3;
	req.data       = data;

	for (i = 0; i < req.len; i++) {
		data[i] = (uint8_t)strtoul(argv[3 + i], NULL, 16);
	}

	ret = espi_write_request(espi_dev, &req);
	if (ret) {
		shell_error(sh, "write_request failed: %d", ret);
		return ret;
	}

	shell_print(sh, "wr_req mem32 sent: tag=%u addr=0x%08x len=%u",
		    req.tag, req.address, req.len);
	return 0;
}

/* perif wr_req mem64 <tag> <addr_hex> [hex_bytes...] */
static int cmd_perif_wr_req_mem64(const struct shell *sh, size_t argc, char **argv)
{
	struct espi_request_packet req;
	static uint8_t data[ESPI_PLD_LEN_MAX];
	int ret;
	int i;

	req.cycle_type = ESPI_CYCLE_MEMORY_WRITE64;
	req.tag        = (uint8_t)strtoul(argv[1], NULL, 0);
	req.address    = (uint32_t)strtoull(argv[2], NULL, 16);
	req.len        = argc - 3;
	req.data       = data;

	for (i = 0; i < req.len; i++) {
		data[i] = (uint8_t)strtoul(argv[3 + i], NULL, 16);
	}

	ret = espi_write_request(espi_dev, &req);
	if (ret) {
		shell_error(sh, "write_request failed: %d", ret);
		return ret;
	}

	shell_print(sh, "wr_req mem64 sent: tag=%u addr=0x%08x len=%u",
		    req.tag, req.address, req.len);
	return 0;
}

static int do_rd_req(const struct shell *sh, enum espi_cycle_type cyc,
		     uint8_t tag, uint32_t addr, uint16_t len)
{
	struct espi_request_packet req;
	static uint8_t data[ESPI_PLD_LEN_MAX];
	int ret;
	int i;

	req.cycle_type = cyc;
	req.tag        = tag;
	req.address    = addr;
	req.len        = len;
	req.data       = data;

	ret = espi_read_request(espi_dev, &req);
	if (ret) {
		shell_error(sh, "read_request failed: %d", ret);
		return ret;
	}

	shell_print(sh, "rd_req response: cyc=%u tag=%u addr=0x%08x len=%u",
		    req.cycle_type, req.tag, req.address, req.len);
	for (i = 0; i < req.len; i++) {
		shell_fprintf(sh, SHELL_NORMAL, "%02x ", data[i]);
		if ((i + 1) % 16 == 0) {
			shell_fprintf(sh, SHELL_NORMAL, "\n");
		}
	}
	if (req.len % 16 != 0) {
		shell_fprintf(sh, SHELL_NORMAL, "\n");
	}
	return 0;
}

/* perif rd_req mem32 <tag> <addr_hex> <len> */
static int cmd_perif_rd_req_mem32(const struct shell *sh, size_t argc, char **argv)
{
	return do_rd_req(sh, ESPI_CYCLE_MEMORY_READ32,
			 (uint8_t)strtoul(argv[1], NULL, 0),
			 (uint32_t)strtoul(argv[2], NULL, 16),
			 (uint16_t)strtoul(argv[3], NULL, 0));
}

/* perif rd_req mem64 <tag> <addr_hex> <len> */
static int cmd_perif_rd_req_mem64(const struct shell *sh, size_t argc, char **argv)
{
	return do_rd_req(sh, ESPI_CYCLE_MEMORY_READ64,
			 (uint8_t)strtoul(argv[1], NULL, 0),
			 (uint32_t)strtoull(argv[2], NULL, 16),
			 (uint16_t)strtoul(argv[3], NULL, 0));
}

SHELL_STATIC_SUBCMD_SET_CREATE(wr_req_cmds,
	SHELL_CMD_ARG(mem32, NULL,
		      "Send MEMWR32 request: <tag> <addr_hex> [hex_bytes...]",
		      cmd_perif_wr_req_mem32, 3, CONFIG_SHELL_ARGC_MAX - 3),
	SHELL_CMD_ARG(mem64, NULL,
		      "Send MEMWR64 request: <tag> <addr_hex> [hex_bytes...]",
		      cmd_perif_wr_req_mem64, 3, CONFIG_SHELL_ARGC_MAX - 3),
	SHELL_SUBCMD_SET_END
);

SHELL_STATIC_SUBCMD_SET_CREATE(rd_req_cmds,
	SHELL_CMD_ARG(mem32, NULL,
		      "Send MEMRD32 request: <tag> <addr_hex> <len>",
		      cmd_perif_rd_req_mem32, 4, 0),
	SHELL_CMD_ARG(mem64, NULL,
		      "Send MEMRD64 request: <tag> <addr_hex> <len>",
		      cmd_perif_rd_req_mem64, 4, 0),
	SHELL_SUBCMD_SET_END
);

SHELL_STATIC_SUBCMD_SET_CREATE(np_put_cmds,
	SHELL_CMD_ARG(md32, NULL,
		      "Send MEMRD32 request: <tag> <len_hex> <addr_hex>",
		      cmd_perif_np_put_md32, 4, 0),
	SHELL_CMD_ARG(md64, NULL,
		      "Send MEMRD64 request: <tag> <len_hex> <addr_hex>",
		      cmd_perif_np_put_md64, 4, 0),
	SHELL_SUBCMD_SET_END
);

SHELL_STATIC_SUBCMD_SET_CREATE(perif_cmds,
	SHELL_CMD(pc_get, NULL, "Receive one PC packet (blocking) and decode it", cmd_perif_pc_get),
	SHELL_CMD(pc_put, &pc_put_cmds, "Send PC packet", NULL),
	SHELL_CMD(np_get, NULL, "Receive one NP packet (blocking) and decode it", cmd_perif_np_get),
	SHELL_CMD(np_put, &np_put_cmds, "Send NP packet", NULL),
	SHELL_CMD(wr_req, &wr_req_cmds, "Send write request", NULL),
	SHELL_CMD(rd_req, &rd_req_cmds, "Send read request", NULL),
	SHELL_SUBCMD_SET_END
);

SHELL_CMD_REGISTER(perif, &perif_cmds, "eSPI peripheral channel shell commands", NULL);
```

## src/safs_handler.c
```c
/*
 * Copyright (c) 2026 ASPEED Technology Inc.
 *
 * SPDX-License-Identifier: MIT
 */

#include <zephyr/kernel.h>
#include <zephyr/device.h>
#include <zephyr/logging/log.h>
#include <zephyr/drivers/espi.h>
#include <zephyr/drivers/espi_aspeed.h>
#include <zephyr/sys/byteorder.h>
#include <string.h>

#include "safs_handler.h"

LOG_MODULE_DECLARE(espi_shell, CONFIG_LOG_DEFAULT_LEVEL);

#define SAFS_FLASH_SIZE      (8 * 1024 * 1024)

#define SAFS_ERASE_4K        (4 * 1024)
#define SAFS_ERASE_32K       (32 * 1024)
#define SAFS_ERASE_64K       (64 * 1024)
#define SAFS_ERASE_128K      (128 * 1024)

static uint8_t fake_flash[SAFS_FLASH_SIZE];
static uint8_t taf_tx_buf[sizeof(struct espi_flash_cmplt) + ESPI_PLD_LEN_MAX];

static uint16_t taf_payload_len(uint16_t len)
{
	return len ? len : ESPI_PLD_LEN_MAX;
}

static bool taf_range_valid(uint32_t addr, uint32_t len)
{
	return (addr < SAFS_FLASH_SIZE) && (len <= SAFS_FLASH_SIZE - addr);
}

static bool taf_erase_size(uint16_t type, uint32_t *erase_size)
{
	switch (type) {
	case 0:
		*erase_size = SAFS_ERASE_4K;
		return true;
	case 1:
		*erase_size = SAFS_ERASE_32K;
		return true;
	case 2:
		*erase_size = SAFS_ERASE_64K;
		return true;
	case 3:
		*erase_size = SAFS_ERASE_128K;
		return true;
	default:
		return false;
	}
}

static void send_unsuc_cmplt(const struct device *dev, uint8_t tag)
{
	struct espi_flash_cmplt cmplt;
	struct espi_aspeed_ioc ioc;
	int ret;

	cmplt.cyc   = ESPI_FLASH_UNSUC_CMPLT;
	cmplt.tag   = tag;
	cmplt.len_h = 0;
	cmplt.len_l = 0;

	ioc.pkt_len = sizeof(cmplt);
	ioc.pkt     = (uint8_t *)&cmplt;
	ret = espi_aspeed_flash_put_tx(dev, &ioc);
	if (ret) {
		LOG_ERR("UNSUC_CMPLT put_tx failed: %d", ret);
	}
}

static void send_suc_cmplt(const struct device *dev, uint8_t tag, const char *op)
{
	struct espi_flash_cmplt cmplt;
	struct espi_aspeed_ioc ioc;
	int ret;

	cmplt.cyc   = ESPI_FLASH_SUC_CMPLT;
	cmplt.tag   = tag;
	cmplt.len_h = 0;
	cmplt.len_l = 0;

	ioc.pkt_len = sizeof(cmplt);
	ioc.pkt     = (uint8_t *)&cmplt;
	ret = espi_aspeed_flash_put_tx(dev, &ioc);
	if (ret) {
		LOG_ERR("TAF %s completion failed: %d", op, ret);
	}
}

static void espi_taf_handler(const struct device *dev, struct espi_taf_req *req, void *user_data)
{
	struct espi_aspeed_ioc ioc;
	int ret;

	ARG_UNUSED(user_data);

	LOG_INF("TAF request: dev=%s cyc=0x%02x tag=0x%02x len=%u addr=0x%08x data=%p",
		dev->name, req->cyc, req->tag, req->len, req->addr, req->data);

	switch (req->cyc) {
	case ESPI_FLASH_READ: {
		struct espi_flash_cmplt *cmplt = (struct espi_flash_cmplt *)taf_tx_buf;
		uint16_t len = taf_payload_len(req->len);

		LOG_INF("TAF READ: addr=0x%08x len=%u tag=0x%02x",
			req->addr, len, req->tag);

		if (!taf_range_valid(req->addr, len)) {
			LOG_ERR("TAF READ out of range: addr=0x%08x len=%u flash_size=%u",
				req->addr, len, SAFS_FLASH_SIZE);
			send_unsuc_cmplt(dev, req->tag);
			return;
		}

		cmplt->cyc   = ESPI_FLASH_SUC_CMPLT_D_ONLY;
		cmplt->tag   = req->tag;
		cmplt->len_h = len >> 8;
		cmplt->len_l = len & 0xff;
		memcpy(cmplt->data, &fake_flash[req->addr], len);

		ioc.pkt     = taf_tx_buf;
		ioc.pkt_len = sizeof(*cmplt) + len;
		ret = espi_aspeed_flash_put_tx(dev, &ioc);
		if (ret) {
			LOG_ERR("TAF READ completion failed: %d", ret);
		} else {
			LOG_DBG("TAF READ completion sent: len=%u", ioc.pkt_len);
		}
		break;
	}
	case ESPI_FLASH_WRITE: {
		uint16_t len = taf_payload_len(req->len);

		LOG_INF("TAF WRITE: addr=0x%08x len=%u tag=0x%02x data=%p",
			req->addr, len, req->tag, req->data);

		if (!req->data) {
			LOG_ERR("TAF WRITE missing data pointer");
			send_unsuc_cmplt(dev, req->tag);
			return;
		}

		if (!taf_range_valid(req->addr, len)) {
			LOG_ERR("TAF WRITE out of range: addr=0x%08x len=%u flash_size=%u",
				req->addr, len, SAFS_FLASH_SIZE);
			send_unsuc_cmplt(dev, req->tag);
			return;
		}

		memcpy(&fake_flash[req->addr], req->data, len);
		send_suc_cmplt(dev, req->tag, "WRITE");
		break;
	}
	case ESPI_FLASH_ERASE: {
		uint32_t erase_size;

		LOG_INF("TAF ERASE: addr=0x%08x type=%u tag=0x%02x",
			req->addr, req->len, req->tag);

		if (!taf_erase_size(req->len, &erase_size)) {
			LOG_ERR("TAF ERASE invalid type: %u", req->len);
			send_unsuc_cmplt(dev, req->tag);
			return;
		}

		if ((req->addr % erase_size) != 0) {
			LOG_ERR("TAF ERASE unaligned addr: addr=0x%08x size=%u",
				req->addr, erase_size);
			send_unsuc_cmplt(dev, req->tag);
			return;
		}

		if (!taf_range_valid(req->addr, erase_size)) {
			LOG_ERR("TAF ERASE out of range: addr=0x%08x size=%u flash_size=%u",
				req->addr, erase_size, SAFS_FLASH_SIZE);
			send_unsuc_cmplt(dev, req->tag);
			return;
		}

		memset(&fake_flash[req->addr], 0xff, erase_size);
		send_suc_cmplt(dev, req->tag, "ERASE");
		break;
	}
	default:
		LOG_ERR("TAF unknown cycle: cyc=0x%02x tag=0x%02x", req->cyc, req->tag);
		send_unsuc_cmplt(dev, req->tag);
		break;
	}
}

int safs_init(void)
{
	const struct device *espi_dev = DEVICE_DT_GET(DT_NODELABEL(espi0));
	int ret;

	memset(fake_flash, 0xff, sizeof(fake_flash));

	LOG_INF("SAFS init: registering TAF handler on %s", espi_dev->name);

	ret = espi_aspeed_taf_register(espi_dev, espi_taf_handler, NULL);
	if (ret) {
		LOG_ERR("SAFS init: TAF handler register failed: %d", ret);
		return ret;
	}

	LOG_INF("SAFS init: TAF handler registered");
	return 0;
}
```

## src/safs_handler.h
```c
/*
 * Copyright (c) 2026 ASPEED Technology Inc.
 *
 * SPDX-License-Identifier: MIT
 */

#ifndef SAFS_HANDLER_H
#define SAFS_HANDLER_H

int safs_init(void);

#endif /* SAFS_HANDLER_H */
```
