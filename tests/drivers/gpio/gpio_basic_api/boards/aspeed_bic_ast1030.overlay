/*
 * Copyright (c) 2021 ASPEED
 *
 * SPDX-License-Identifier: Apache-2.0
 */

 / {
	resources {
		compatible = "test,gpio_basic_api";
		out-gpios = <&gpio0_0 4 0>;
		in-gpios = <&gpio0_0 5 0>;
	};
};