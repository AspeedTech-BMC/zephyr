/*
 * Copyright (c) 2023 ASPEED
 *
 * SPDX-License-Identifier: Apache-2.0
 */

 / {
	resources {
		compatible = "test-gpio-basic-api";
		out-gpios = <&gpio0_a_d 8 0>;
		in-gpios = <&gpio0_a_d 9 0>;
	};
};