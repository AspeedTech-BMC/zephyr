## CMakeLists.txt
```
# SPDX-License-Identifier: Apache-2.0

cmake_minimum_required(VERSION 3.20.0)

find_package(Zephyr REQUIRED HINTS $ENV{ZEPHYR_BASE})
project(peci)

target_sources(app PRIVATE src/main.c)

target_include_directories(app PRIVATE ${CMAKE_CURRENT_SOURCE_DIR}/../common)
```

## prj.conf
```kconfig
CONFIG_ZTEST=y
CONFIG_PECI=y
CONFIG_PECI_ASPEED=y
```

## boards/ast1030_evb.overlay
```dts
/*
 * Copyright (c) 2026 Aspeed Technology Inc.
 *
 * SPDX-License-Identifier: Apache-2.0
 */

/*
 * Provides slot0_partition, referenced by the board dts's
 * zephyr,code-partition chosen node (boards/aspeed/ast1030_evb/ast1030_evb.dts)
 * which the shared board dts itself never defines. Supplied here instead of
 * editing the shared board dts, following the same per-app overlay pattern
 * used by samples/boards/ast1030_evb/demo/boards/ast1030_evb.overlay.
 */
&fmc_cs0 {
	partitions {
		compatible = "fixed-partitions";
		#address-cells = <1>;
		#size-cells = <1>;
		slot0_partition: partition@0 {
			label = "image-0";
			reg = <0x0 0x100000>;
		};
	};
};
```

## src/main.c
```c
/*
 * Copyright (c) 2026 Aspeed Technology Inc.
 *
 * SPDX-License-Identifier: Apache-2.0
 */

#include <zephyr/device.h>
#include "ast_test.h"

static const struct device *const peci_dev = DEVICE_DT_GET(DT_NODELABEL(peci));

int test_peci(void)
{
	ast_zassert_true(device_is_ready(peci_dev), "PECI device is not ready");

	return ast_ztest_result();
}

/*
 * tests/boards/ast1030_evb/all links this file too, calling test_peci()
 * from its own concurrent thread instead - skip registering this suite
 * there so the same check doesn't also run sequentially through ztest's
 * own runner first.
 */
#if !defined(AST1030_CONCURRENT_ALL)
ZTEST(peci, test_peci_device_ready)
{
	zassert_equal(test_peci(), AST_TEST_PASS, "peci test failed");
}

ZTEST_SUITE(peci, NULL, NULL, NULL, NULL, NULL);
#endif
```
