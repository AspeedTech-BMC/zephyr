## prj.conf
```kconfig
CONFIG_ZTEST=y
CONFIG_THREAD_ANALYZER=y
```

## src/main.c
```c
/*
 * Copyright (c) 2021 Aspeed Technology Inc.
 *
 * SPDX-License-Identifier: Apache-2.0
 */

#include <ztest.h>
#include <debug/thread_analyzer.h>

/* USB */
extern void test_usb_enable(void);
extern void test_usb_dc_api(void);
extern void test_usb_dc_api_read_write(void);
extern void test_usb_dc_api_invalid(void);
extern void test_usb_comm(void);

/* ADC */
extern void test_adc_enable(void);

/* PWM */
extern void test_pwm_enable(void);

/* JTAG */
extern void test_jtag_enable(void);

/* TACH */
extern void test_tach_enable(void);

/* I2C */
extern void test_i2c_enable(void);

/* I3C */
extern void test_i3c_enable(void);

/* GPIO */
extern void test_gpio_enable(void);

/* UART */
extern void test_uart_enable(void);

/* SPI */
extern void test_spi_enable(void);

/* ESPI */
extern void test_espi_enable(void);

/* PECI */
extern void test_peci_enable(void);

#define run_test_suite(suite) \
	ast_run_test_suite(#suite, _##suite)

#define TEST_THREAD_CNT		20
#define TEST_STACKSIZE		1024

K_THREAD_STACK_ARRAY_DEFINE(test_thread_stack, TEST_THREAD_CNT, TEST_STACKSIZE);

static struct k_thread ztest_thread[TEST_THREAD_CNT];
static int unit_test_count;
static int unit_test_remain;

static void test_cb(void *a, void *dummy2, void *dummy)
{
	struct unit_test *test = (struct unit_test *)a;
	int ret = TC_PASS;

	ARG_UNUSED(dummy2);
	ARG_UNUSED(dummy);

	TC_START(test->name);

	printk("Current thread id: %d\n", (int)k_current_get());
	test->test();

	unit_test_remain--;
	Z_TC_END_RESULT(ret, test->name);
}

static int create_test(struct unit_test *test, int thread_num)
{
	int ret = TC_PASS;
	k_tid_t pid;

	if (IS_ENABLED(CONFIG_MULTITHREADING)) {
		pid = k_thread_create(&ztest_thread[thread_num], test_thread_stack[thread_num],
				TEST_STACKSIZE,
				(k_thread_entry_t) test_cb, (struct unit_test *)test,
				NULL, NULL, CONFIG_ZTEST_THREAD_PRIORITY,
				test->thread_options | K_INHERIT_PERMS,
					K_FOREVER);

		if (test->name != NULL) {
			k_thread_name_set(&ztest_thread[thread_num], test->name);
		}
	} else {
		printk("multithreading is not supported\n");
		ret = TC_FAIL;
	}

	printk("Create thread %s\t to num %d, pid: %d\n", test->name, thread_num, (int)pid);

	return ret;
}

static void run_test(void)
{
	int i;

	for (i = 0; i < unit_test_count; i++) {
		k_thread_start(&ztest_thread[i]);
	}
}

static void terminate_test(void)
{
	int i;

	for (i = 0; i < unit_test_count; i++) {
		k_thread_abort(&ztest_thread[i]);
	}
}

static void ast_run_test_suite(const char *name, struct unit_test *suite)
{
	int count = 0;
	int fail = 0;

	while (suite->test) {
		fail += create_test(suite, unit_test_count++);
		suite++;
		if (unit_test_count >= TEST_THREAD_CNT) {
			printk("unit tests are limited to %d\n", unit_test_count);
			break;
		}
	}

	if (fail)
		goto end;

	unit_test_remain = unit_test_count;
	thread_analyzer_print();

	run_test();

	while (unit_test_remain && (count < 200)) {
		count++;
		k_sleep(K_MSEC(100));
	}

	if (unit_test_remain) {
		printk("Total test case: %d, remaining: %d\n",
			unit_test_count, unit_test_remain);
		fail++;
	}

end:
	terminate_test();
	zassert_equal(fail, 0, "test ast1030 failed");
}

static void test_platform(void)
{
	ztest_test_suite(test_ast1030,
			 /* USB */
			 ztest_unit_test(test_usb_enable),
			 ztest_unit_test(test_usb_dc_api),
			 ztest_unit_test(test_usb_dc_api_read_write),
			 ztest_unit_test(test_usb_dc_api_invalid),
			 ztest_unit_test(test_usb_comm),

			 ztest_unit_test(test_adc_enable),
			 ztest_unit_test(test_pwm_enable),
			 ztest_unit_test(test_jtag_enable),
			 ztest_unit_test(test_tach_enable),
			 ztest_unit_test(test_i2c_enable),
			 ztest_unit_test(test_i3c_enable),
			 ztest_unit_test(test_gpio_enable),
			 ztest_unit_test(test_uart_enable),
			 ztest_unit_test(test_spi_enable),
			 ztest_unit_test(test_espi_enable),
			 ztest_unit_test(test_peci_enable)
			 );

	run_test_suite(test_ast1030);
}

/* test case main entry */
void test_main(void)
{
	ztest_test_suite(platform_test,
			 ztest_unit_test(test_platform));

	ztest_run_test_suite(platform_test);
}
```

## src/espi.c
```c
/*
 * Copyright (c) 2021 Aspeed Technology Inc.
 *
 * SPDX-License-Identifier: Apache-2.0
 */

#include <tc_util.h>

void test_espi_enable(void)
{
	printk("Do nothing\n");
}
```

## src/gpio.c
```c
/*
 * Copyright (c) 2021 Aspeed Technology Inc.
 *
 * SPDX-License-Identifier: Apache-2.0
 */

#include <tc_util.h>

void test_gpio_enable(void)
{
	printk("Do nothing\n");
}
```

## src/spi.c
```c
/*
 * Copyright (c) 2021 Aspeed Technology Inc.
 *
 * SPDX-License-Identifier: Apache-2.0
 */

#include <tc_util.h>

void test_spi_enable(void)
{
	printk("Do nothing\n");
}
```

## src/tach.c
```c
/*
 * Copyright (c) 2021 Aspeed Technology Inc.
 *
 * SPDX-License-Identifier: Apache-2.0
 */

#include <tc_util.h>

void test_tach_enable(void)
{
	printk("Do nothing\n");
}
```

## src/uart.c
```c
/*
 * Copyright (c) 2021 Aspeed Technology Inc.
 *
 * SPDX-License-Identifier: Apache-2.0
 */

#include <tc_util.h>

void test_uart_enable(void)
{
	printk("Do nothing\n");
}
```

## src/usb.c
```c
/*
 * Copyright (c) 2021 Aspeed Technology Inc.
 *
 * SPDX-License-Identifier: Apache-2.0
 */

#include <ztest.h>
#include <tc_util.h>

#include <usb/usb_device.h>
#include <usb/usb_common.h>
#include <drivers/uart.h>

/* Max packet size for endpoints */
#define BULK_EP_MPS		64
#define ENDP_BULK_IN		0x81
#define VALID_EP		ENDP_BULK_IN
#define INVALID_EP		0x20

#define RX_BUFF_SIZE		64
#define RING_BUF_SIZE		256

RING_BUF_DECLARE(ringbuf, RING_BUF_SIZE);

K_SEM_DEFINE(usb_sem, 0, 1);
static const char *golden_str = "usb_test";

static int data_handle(void)
{
	uint8_t buff[RX_BUFF_SIZE];
	int data_print = 1;
	int rb_len;
	int i;

	rb_len = ring_buf_get(&ringbuf, buff, sizeof(buff));
	if (data_print) {
		printk("Print Data: ");
		for (i = 0; i < rb_len; i++)
			printk("0x%x ", buff[i]);
		printk("\n");
	}

	/* Check golden pattern */
	rb_len = strlen(golden_str);
	for (i = 0; i < rb_len; i++) {
		if (golden_str[i] != buff[i]) {
			printk("cmp to %d, buff: %s\n", i, buff);
			return -EIO;
		}
	}

	return TC_PASS;
}

static void interrupt_handler(const struct device *dev, void *user_data)
{
	uint8_t rx_buff[RX_BUFF_SIZE];
	int total_len = 0;
	int recv_len;
	int rb_len;

	ARG_UNUSED(user_data);

	while (uart_irq_is_pending(dev) && uart_irq_rx_ready(dev)) {
		recv_len = uart_fifo_read(dev, rx_buff, sizeof(rx_buff));
		total_len += recv_len;

		if (recv_len) {
			rb_len = ring_buf_put(&ringbuf, rx_buff, recv_len);
			if (rb_len < recv_len) {
				printk("Drop %u bytes\n", recv_len - rb_len);
			}
		} else {
			break;
		}

		printk("total transfer len: 0x%x\n", total_len);
		k_sem_give(&usb_sem);
	}
}

void test_usb_comm(void)
{
	const struct device *dev;
	int count = 0;
	int ret;

	dev = device_get_binding("CDC_ACM_0");
	zassert_not_null(dev, "CDC ACM device is not found");

	uart_irq_callback_set(dev, interrupt_handler);

	/* Enable rx interrupts */
	uart_irq_rx_enable(dev);

	printk("Wait for host side data, expect to receive \"%s\"...\n\n", golden_str);
	while (count < 100) {
		ret = k_sem_take(&usb_sem, K_NO_WAIT);
		if (ret) {
			count++;
			k_sleep(K_MSEC(100));
		} else {
			break;
		}
	}

	zassert_equal(data_handle(), TC_PASS, "compare received data failed");
}

/* Test USB Device Cotnroller API */
void test_usb_dc_api(void)
{
	/* Control endpoins are configured */
	zassert_equal(usb_dc_ep_mps(0x0), 64,
		      "usb_dc_ep_mps(0x00) failed");
	zassert_equal(usb_dc_ep_mps(0x80), 64,
		      "usb_dc_ep_mps(0x80) failed");

	/* Bulk EP is not configured yet */
	zassert_equal(usb_dc_ep_mps(ENDP_BULK_IN), 0,
		      "usb_dc_ep_mps(ENDP_BULK_IN) not configured");
}

/* Test USB Device Cotnroller API for invalid parameters */
void test_usb_dc_api_invalid(void)
{
	uint32_t size;
	uint8_t byte;

	/* Set stall to invalid EP */
	zassert_not_equal(usb_dc_ep_set_stall(INVALID_EP), TC_PASS,
			  "usb_dc_ep_set_stall(INVALID_EP)");

	/* Clear stall to invalid EP */
	zassert_not_equal(usb_dc_ep_clear_stall(INVALID_EP), TC_PASS,
			  "usb_dc_ep_clear_stall(INVALID_EP)");

	/* Check if the selected endpoint is stalled */
	zassert_not_equal(usb_dc_ep_is_stalled(INVALID_EP, &byte), TC_PASS,
			  "usb_dc_ep_is_stalled(INVALID_EP, stalled)");
	zassert_not_equal(usb_dc_ep_is_stalled(VALID_EP, NULL), TC_PASS,
			  "usb_dc_ep_is_stalled(VALID_EP, NULL)");

	/* Halt invalid EP */
	zassert_not_equal(usb_dc_ep_halt(INVALID_EP), TC_PASS,
			  "usb_dc_ep_halt(INVALID_EP)");

	/* Enable invalid EP */
	zassert_not_equal(usb_dc_ep_enable(INVALID_EP), TC_PASS,
			  "usb_dc_ep_enable(INVALID_EP)");

	/* Disable invalid EP */
	zassert_not_equal(usb_dc_ep_disable(INVALID_EP), TC_PASS,
			  "usb_dc_ep_disable(INVALID_EP)");

	/* Flush invalid EP */
	zassert_not_equal(usb_dc_ep_flush(INVALID_EP), TC_PASS,
			  "usb_dc_ep_flush(INVALID_EP)");

	/* Set callback to invalid EP */
	zassert_not_equal(usb_dc_ep_set_callback(INVALID_EP, NULL), TC_PASS,
			  "usb_dc_ep_set_callback(INVALID_EP, NULL)");

	/* Write to invalid EP */
	zassert_not_equal(usb_dc_ep_write(INVALID_EP, &byte, sizeof(byte),
					  &size),
			  TC_PASS, "usb_dc_ep_write(INVALID_EP)");

	/* Read invalid EP */
	zassert_not_equal(usb_dc_ep_read(INVALID_EP, &byte, sizeof(byte),
					 &size),
			  TC_PASS, "usb_dc_ep_read(INVALID_EP)");
	zassert_not_equal(usb_dc_ep_read_wait(INVALID_EP, &byte, sizeof(byte),
					      &size),
			  TC_PASS, "usb_dc_ep_read_wait(INVALID_EP)");
	zassert_not_equal(usb_dc_ep_read_continue(INVALID_EP), TC_PASS,
			  "usb_dc_ep_read_continue(INVALID_EP)");

	/* Get endpoint max packet size for invalid EP */
	zassert_not_equal(usb_dc_ep_mps(INVALID_EP), TC_PASS,
			  "usb_dc_ep_mps(INVALID_EP)");
}

void test_usb_dc_api_read_write(void)
{
	uint32_t size;
	uint8_t byte;

	/* Read invalid EP */
	zassert_not_equal(usb_read(INVALID_EP, &byte, sizeof(byte), &size),
			  TC_PASS, "usb_read(INVALID_EP)");

	/* Write to invalid EP */
	zassert_not_equal(usb_write(INVALID_EP, &byte, sizeof(byte), &size),
			  TC_PASS, "usb_write(INVALID_EP)");
}

void test_usb_enable(void)
{
	zassert_equal(usb_enable(NULL), 0, "usb_enable() failed");
}
```
