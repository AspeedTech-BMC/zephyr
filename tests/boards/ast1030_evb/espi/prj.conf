## prj.conf
```kconfig
CONFIG_ZTEST=y
CONFIG_ESPI=y
CONFIG_ESPI_ASPEED=y
```

## boards/ast1030_evb.overlay
```dts
/*
 * Copyright (c) 2026 Aspeed Technology Inc.
 *
 * SPDX-License-Identifier: Apache-2.0
 */

&espi {
	status = "okay";
};

/*
 * Provides slot0_partition, referenced by the board dts's
 * zephyr,code-partition chosen node (boards/aspeed/ast1030_evb/ast1030_evb.dts)
 * which the shared board dts itself never defines. Supplied here instead of
 * editing the shared board dts, following the same per-app overlay pattern
 * used by samples/boards/ast1030_evb/demo/boards/ast1030_evb.overlay.
 */
&fmc_cs0 {
	partitions {
		compatible = "fixed-partitions";
		#address-cells = <1>;
		#size-cells = <1>;
		slot0_partition: partition@0 {
			label = "image-0";
			reg = <0x0 0x100000>;
		};
	};
};
```

## src/main.c
```c
/*
 * Copyright (c) 2026 Aspeed Technology Inc.
 *
 * SPDX-License-Identifier: Apache-2.0
 */

#include <zephyr/device.h>
#include "ast_test.h"

/*
 * The old CI-mode eSPI test (tests/boards/ast1030/src/espi.c on
 * aspeed-dev-v2.6.0) did nothing but return 0 - the register-level bit poke
 * lived only in the FT (production test) path, which is out of scope for
 * this port. Keep the same CI intent: confirm the controller is present.
 */
static const struct device *const espi_dev = DEVICE_DT_GET(DT_NODELABEL(espi));

int test_espi(void)
{
	ast_zassert_true(device_is_ready(espi_dev), "eSPI device is not ready");

	return ast_ztest_result();
}

/*
 * tests/boards/ast1030_evb/all links this file too, calling test_espi()
 * from its own concurrent thread instead - skip registering this suite
 * there so the same check doesn't also run sequentially through ztest's
 * own runner first.
 */
#if !defined(AST1030_CONCURRENT_ALL)
ZTEST(espi, test_espi_device_ready)
{
	zassert_equal(test_espi(), AST_TEST_PASS, "espi test failed");
}

ZTEST_SUITE(espi, NULL, NULL, NULL, NULL, NULL);
#endif
```
