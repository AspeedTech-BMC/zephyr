## tests/boards/ast1040_evb/gpio/testcase.yaml
```yaml
common:
  harness: ztest
  harness_config:
    fixture: gpio_loopback

tests:
  boards.ast1040_evb.gpio:
    platform_allow: ast1040_evb/ast1040/cm4
    tags:
      - drivers
      - gpio
```

## tests/boards/ast1040_evb/i2c/testcase.yaml
```yaml
tests:
  boards.ast1040_evb.i2c:
    platform_allow: ast1040_evb/ast1040/cm4
    tags:
      - drivers
      - i2c
```

## tests/boards/ast1040_evb/otp/testcase.yaml
```yaml
common:
  harness: ztest

tests:
  boards.ast1040_evb.otp:
    platform_allow: ast1040_evb/ast1040/cm4
    tags:
      - drivers
      - misc
```

## tests/boards/ast1040_evb/spi/testcase.yaml
```yaml
tests:
  boards.ast1040_evb.spi:
    platform_allow: ast1040_evb/ast1040/cm4
    tags:
      - drivers
      - spi
      - flash
```

## tests/boards/ast1040_evb/uart/testcase.yaml
```yaml
tests:
  boards.ast1040_evb.uart:
    platform_allow: ast1040_evb/ast1040/cm4
    tags:
      - drivers
      - uart
```
