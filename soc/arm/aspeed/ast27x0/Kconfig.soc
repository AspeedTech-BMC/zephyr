## soc/arm/aspeed/ast27x0/Kconfig.soc
```kconfig
# SPDX-License-Identifier: Apache-2.0
#
# Copyright (c) 2023 ASPEED Technology Inc.

choice
	prompt "ASPEED AST27X0 Selection"
	depends on SOC_SERIES_AST27X0

config SOC_AST2700
	bool "AST2700"

endchoice

config SRAM_RO_SIZE
	int "Read-only SRAM Size in kB"
	help
	 The cached SRAM has two memory regions: read-only and read-write. This
	 option allows you to configure the size of the read-only region, while
	 the size of the read-write region is determined by subtracting
	 SRAM_RO_SIZE from the total SRAM_SIZE.
```

## soc/aspeed/ast26xx/Kconfig.defconfig.ast2600
```kconfig
# SPDX-License-Identifier: Apache-2.0
#
# Copyright (c) 2023 ASPEED Technology Inc.

if SOC_AST2600

config NUM_IRQS
	default 240

endif # SOC_AST2600
```

## west.yml
```yaml
# The west manifest file for upstream Zephyr.
#
# The per-installation west configuration file, .west/config, sets the
# path to the project containing this file in the [manifest] section's
# "path" variable.
#
# You are free to create your own manifest files and put them in any
# repository you want, to create your own custom Zephyr installations.
# For example, you could create a manifest file in your own out of
# tree application directory, which would pull this zephyr repository
# in as an ordinary project.
#
# You can pass your manifest repositories to west init when creating a
# new Zephyr installation. See the west documentation for more
# information.

manifest:
  defaults:
    remote: upstream

  remotes:
    - name: upstream
      url-base: https://github.com/zephyrproject-rtos

  #
  # Please add items below based on alphabetical order
  projects:
    - name: cmsis
      revision: c3bd2094f92d574377f7af2aec147ae181aa5f8e
      path: modules/hal/cmsis
    - name: mbedtls
      revision: 126609c9b00306fa37f73bc24f412a1a0901a8a0
      path: modules/crypto/mbedtls
    - name: mcuboot
      revision: 2fce9769b191411d580bbc65b043956c2ae9307e
      path: bootloader/mcuboot

  self:
    path: zephyr
    west-commands: scripts/west-commands.yml
```
