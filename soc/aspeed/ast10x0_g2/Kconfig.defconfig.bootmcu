## soc/aspeed/ast10x0_g2/Kconfig.defconfig.bootmcu
```kconfig
# SPDX-License-Identifier: Apache-2.0
#
# Copyright (c) 2023 ASPEED Technology Inc.

if SOC_SERIES_AST10x0_G2_BOOTMCU

config SYS_CLOCK_HW_CYCLES_PER_SEC
	default 1000000

config RISCV_SOC_INTERRUPT_INIT
	default y

config RISCV_HAS_CPU_IDLE
	default y

config RISCV_GP
	default y

config NUM_IRQS
	default 16

config CLOCK_CONTROL_INIT_PRIORITY
	default SYSCON_INIT_PRIORITY

config RESET_INIT_PRIORITY
	default SYSCON_INIT_PRIORITY

endif # SOC_SERIES_AST10x0_G2_BOOTMCU
```

## soc/aspeed/ast10x0_g2/Kconfig.soc
```kconfig
# SPDX-License-Identifier: Apache-2.0
#
# Copyright (c) 2023 ASPEED Technology Inc.

config SOC_SERIES_AST10x0_G2
	bool
	select SOC_FAMILY_ASPEED
	help
	  Enable support for ASPEED AST10x0 G2 series (AST1040, AST1080)

config SOC_SERIES_AST10x0_G2_CM4
	bool
	select SOC_SERIES_AST10x0_G2

config SOC_SERIES_AST10x0_G2_BOOTMCU
	bool
	select SOC_SERIES_AST10x0_G2

config SOC_AST1040_CM4
	bool
	select SOC_SERIES_AST10x0_G2_CM4
	help
	  AST1040 CM4 SOC

config SOC_AST1040_BOOTMCU
	bool
	select SOC_SERIES_AST10x0_G2_BOOTMCU
	help
	  AST1040 BOOTMCU SOC

config SOC_AST1080_CM4
	bool
	select SOC_SERIES_AST10x0_G2_CM4
	help
	  AST1080 CM4 SOC

config SOC_AST1080_BOOTMCU
	bool
	select SOC_SERIES_AST10x0_G2_BOOTMCU
	help
	  AST1080 BOOTMCU SOC

config SOC_SERIES
	default "ast10x0_g2" if SOC_SERIES_AST10x0_G2

config SOC
	default "ast1040" if SOC_AST1040_CM4 || SOC_AST1040_BOOTMCU
	default "ast1080" if SOC_AST1080_CM4 || SOC_AST1080_BOOTMCU
```

## soc/aspeed/ast26xx/Kconfig
```kconfig
# SPDX-License-Identifier: Apache-2.0
#
# Copyright (c) 2023 ASPEED Technology Inc.

config SOC_SERIES_AST26XX
	select ARM
	select CPU_CORTEX_M3
	select SYSCON
	select CACHE
	select CPU_HAS_DCACHE
	select CPU_HAS_ICACHE
	select CACHE_MANAGEMENT
	select CACHE_ASPEED
```

## soc/aspeed/ast26xx/Kconfig.defconfig
```kconfig
# SPDX-License-Identifier: Apache-2.0
#
# Copyright (c) 2023 ASPEED Technology Inc.

if SOC_SERIES_AST26XX

rsource "Kconfig.defconfig.ast2600"

config SOC_SERIES
	default "ast26xx"

config ICACHE_LINE_SIZE
	default 32

config DCACHE_LINE_SIZE
	default 32

choice CACHE_TYPE
	default EXTERNAL_CACHE
endchoice

config XIP
	default y

config SYS_CLOCK_HW_CYCLES_PER_SEC
	default 200000000

config LINKER_LAST_SECTION_ID
	default n

config CLOCK_CONTROL_INIT_PRIORITY
	default SYSCON_INIT_PRIORITY

config RESET_INIT_PRIORITY
	default SYSCON_INIT_PRIORITY

endif # SOC_SERIES_AST26XX
```

## soc/aspeed/ast26xx/Kconfig.soc
```kconfig
# SPDX-License-Identifier: Apache-2.0
#
# Copyright (c) 2023 ASPEED Technology Inc.

config SOC_SERIES_AST26XX
	bool
	select SOC_FAMILY_ASPEED
	help
	  Enable support for ASPEED AST26XX series

config SOC_AST2600
	bool
	select SOC_SERIES_AST26XX
	help
	  AST2600

config SOC_SERIES
	default "ast26xx" if SOC_SERIES_AST26XX

config SOC
	default "ast2600" if SOC_AST2600
```

## soc/aspeed/ast27x0/Kconfig
```kconfig
# SPDX-License-Identifier: Apache-2.0
#
# Copyright (c) 2023 ASPEED Technology Inc.

config SOC_AST2700_SSP
	select ARM
	select CPU_CORTEX_M4
	select CPU_HAS_FPU
	select CPU_HAS_ARM_MPU
	select SYSCON
	select CACHE
	select CPU_HAS_DCACHE
	select CPU_HAS_ICACHE
	select CACHE_MANAGEMENT
	select CACHE_AST27XX

config SOC_AST2700_TSP
	select ARM
	select CPU_CORTEX_M4
	select CPU_HAS_FPU
	select CPU_HAS_ARM_MPU
	select SYSCON
	select CACHE
	select CPU_HAS_DCACHE
	select CPU_HAS_ICACHE
	select CACHE_MANAGEMENT
	select CACHE_AST27XX
```

## soc/aspeed/ast27x0/Kconfig.soc
```kconfig
# SPDX-License-Identifier: Apache-2.0
#
# Copyright (c) 2023 ASPEED Technology Inc.

config SOC_SERIES_AST27X0
	bool
	select SOC_FAMILY_ASPEED

config SOC_SERIES
	default "ast27x0" if SOC_SERIES_AST27X0

config SOC_AST2700
	bool
	select SOC_SERIES_AST27X0

config SOC_AST1700
	bool
	select SOC_SERIES_AST27X0

config SOC
	default "ast2700" if SOC_AST2700
	default "ast1700" if SOC_AST2700

config SOC_AST2700_SSP
	bool
	select SOC_AST2700
	help
	  Enable support for AST2700 SSP

config SOC_AST2700_TSP
	bool
	select SOC_AST2700
	help
	  Enable support for AST2700 TSP
```

## soc/aspeed/ast27xx/Kconfig
```kconfig
# SPDX-License-Identifier: Apache-2.0
#
# Copyright (c) 2023 ASPEED Technology Inc.

config SOC_AST2700_SSP
	select ARM
	select CPU_CORTEX_M4
	select CPU_HAS_FPU
	select CPU_HAS_ARM_MPU
	select SYSCON
	select CACHE
	select CPU_HAS_DCACHE
	select CPU_HAS_ICACHE
	select CACHE_MANAGEMENT
	select CACHE_AST27XX

config SOC_AST2700_TSP
	select ARM
	select CPU_CORTEX_M4
	select CPU_HAS_FPU
	select CPU_HAS_ARM_MPU
	select SYSCON
	select CACHE
	select CPU_HAS_DCACHE
	select CPU_HAS_ICACHE
	select CACHE_MANAGEMENT
	select CACHE_AST27XX

config SOC_AST2700_BOOTMCU
	select RISCV
	select RISCV_PRIVILEGED
	select RISCV_VECTORED_MODE
	select GEN_IRQ_VECTOR_TABLE
	select ATOMIC_OPERATIONS_C
	select INCLUDE_RESET_VECTOR
	select RISCV_ISA_RV32I
	select RISCV_ISA_EXT_M
	select RISCV_ISA_EXT_C
	select RISCV_ISA_EXT_ZICSR
	select RISCV_ISA_EXT_ZIFENCEI

config SOC_AST2700_A0_SSP
	select ARM
	select CPU_CORTEX_M4
	select CPU_HAS_FPU
	select CPU_HAS_ARM_MPU
	select SYSCON
	select CACHE
	select CPU_HAS_DCACHE
	select CPU_HAS_ICACHE
	select CACHE_MANAGEMENT
	select CACHE_AST27XX

config SOC_AST2700_A0_TSP
	select ARM
	select CPU_CORTEX_M4
	select CPU_HAS_FPU
	select CPU_HAS_ARM_MPU
	select SYSCON
	select CACHE
	select CPU_HAS_DCACHE
	select CPU_HAS_ICACHE
	select CACHE_MANAGEMENT
	select CACHE_AST27XX

config SOC_AST2700_A0_BOOTMCU
	select RISCV
	select RISCV_PRIVILEGED
	select RISCV_VECTORED_MODE
	select GEN_IRQ_VECTOR_TABLE
	select ATOMIC_OPERATIONS_C
	select INCLUDE_RESET_VECTOR
	select RISCV_ISA_RV32I
	select RISCV_ISA_EXT_M
	select RISCV_ISA_EXT_C
	select RISCV_ISA_EXT_ZICSR
	select RISCV_ISA_EXT_ZIFENCEI
```

## soc/aspeed/ast27xx/Kconfig.defconfig
```kconfig
# SPDX-License-Identifier: Apache-2.0
#
# Copyright (c) 2023 ASPEED Technology Inc.

if SOC_SERIES_AST27XX

rsource "Kconfig.defconfig.ssp"
rsource "Kconfig.defconfig.tsp"
rsource "Kconfig.defconfig.bootmcu"

endif # SOC_SERIES_AST27XX
```

## soc/aspeed/ast27xx/Kconfig.defconfig.bootmcu
```kconfig
# SPDX-License-Identifier: Apache-2.0
#
# Copyright (c) 2024 ASPEED Technology Inc.

if SOC_AST2700_BOOTMCU || SOC_AST2700_A1_BOOTMCU

config SYS_CLOCK_HW_CYCLES_PER_SEC
	default 1000000

config RISCV_SOC_INTERRUPT_INIT
	default y

config RISCV_HAS_CPU_IDLE
	default y

config RISCV_GP
	default y

config NUM_IRQS
	default 16

config PINCTRL
	default y

config CLOCK_CONTROL_INIT_PRIORITY
	default SYSCON_INIT_PRIORITY

config RESET_INIT_PRIORITY
	default SYSCON_INIT_PRIORITY

endif # SOC_AST2700_BOOTMCU || SOC_AST2700_A1_BOOTMCU
```

## soc/aspeed/ast27xx/Kconfig.defconfig.tsp
```kconfig
if SOC_AST2700_TSP || SOC_AST2700_A0_TSP

config ICACHE_LINE_SIZE
	default 32

config DCACHE_LINE_SIZE
	default 32

choice CACHE_TYPE
	default EXTERNAL_CACHE
endchoice

config XIP
	default y

config LINKER_LAST_SECTION_ID
	default n

config CLOCK_CONTROL_INIT_PRIORITY
	default SYSCON_INIT_PRIORITY

config RESET_INIT_PRIORITY
	default SYSCON_INIT_PRIORITY

config ARM_CUSTOM_INTERRUPT_CONTROLLER
	default y

config MULTI_LEVEL_INTERRUPTS
	default y

config MAX_IRQ_PER_AGGREGATOR
	default 32

config 2ND_LEVEL_INTERRUPTS
	default y

if SOC_AST2700_A0_TSP

config 2ND_LVL_ISR_TBL_OFFSET
	default 160

config NUM_2ND_LEVEL_AGGREGATORS
	default 8

config 2ND_LVL_INTR_00_OFFSET
	default 128

config 2ND_LVL_INTR_01_OFFSET
	default 129

config 2ND_LVL_INTR_02_OFFSET
	default 130

config 2ND_LVL_INTR_03_OFFSET
	default 131

config 2ND_LVL_INTR_04_OFFSET
	default 132

config 2ND_LVL_INTR_05_OFFSET
	default 133

config 2ND_LVL_INTR_06_OFFSET
	default 134

config 2ND_LVL_INTR_07_OFFSET
	default 135

config NUM_IRQS
	default 448

endif # SOC_AST2700_A0_TSP

if SOC_AST2700_TSP

config 2ND_LVL_ISR_TBL_OFFSET
	default 192

config NUM_2ND_LEVEL_AGGREGATORS
	default 1

config 2ND_LVL_INTR_00_OFFSET
	default 160

config 3RD_LEVEL_INTERRUPTS
	default y

config 3RD_LVL_ISR_TBL_OFFSET
	default 224

config NUM_3RD_LEVEL_AGGREGATORS
	default 8

config 3RD_LVL_INTR_00_OFFSET
	default 0

config 3RD_LVL_INTR_01_OFFSET
	default 1

config 3RD_LVL_INTR_02_OFFSET
	default 2

config 3RD_LVL_INTR_03_OFFSET
	default 3

config 3RD_LVL_INTR_04_OFFSET
	default 4

config 3RD_LVL_INTR_05_OFFSET
	default 5

config 3RD_LVL_INTR_06_OFFSET
	default 6

config 3RD_LVL_INTR_07_OFFSET
	default 7

config NUM_IRQS
	default 480

endif # SOC_AST2700_TSP

endif # SOC_AST2700_TSP || SOC_AST2700_A0_TSP
```

## soc/aspeed/ast27xx/Kconfig.soc
```kconfig
# SPDX-License-Identifier: Apache-2.0
#
# Copyright (c) 2023 ASPEED Technology Inc.

config SOC_SERIES_AST27XX
	bool
	select SOC_FAMILY_ASPEED

config SOC_SERIES
	default "ast27xx" if SOC_SERIES_AST27XX

config SOC_AST2700
	bool
	select SOC_SERIES_AST27XX

config SOC_AST2700_A1
	bool
	select SOC_SERIES_AST27XX

config SOC_AST2705
	bool
	select SOC_SERIES_AST27XX

config SOC
	default "ast2700" if SOC_AST2700
	default "ast2700-a1" if SOC_AST2700_A1
	default "ast2705" if SOC_AST2705

config SOC_AST2700_SSP
	bool
	select SOC_AST2700
	help
	  Enable support for AST2700 SSP

config SOC_AST2700_TSP
	bool
	select SOC_AST2700
	help
	  Enable support for AST2700 TSP

config SOC_AST2700_BOOTMCU
	bool
	select SOC_AST2700
	help
	  Enable support for AST2700 Boot MCU

config SOC_AST2700_A1_SSP
	bool
	select SOC_AST2700_A1
	help
	  Enable support for ast2700-a1 SSP

config SOC_AST2700_A1_TSP
	bool
	select SOC_AST2700_A1
	help
	  Enable support for ast2700-a1 TSP

config SOC_AST2700_A1_BOOTMCU
	bool
	select SOC_AST2700_A1
	help
	  Enable support for ast2700-a1 Boot MCU

config SOC_AST2705_SSP
	bool
	select SOC_AST2705
	help
	  Enable support for AST2705 SSP

config SOC_AST2705_TSP
	bool
	select SOC_AST2705
	help
	  Enable support for AST2705 TSP

config SOC_AST2705_BOOTMCU
	bool
	select SOC_AST2705
	help
	  Enable support for AST2705 Boot MCU
```

## tests/boards/ast1030_evb/crypto/testcase.yaml
```yaml
tests:
  boards.ast1030_evb.crypto:
    platform_allow: ast1030_evb
    tags:
      - drivers
      - crypto
```

## tests/boards/ast1030_evb/espi/testcase.yaml
```yaml
tests:
  boards.ast1030_evb.espi:
    platform_allow: ast1030_evb
    tags:
      - drivers
      - espi
```

## tests/boards/ast1030_evb/i2c/testcase.yaml
```yaml
tests:
  boards.ast1030_evb.i2c:
    platform_allow: ast1030_evb
    tags:
      - drivers
      - i2c
```

## tests/boards/ast1030_evb/i3c/testcase.yaml
```yaml
tests:
  boards.ast1030_evb.i3c:
    platform_allow: ast1030_evb
    tags:
      - drivers
      - i3c
```

## tests/boards/ast1030_evb/jtag/testcase.yaml
```yaml
tests:
  boards.ast1030_evb.jtag:
    platform_allow: ast1030_evb
    tags:
      - drivers
      - jtag
```

## tests/boards/ast1030_evb/peci/testcase.yaml
```yaml
tests:
  boards.ast1030_evb.peci:
    platform_allow: ast1030_evb
    tags:
      - drivers
      - peci
```

## tests/boards/ast1030_evb/pwm_tach/testcase.yaml
```yaml
tests:
  boards.ast1030_evb.pwm_tach:
    platform_allow: ast1030_evb
    tags:
      - drivers
      - pwm
      - sensor
```

## tests/boards/ast1030_evb/spi/testcase.yaml
```yaml
tests:
  boards.ast1030_evb.spi:
    platform_allow: ast1030_evb
    tags:
      - drivers
      - spi
      - flash
```

## tests/boards/ast1030_evb/uart/testcase.yaml
```yaml
tests:
  boards.ast1030_evb.uart:
    platform_allow: ast1030_evb
    tags:
      - drivers
      - uart
```

## tests/boards/ast1040_evb/cptra/testcase.yaml
```yaml
common:
  harness: ztest

tests:
  boards.ast1040_evb.cptra:
    platform_allow: ast1040_evb/ast1040/cm4
    tags:
      - drivers
      - crypto
```

## tests/boards/ast1040_evb/espi/testcase.yaml
```yaml
tests:
  boards.ast1040_evb.espi:
    platform_allow: ast1040_evb/ast1040/cm4
    timeout: 630
    tags:
      - drivers
      - espi
```
